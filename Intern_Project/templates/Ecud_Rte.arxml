AUTOSAR XML (schema 4-0-3)
package /AUTOSAR
  module config Rte: implementation-config-variant=VARIANT-PRE-COMPILE
    BswInstance_BswM (RteBswModuleInstance): category=TOOL_CONFIGURED, RteBswImplementationRef=BswImplementation_BswM, RteBswModuleConfigurationRef=BswM
      16 x RteBswEventToTaskMapping, all with RteBswImmediateRestart=0:
        RteBswEventToTaskMapping_TimingEvent: category=TOOL_CONFIGURED, RteBswPositionInTask=4, RteBswEventRef=BswTE_BswM_MainFunction, RteBswMappedToTaskRef=OsTask_BSW_FG1_10ms, RteBswUsedOsAlarmRef=OsAlarm_BSW_10ms
        BMSE_Entry_BswM_Immediate_DcmEcuReset_modeNotificationPort_DcmEcuReset_HARD: RteBswEventRef=BMSE_Entry_BswM_Immediate_DcmEcuReset_modeNotificationPort_DcmEcuReset_HARD
        BMSE_Entry_BswM_Immediate_DcmEcuReset_modeNotificationPort_DcmEcuReset_JUMPTOSYSSUPPLIERBOOTLOADER: RteBswEventRef=BMSE_Entry_BswM_Immediate_DcmEcuReset_modeNotificationPort_DcmEcuReset_JUMPTOSYSSUPPLIERBOOTLOADER
        BMSE_Entry_BswM_Immediate_DcmEcuReset_modeNotificationPort_DcmEcuReset_KEYONOFF: RteBswEventRef=BMSE_Entry_BswM_Immediate_DcmEcuReset_modeNotificationPort_DcmEcuReset_KEYONOFF
        BMSE_Entry_BswM_Immediate_DcmEcuReset_modeNotificationPort_DcmEcuReset_JUMPTOBOOTLOADER: RteBswEventRef=BMSE_Entry_BswM_Immediate_DcmEcuReset_modeNotificationPort_DcmEcuReset_JUMPTOBOOTLOADER
        BMSE_Entry_BswM_Immediate_DcmEcuReset_modeNotificationPort_DcmEcuReset_EXECUTE: RteBswEventRef=BMSE_Entry_BswM_Immediate_DcmEcuReset_modeNotificationPort_DcmEcuReset_EXECUTE
        BMSE_Entry_BswM_Immediate_DcmEcuReset_modeNotificationPort_DcmEcuReset_NONE: RteBswEventRef=BMSE_Entry_BswM_Immediate_DcmEcuReset_modeNotificationPort_DcmEcuReset_NONE
        BMSE_Entry_BswM_Immediate_DcmEcuReset_modeNotificationPort_DcmEcuReset_SOFT: RteBswEventRef=BMSE_Entry_BswM_Immediate_DcmEcuReset_modeNotificationPort_DcmEcuReset_SOFT
        BMSE_Entry_BswM_Immediate_DcmDiagnosticSessionControl_modeNotificationPort_DcmDiagnosticSessionControl_DCM_PROGRAMMING_SESSION: RteBswEventRef=BMSE_Entry_BswM_Immediate_DcmDiagnosticSessionControl_modeNotificationPort_DcmDiagnosticSessionControl_DCM_PROGRAMMING_SESSION
        BMSE_Entry_BswM_Immediate_DcmDiagnosticSessionControl_modeNotificationPort_DcmDiagnosticSessionControl_DCM_ECU_PROGRAMMING_MODE: RteBswEventRef=BMSE_Entry_BswM_Immediate_DcmDiagnosticSessionControl_modeNotificationPort_DcmDiagnosticSessionControl_DCM_ECU_PROGRAMMING_MODE
        BMSE_Entry_BswM_Immediate_DcmDiagnosticSessionControl_modeNotificationPort_DcmDiagnosticSessionControl_DCM_QUIESCENT_CURRENT_DIAGNOSTIC_MODE_START: RteBswEventRef=BMSE_Entry_BswM_Immediate_DcmDiagnosticSessionControl_modeNotificationPort_DcmDiagnosticSessionControl_DCM_QUIESCENT_CURRENT_DIAGNOSTIC_MODE_START
        BMSE_Entry_BswM_Immediate_DcmDiagnosticSessionControl_modeNotificationPort_DcmDiagnosticSessionControl_DCM_SAFETY_SYSTEM_DIAGNOSTIC_SESSION: RteBswEventRef=BMSE_Entry_BswM_Immediate_DcmDiagnosticSessionControl_modeNotificationPort_DcmDiagnosticSessionControl_DCM_SAFETY_SYSTEM_DIAGNOSTIC_SESSION
        BMSE_Entry_BswM_Immediate_DcmDiagnosticSessionControl_modeNotificationPort_DcmDiagnosticSessionControl_DCM_EXTENDED_DIAGNOSTIC_MODE: RteBswEventRef=BMSE_Entry_BswM_Immediate_DcmDiagnosticSessionControl_modeNotificationPort_DcmDiagnosticSessionControl_DCM_EXTENDED_DIAGNOSTIC_MODE
        BMSE_Entry_BswM_Immediate_DcmDiagnosticSessionControl_modeNotificationPort_DcmDiagnosticSessionControl_DCM_EXTENDED_DIAGNOSTIC_SESSION: RteBswEventRef=BMSE_Entry_BswM_Immediate_DcmDiagnosticSessionControl_modeNotificationPort_DcmDiagnosticSessionControl_DCM_EXTENDED_DIAGNOSTIC_SESSION
        BMSE_Entry_BswM_Immediate_DcmDiagnosticSessionControl_modeNotificationPort_DcmDiagnosticSessionControl_DCM_DEFAULT_SESSION: RteBswEventRef=BMSE_Entry_BswM_Immediate_DcmDiagnosticSessionControl_modeNotificationPort_DcmDiagnosticSessionControl_DCM_DEFAULT_SESSION
        BMSE_Entry_BswM_Immediate_DcmDiagnosticSessionControl_modeNotificationPort_DcmDiagnosticSessionControl_DCM_SLEEP_MODE_START_REQUEST: RteBswEventRef=BMSE_Entry_BswM_Immediate_DcmDiagnosticSessionControl_modeNotificationPort_DcmDiagnosticSessionControl_DCM_SLEEP_MODE_START_REQUEST
      3 x RteBswExclusiveAreaImpl, all with category=TOOL_CONFIGURED, RteExclusiveAreaImplMechanism=ALL_INTERRUPT_BLOCKING:
        DATA_PROTECTION_RteBswExclusiveAreaImpl: RteBswExclusiveAreaRef=DATA_PROTECTION
        RULEPREVRESULT_PROTECTION_RteBswExclusiveAreaImpl: RteBswExclusiveAreaRef=RULEPREVRESULT_PROTECTION
        RULESTATUS_PROTECTION_RteBswExclusiveAreaImpl: RteBswExclusiveAreaRef=RULESTATUS_PROTECTION
      modeNotificationPort_DcmEcuReset (RteBswRequiredModeGroupConnection):
        category = TOOL_CONFIGURED
        RteBswProvidedModeGroupRef = DcmEcuReset
        RteBswRequiredModeGroupRef = modeNotificationPort_DcmEcuReset
        RteBswProvidedModeGrpModInstRef = BswInstance_Dcm
      modeNotificationPort_DcmDiagnosticSessionControl (RteBswRequiredModeGroupConnection):
        category = TOOL_CONFIGURED
        RteBswProvidedModeGroupRef = DcmDiagnosticSessionControl
        RteBswRequiredModeGroupRef = modeNotificationPort_DcmDiagnosticSessionControl
        RteBswProvidedModeGrpModInstRef = BswInstance_Dcm
    SwcInstance_BswM (RteSwComponentInstance): category=TOOL_CONFIGURED, RteSoftwareComponentInstanceRef=BswM
      4 x RteEventToTaskMapping, all with category=TOOL_CONFIGURED, RteImmediateRestart=0:
        RteEventToTaskMapping_DRE_BswM_Immediate_SwcModeRequest_AppMode_modeRequestPort_AppMode_AppMode: RtePositionInTask=0, RteEventRef=DRE_BswM_Immediate_SwcModeRequest_AppMode_modeRequestPort_AppMode_AppMode, RteMappedToTaskRef=OsTask_BSW_AppModeRequest
        RteEventToTaskMapping_DRE_BswM_Immediate_SwcModeRequest_ComMMode_LCANFD_modeRequestPort_ComMMode_LCANFD_ComMMode_LCANFD: RtePositionInTask=0, RteEventRef=DRE_BswM_Immediate_SwcModeRequest_ComMMode_LCANFD_modeRequestPort_ComMMode_LCANFD_ComMMode_LCANFD, RteMappedToTaskRef=OsTask_BSW_ComMModeRequest
        RteEventToTaskMapping_DRE_BswM_Immediate_SwcModeRequest_ComMMode_CCANFD_modeRequestPort_ComMMode_CCANFD_ComMMode_CCANFD: RtePositionInTask=2, RteEventRef=DRE_BswM_Immediate_SwcModeRequest_ComMMode_CCANFD_modeRequestPort_ComMMode_CCANFD_ComMMode_CCANFD, RteMappedToTaskRef=OsTask_BSW_ComMModeRequest
        RteEventToTaskMapping_DRE_BswM_Immediate_SwcModeRequest_ComMMode_zDEBUGCAN_modeRequestPort_ComMMode_zDEBUGCAN_ComMMode_zDEBUGCAN: RtePositionInTask=3, RteEventRef=DRE_BswM_Immediate_SwcModeRequest_ComMMode_zDEBUGCAN_modeRequestPort_ComMMode_zDEBUGCAN_ComMMode_zDEBUGCAN, RteMappedToTaskRef=OsTask_BSW_ComMModeRequest
    SwcInstance_SWC_AppMode (RteSwComponentInstance): category=TOOL_CONFIGURED, RteSoftwareComponentInstanceRef=SWC_AppMode
      31 x RteEventToTaskMapping, all with category=TOOL_CONFIGURED:
        RteEventToTaskMapping_SMSE_Entry_BusStateSwitched_modeNotificationPort_CanSMBORState_LCANFD_CanSMBORState_LCANFD_COMPLETE: RteImmediateRestart=0, RteEventRef=SMSE_Entry_BusOffStateSwitched_modeNotificationPort_CanSMBORState_LCANFD_CanSMBORState_LCANFD_COMPLETE
        RteEventToTaskMapping_SMSE_Entry_BusStateSwitched_modeNotificationPort_CanSMBORState_LCANFD_CanSMBORState_LCANFD_START: RteImmediateRestart=0, RteEventRef=SMSE_Entry_BusOffStateSwitched_modeNotificationPort_CanSMBORState_LCANFD_CanSMBORState_LCANFD_START
        RteEventToTaskMapping_SMSE_Entry_PduGroupSwitched_modeNotificationPort_PduGroupTx_LCANFD_PduGroupTx_LCANFD_START: RteImmediateRestart=false, RteEventRef=SMSE_Entry_PduGroupSwitched_LCANFD_Tx_modeNotificationPort_PduGroupTx_LCANFD_PduGroupTx_LCANFD_START
        RteEventToTaskMapping_SMSE_Entry_PduGroupSwitched_modeNotificationPort_PduGroupTx_LCANFD_PduGroupTx_LCANFD_STOP: RteImmediateRestart=false, RteEventRef=SMSE_Entry_PduGroupSwitched_LCANFD_Tx_modeNotificationPort_PduGroupTx_LCANFD_PduGroupTx_LCANFD_STOP
        RteEventToTaskMapping_SMSE_Entry_PduGroupSwitched_modeNotificationPort_ComMMode_LCANFD_ComMMode_LCANFD_FULL_COM: RteImmediateRestart=false, RteEventRef=SMSE_Entry_PduGroupSwitched_modeNotificationPort_ComMMode_LCANFD_ComMMode_LCANFD_FULL_COM
        RteEventToTaskMapping_SMSE_Entry_PduGroupSwitched_modeNotificationPort_ComMMode_LCANFD_ComMMode_LCANFD_NO_COM: RteImmediateRestart=false, RteEventRef=SMSE_Entry_PduGroupSwitched_modeNotificationPort_ComMMode_LCANFD_ComMMode_LCANFD_NO_COM
        RteEventToTaskMapping_SMSE_Entry_PduGroupSwitched_modeNotificationPort_ComMMode_LCANFD_ComMMode_LCANFD_SILENT_COM: RteImmediateRestart=false, RteEventRef=SMSE_Entry_PduGroupSwitched_modeNotificationPort_ComMMode_LCANFD_ComMMode_LCANFD_SILENT_COM
        RteEventToTaskMapping_SMSE_Entry_BusStateSwitched_modeNotificationPort_CanSMBORState_CCANFD_CanSMBORState_CCANFD_COMPLETE: RteImmediateRestart=0, RteEventRef=SMSE_Entry_BusOffStateSwitched_modeNotificationPort_CanSMBORState_CCANFD_CanSMBORState_CCANFD_COMPLETE
        RteEventToTaskMapping_SMSE_Entry_BusStateSwitched_modeNotificationPort_CanSMBORState_CCANFD_CanSMBORState_CCANFD_START: RteImmediateRestart=0, RteEventRef=SMSE_Entry_BusOffStateSwitched_modeNotificationPort_CanSMBORState_CCANFD_CanSMBORState_CCANFD_START
        RteEventToTaskMapping_SMSE_Entry_PduGroupSwitched_modeNotificationPort_PduGroupTx_CCANFD_PduGroupTx_CCANFD_START: RteImmediateRestart=false, RteEventRef=SMSE_Entry_PduGroupSwitched_CCANFD_Tx_modeNotificationPort_PduGroupTx_CCANFD_PduGroupTx_CCANFD_START
        RteEventToTaskMapping_SMSE_Entry_PduGroupSwitched_modeNotificationPort_PduGroupTx_CCANFD_PduGroupTx_CCANFD_STOP: RteImmediateRestart=false, RteEventRef=SMSE_Entry_PduGroupSwitched_CCANFD_Tx_modeNotificationPort_PduGroupTx_CCANFD_PduGroupTx_CCANFD_STOP
        RteEventToTaskMapping_SMSE_Entry_PduGroupSwitched_modeNotificationPort_ComMMode_CCANFD_ComMMode_CCANFD_FULL_COM: RteImmediateRestart=false, RteEventRef=SMSE_Entry_PduGroupSwitched_modeNotificationPort_ComMMode_CCANFD_ComMMode_CCANFD_FULL_COM
        RteEventToTaskMapping_SMSE_Entry_PduGroupSwitched_modeNotificationPort_ComMMode_CCANFD_ComMMode_CCANFD_NO_COM: RteImmediateRestart=false, RteEventRef=SMSE_Entry_PduGroupSwitched_modeNotificationPort_ComMMode_CCANFD_ComMMode_CCANFD_NO_COM
        RteEventToTaskMapping_SMSE_Entry_PduGroupSwitched_modeNotificationPort_ComMMode_CCANFD_ComMMode_CCANFD_SILENT_COM: RteImmediateRestart=false, RteEventRef=SMSE_Entry_PduGroupSwitched_modeNotificationPort_ComMMode_CCANFD_ComMMode_CCANFD_SILENT_COM
        RteEventToTaskMapping_SMSE_Entry_BusStateSwitched_modeNotificationPort_CanSMBORState_zDEBUGCAN_CanSMBORState_zDEBUGCAN_COMPLETE: RteImmediateRestart=0, RteEventRef=SMSE_Entry_CanSMBorStateSwitched_zDEBUGCAN_modeNotificationPort_CanSMBORState_zDEBUGCAN_CanSMBORState_zDEBUGCAN_COMPLETE
        RteEventToTaskMapping_SMSE_Entry_BusStateSwitched_modeNotificationPort_CanSMBORState_zDEBUGCAN_CanSMBORState_zDEBUGCAN_START: RteImmediateRestart=0, RteEventRef=SMSE_Entry_CanSMBorStateSwitched_zDEBUGCAN_modeNotificationPort_CanSMBORState_zDEBUGCAN_CanSMBORState_zDEBUGCAN_START
        RteEventToTaskMapping_SMSE_Entry_PduGroupSwitched_modeNotificationPort_PduGroupTx_zDEBUGCAN_PduGroupTx_zDEBUGCAN_START: RteImmediateRestart=false, RteEventRef=SMSE_Entry_PduGroupSwitched_zDEBUGCAN_Tx_modeNotificationPort_PduGroupTx_zDEBUGCAN_PduGroupTx_zDEBUGCAN_START
        RteEventToTaskMapping_SMSE_Entry_PduGroupSwitched_modeNotificationPort_PduGroupTx_zDEBUGCAN_PduGroupTx_zDEBUGCAN_STOP: RteImmediateRestart=false, RteEventRef=SMSE_Entry_PduGroupSwitched_zDEBUGCAN_Tx_modeNotificationPort_PduGroupTx_zDEBUGCAN_PduGroupTx_zDEBUGCAN_STOP
        RteEventToTaskMapping_SMSE_Entry_PduGroupSwitched_modeNotificationPort_ComMMode_zDEBUGCAN_ComMMode_zDEBUGCAN_FULL_COM: RteImmediateRestart=false, RteEventRef=SMSE_Entry_ComMModeSwitched_zDEBUGCAN_modeNotificationPort_ComMMode_zDEBUGCAN_ComMMode_zDEBUGCAN_FULL_COM
        RteEventToTaskMapping_SMSE_Entry_PduGroupSwitched_modeNotificationPort_ComMMode_zDEBUGCAN_ComMMode_zDEBUGCAN_NO_COM: RteImmediateRestart=false, RteEventRef=SMSE_Entry_ComMModeSwitched_zDEBUGCAN_modeNotificationPort_ComMMode_zDEBUGCAN_ComMMode_zDEBUGCAN_NO_COM
        RteEventToTaskMapping_SMSE_Entry_PduGroupSwitched_modeNotificationPort_ComMMode_zDEBUGCAN_ComMMode_zDEBUGCAN_SILENT_COM: RteImmediateRestart=false, RteEventRef=SMSE_Entry_ComMModeSwitched_zDEBUGCAN_modeNotificationPort_ComMMode_zDEBUGCAN_ComMMode_zDEBUGCAN_SILENT_COM
        RteEventToTaskMapping_SMSE_Entry_EcuModeSwitched_modeNotificationPort_EcuMode_EcuMode_ECUM_STATE_PREP_SHUTDOWN: RteImmediateRestart=0, RteEventRef=SMSE_Entry_EcuModeSwitched_modeNotificationPort_EcuMode_EcuMode_ECUM_STATE_PREP_SHUTDOWN
        RteEventToTaskMapping_SMSE_Entry_EcuModeSwitched_modeNotificationPort_EcuMode_EcuMode_ECUM_STATE_RUN: RteImmediateRestart=0, RteEventRef=SMSE_Entry_EcuModeSwitched_modeNotificationPort_EcuMode_EcuMode_ECUM_STATE_RUN
        RteEventToTaskMapping_SMSE_Entry_EcuModeSwitched_modeNotificationPort_EcuMode_EcuMode_ECUM_STATE_SHUTDOWN: RteImmediateRestart=0, RteEventRef=SMSE_Entry_EcuModeSwitched_modeNotificationPort_EcuMode_EcuMode_ECUM_STATE_SHUTDOWN
        RteEventToTaskMapping_SMSE_Entry_EcuModeSwitched_modeNotificationPort_EcuMode_EcuMode_ECUM_STATE_SLEEP: RteImmediateRestart=0, RteEventRef=SMSE_Entry_EcuModeSwitched_modeNotificationPort_EcuMode_EcuMode_ECUM_STATE_SLEEP
        RteEventToTaskMapping_SMSE_Entry_EcuModeSwitched_modeNotificationPort_EcuMode_EcuMode_ECUM_STATE_APP_POST_RUN: RteImmediateRestart=false, RteEventRef=SMSE_Entry_EcuModeSwitched_modeNotificationPort_EcuMode_EcuMode_ECUM_STATE_APP_POST_RUN
        RteEventToTaskMapping_SMSE_Entry_EcuModeSwitched_modeNotificationPort_EcuMode_EcuMode_ECUM_STATE_APP_RUN: RteImmediateRestart=false, RteEventRef=SMSE_Entry_EcuModeSwitched_modeNotificationPort_EcuMode_EcuMode_ECUM_STATE_APP_RUN
        RteEventToTaskMapping_SMSE_Entry_EcuModeSwitched_modeNotificationPort_EcuMode_EcuMode_ECUM_STATE_OFF: RteImmediateRestart=false, RteEventRef=SMSE_Entry_EcuModeSwitched_modeNotificationPort_EcuMode_EcuMode_ECUM_STATE_OFF
        RteEventToTaskMapping_SMSE_Entry_EcuModeSwitched_modeNotificationPort_EcuMode_EcuMode_ECUM_STATE_RESET: RteImmediateRestart=false, RteEventRef=SMSE_Entry_EcuModeSwitched_modeNotificationPort_EcuMode_EcuMode_ECUM_STATE_RESET
        RteEventToTaskMapping_SMSE_Entry_InitCompleted_modeNotificationPort_InitState_InitState_COMPLETE: RteImmediateRestart=0, RteEventRef=SMSE_Entry_InitCompleted_modeNotificationPort_InitState_InitState_COMPLETE
        RteEventToTaskMapping_TE_Test: RteImmediateRestart=0, RtePositionInTask=0, RteEventRef=TE_AppMode_Test, RteMappedToTaskRef=OsTask_ASW_FG1_100ms, RteUsedOsAlarmRef=OsAlarm_ASW_100ms
    27 x RteBswModuleInstance:
      BswInstance_Adc: category=TOOL_CONFIGURED, RteBswModuleConfigurationRef=Adc, RteBswImplementationRef=BswImplementation_Adc
        12 x RteBswExclusiveAreaImpl, all with category=TOOL_CONFIGURED, RteExclusiveAreaImplMechanism=ALL_INTERRUPT_BLOCKING:
          StartGroup: RteBswExclusiveAreaRef=StartGroup
          StopGroup: RteBswExclusiveAreaRef=StopGroup
          ReadGroup: RteBswExclusiveAreaRef=ReadGroup
          EnableHwTrig: RteBswExclusiveAreaRef=EnableHwTrig
          DisableHwTrig: RteBswExclusiveAreaRef=DisableHwTrig
          GetGrpStatus: RteBswExclusiveAreaRef=GetGrpStatus
          GetStreamLastPtr: RteBswExclusiveAreaRef=GetStreamLastPtr
          ScheduleStart: RteBswExclusiveAreaRef=ScheduleStart
          ScheduleStop: RteBswExclusiveAreaRef=ScheduleStop
          PushQueue: RteBswExclusiveAreaRef=PushQueue
          PopQueue: RteBswExclusiveAreaRef=PopQueue
          ScheduleNext: RteBswExclusiveAreaRef=ScheduleNext
      BswInstance_Can: category=TOOL_CONFIGURED, RteBswModuleConfigurationRef=Can, RteBswImplementationRef=BswImplementation_Can
        3 x RteBswExclusiveAreaImpl, all with category=TOOL_CONFIGURED, RteExclusiveAreaImplMechanism=ALL_INTERRUPT_BLOCKING:
          CanDisInt: RteBswExclusiveAreaRef=CanDisInt
          CanEnInt: RteBswExclusiveAreaRef=CanEnInt
          CanWrMO: RteBswExclusiveAreaRef=CanWrMO
      BswInstance_CanIf: category=TOOL_CONFIGURED, RteBswModuleConfigurationRef=CanIf, RteBswImplementationRef=BswImplementation_CanIf
        7 x RteBswExclusiveAreaImpl, all with category=TOOL_CONFIGURED, RteExclusiveAreaImplMechanism=ALL_INTERRUPT_BLOCKING:
          MODE_STATUS_PROTECTION: RteBswExclusiveAreaRef=MODE_STATUS_PROTECTION
          TX_QUEUE_PROTECTION: RteBswExclusiveAreaRef=TX_QUEUE_PROTECTION
          ExclusiveArea_0: RteBswExclusiveAreaRef=ExclusiveArea_0
          RX_NOTIFSTATUS_PROTECTION: RteBswExclusiveAreaRef=RX_NOTIFSTATUS_PROTECTION
          RX_DATA_PROTECTION: RteBswExclusiveAreaRef=RX_DATA_PROTECTION
          TX_DYNCANID_PROTECTION: RteBswExclusiveAreaRef=TX_DYNCANID_PROTECTION
          TX_NOTIFSTATUS_PROTECTION: RteBswExclusiveAreaRef=TX_NOTIFSTATUS_PROTECTION
      BswInstance_CanSM: category=TOOL_CONFIGURED, RteBswModuleConfigurationRef=CanSM, RteBswImplementationRef=BswImplementation_CanSM
        MODE_STATUS_PROTECTION (RteBswExclusiveAreaImpl): category=TOOL_CONFIGURED, RteExclusiveAreaImplMechanism=ALL_INTERRUPT_BLOCKING, RteBswExclusiveAreaRef=MODE_STATUS_PROTECTION
        BUSOFF_STATUS_PROTECTION (RteBswExclusiveAreaImpl): category=TOOL_CONFIGURED, RteExclusiveAreaImplMechanism=ALL_INTERRUPT_BLOCKING, RteBswExclusiveAreaRef=BUSOFF_STATUS_PROTECTION
        TE1 (RteBswEventToTaskMapping):
          category = TOOL_CONFIGURED
          RteBswImmediateRestart = false
          RteBswPositionInTask = 18
          RteBswEventRef = TE1
          RteBswMappedToTaskRef = OsTask_BSW_FG1_5ms_Com
          RteBswUsedOsAlarmRef = OsAlarm_BSW_5ms_Com
      BswInstance_CanTp: category=TOOL_CONFIGURED, RteBswModuleConfigurationRef=CanTp, RteBswImplementationRef=BswImplementation_CanTp
        TIMER_PROTECTION (RteBswExclusiveAreaImpl): category=TOOL_CONFIGURED, RteExclusiveAreaImplMechanism=ALL_INTERRUPT_BLOCKING, RteBswExclusiveAreaRef=TIMER_PROTECTION
        BswTimingEvent_0 (RteBswEventToTaskMapping):
          category = TOOL_CONFIGURED
          RteBswImmediateRestart = false
          RteBswPositionInTask = 21
          RteBswEventRef = BswTimingEvent_0
          RteBswMappedToTaskRef = OsTask_BSW_FG1_5ms_Com
          RteBswUsedOsAlarmRef = OsAlarm_BSW_5ms_Com
      BswInstance_Com: category=TOOL_CONFIGURED, RteBswModuleConfigurationRef=Com, RteBswImplementationRef=BswImplementation_Com
        21 x RteBswExclusiveAreaImpl, all with category=TOOL_CONFIGURED, RteExclusiveAreaImplMechanism=ALL_INTERRUPT_BLOCKING:
          RX_DM_STS_PROTECTION_AREA: RteBswExclusiveAreaRef=RX_DM_STS_PROTECTION_AREA
          RX_IPDU_STS_PROTECTION_AREA: RteBswExclusiveAreaRef=RX_IPDU_STS_PROTECTION_AREA
          TX_IPDU_STATUS_PROTECTION_AREA: RteBswExclusiveAreaRef=TX_IPDU_STATUS_PROTECTION_AREA
          TX_IPDU_DATA_PROTECTION: RteBswExclusiveAreaRef=TX_IPDU_DATA_PROTECTION
          TX_MDT_PROTECTION_AREA: RteBswExclusiveAreaRef=TX_MDT_PROTECTION_AREA
          RX_IPDU_STATUS_PROTECTION_AREA: RteBswExclusiveAreaRef=RX_IPDU_STATUS_PROTECTION_AREA
          RX_GW_STS_PROTECTION_AREA: RteBswExclusiveAreaRef=RX_GW_STS_PROTECTION_AREA
          SIG_DATA_PROTECTION_AREA: RteBswExclusiveAreaRef=SIG_DATA_PROTECTION_AREA
          RX_SIG_DATA_PROTECTION_AREA: RteBswExclusiveAreaRef=RX_SIG_DATA_PROTECTION_AREA
          RX_IPDU_DATA_PROTECTION_AREA: RteBswExclusiveAreaRef=RX_IPDU_DATA_PROTECTION_AREA
          IPDU_GRP_STS_PROTECTION: RteBswExclusiveAreaRef=IPDU_GRP_STS_PROTECTION
          IPDU_STS_PROTECTION: RteBswExclusiveAreaRef=IPDU_STS_PROTECTION
          RX_EXT_SIG_DATA_PROTECTION_AREA: RteBswExclusiveAreaRef=RX_EXT_SIG_DATA_PROTECTION_AREA
          TX_EXT_SIG_DATA_PROTECTION_AREA: RteBswExclusiveAreaRef=TX_EXT_SIG_DATA_PROTECTION_AREA
          TX_IPDU_BUFFER_PROTECTION_AREA: RteBswExclusiveAreaRef=TX_IPDU_BUFFER_PROTECTION_AREA
          RX_FIFO_PROTECTION_AREA: RteBswExclusiveAreaRef=RX_FIFO_PROTECTION_AREA
          IPDU_GROUP_STATUS_PROTECTION: RteBswExclusiveAreaRef=IPDU_GROUP_STATUS_PROTECTION
          IPDU_COUNTER_PROTECTION: RteBswExclusiveAreaRef=IPDU_COUNTER_PROTECTION
          TX_TMS_STATUS_PROTECTION_AREA: RteBswExclusiveAreaRef=TX_TMS_STATUS_PROTECTION_AREA
          TX_MDT_STS_PROTECTION_AREA: RteBswExclusiveAreaRef=TX_MDT_STS_PROTECTION_AREA
          TX_DM_STS_PROTECTION_AREA: RteBswExclusiveAreaRef=TX_DM_STS_PROTECTION_AREA
        BswTE_Com_MainFunctionTx (RteBswEventToTaskMapping):
          category = TOOL_CONFIGURED
          RteBswImmediateRestart = false
          RteBswPositionInTask = 17
          RteBswEventRef = BswTE_Com_MainFunctionTx
          RteBswMappedToTaskRef = OsTask_BSW_FG1_5ms_Com
          RteBswUsedOsAlarmRef = OsAlarm_BSW_5ms_Com
        BswTE_Com_MainFunctionRx (RteBswEventToTaskMapping):
          category = TOOL_CONFIGURED
          RteBswImmediateRestart = false
          RteBswPositionInTask = 15
          RteBswEventRef = BswTE_Com_MainFunctionRx
          RteBswMappedToTaskRef = OsTask_BSW_FG1_5ms_Com
          RteBswUsedOsAlarmRef = OsAlarm_BSW_5ms_Com
      BswInstance_ComM: category=TOOL_CONFIGURED, RteBswModuleConfigurationRef=ComM, RteBswImplementationRef=BswImplementation_ComM
        8 x RteBswExclusiveAreaImpl, all with category=TOOL_CONFIGURED, RteExclusiveAreaImplMechanism=ALL_INTERRUPT_BLOCKING:
          INHIBIT_CNT_PROTECTION: RteBswExclusiveAreaRef=INHIBIT_CNT_PROTECTION
          REQ_MODECNT_PROTECTION: RteBswExclusiveAreaRef=REQ_MODECNT_PROTECTION
          CURRENT_MODE_PROTECTION: RteBswExclusiveAreaRef=CURRENT_MODE_PROTECTION
          DCM_DIAGNOSTIC_PROTECTION: RteBswExclusiveAreaRef=DCM_DIAGNOSTIC_PROTECTION
          ECUM_WAKEUP_IND: RteBswExclusiveAreaRef=ECUM_WAKEUP_IND
          NM_INDICATION_PROTECTION: RteBswExclusiveAreaRef=NM_INDICATION_PROTECTION
          PNC_PREPARE_TIMER: RteBswExclusiveAreaRef=PNC_PREPARE_TIMER
          PNC_WAKEUP_IND: RteBswExclusiveAreaRef=PNC_WAKEUP_IND
        3 x RteBswEventToTaskMapping, all with category=TOOL_CONFIGURED, RteBswImmediateRestart=false, RteBswMappedToTaskRef=OsTask_BSW_FG1_5ms_Com, RteBswUsedOsAlarmRef=OsAlarm_BSW_5ms_Com:
          ComM_TE0: RteBswPositionInTask=1, RteBswEventRef=BswTE_ComM_MainFunction0
          ComM_TE1: RteBswPositionInTask=2, RteBswEventRef=BswTE_ComM_MainFunction1
          ComM_TE2: RteBswPositionInTask=3, RteBswEventRef=BswTE_ComM_MainFunction2
      BswInstance_Csm: category=TOOL_CONFIGURED, RteBswModuleConfigurationRef=Csm, RteBswImplementationRef=BswImplementation_Csm
        RteBswExclusiveAreaImpl_FUNCTION_PTR_PROTECTION (RteBswExclusiveAreaImpl): category=TOOL_CONFIGURED, RteExclusiveAreaImplMechanism=ALL_INTERRUPT_BLOCKING, RteBswExclusiveAreaRef=FUNCTION_PTR_PROTECTION
        RteBswEventToTaskMapping_CsmMainFunction (RteBswEventToTaskMapping):
          category = TOOL_CONFIGURED
          RteBswImmediateRestart = false
          RteBswPositionInTask = 6
          RteBswEventRef = BswTE_Csm_MainFunction
          RteBswMappedToTaskRef = OsTask_BSW_FG1_10ms
          RteBswUsedOsAlarmRef = OsAlarm_BSW_10ms
        RteBswInternalTriggerConfig_CsmMainFunction (RteBswInternalTriggerConfig): category=TOOL_CONFIGURED, RteBswTriggerSourceQueueLength=0, RteBswTriggerSourceRef=BswITP_Csm_TriggerPointWorker
        RteBswEventToTaskMapping_CsmWorker (RteBswEventToTaskMapping):
          category = TOOL_CONFIGURED
          RteBswImmediateRestart = false
          RteBswPositionInTask = 0
          RteBswEventRef = BswITOE_Csm_TriggerWorker
          RteBswMappedToTaskRef = OsTask_BSW_BG_Csm
      BswInstance_Dcm: category=TOOL_CONFIGURED, RteBswModuleConfigurationRef=Dcm, RteBswImplementationRef=BswImplementation_Dcm
        5 x RteBswExclusiveAreaImpl, all with category=TOOL_CONFIGURED, RteExclusiveAreaImplMechanism=ALL_INTERRUPT_BLOCKING:
          SIGNAL_DATA_PROTECTION_AREA: RteBswExclusiveAreaRef=SIGNAL_DATA_PROTECTION_AREA
          ProtclProtection: RteBswExclusiveAreaRef=ProtclProtection
          RxPduIdProtection: RteBswExclusiveAreaRef=RxPduIdProtection
          RxLengthProtection: RteBswExclusiveAreaRef=RxLengthProtection
          TimerProtection: RteBswExclusiveAreaRef=TimerProtection
        BswTE_Dcm_MainFunction (RteBswEventToTaskMapping):
          category = TOOL_CONFIGURED
          RteBswImmediateRestart = false
          RteBswPositionInTask = 20
          RteBswEventRef = BswTE_Dcm_MainFunction
          RteBswMappedToTaskRef = OsTask_BSW_FG1_5ms_Com
          RteBswUsedOsAlarmRef = OsAlarm_BSW_5ms_Com
      BswInstance_Dem: category=TOOL_CONFIGURED, RteBswModuleConfigurationRef=Dem, RteBswImplementationRef=BswImplementation_Dem
        9 x RteBswExclusiveAreaImpl, all with category=TOOL_CONFIGURED, RteExclusiveAreaImplMechanism=ALL_INTERRUPT_BLOCKING:
          REQUEST_BUFFER_PROTECTION: RteBswExclusiveAreaRef=REQUEST_BUFFER_PROTECTION
          REQUEST_RECORD_PROTECTION: RteBswExclusiveAreaRef=REQUEST_RECORD_PROTECTION
          REQUEST_STATUS_PROTECTION: RteBswExclusiveAreaRef=REQUEST_STATUS_PROTECTION
          REQUEST_OCC_PROTECTION: RteBswExclusiveAreaRef=REQUEST_OCC_PROTECTION
          REQUEST_OCCTIME_PROTECTION: RteBswExclusiveAreaRef=REQUEST_OCCTIME_PROTECTION
          REQUEST_NVDATA_PROTECTION: RteBswExclusiveAreaRef=REQUEST_NVDATA_PROTECTION
          CAPTURE_OBD_DATA: RteBswExclusiveAreaRef=CAPTURE_OBD_DATA
          REQUEST_DATA_PROTECTION: RteBswExclusiveAreaRef=REQUEST_DATA_PROTECTION
          REQUEST_DEBOUNCETIMEBASED: RteBswExclusiveAreaRef=REQUEST_DEBOUNCETIMEBASED
        BswTE_Dem_MainFunction (RteBswEventToTaskMapping):
          category = TOOL_CONFIGURED
          RteBswImmediateRestart = false
          RteBswPositionInTask = 0
          RteBswEventRef = BswTE_Dem_MainFunction
          RteBswMappedToTaskRef = OsTask_BSW_FG1_5ms_Mem
          RteBswUsedOsAlarmRef = OsAlarm_BSW_5ms_Mem
        ReleasedTrigger_ToNvM (RteBswExternalTriggerConfig): category=TOOL_CONFIGURED, RteBswTriggerSourceQueueLength=1, RteBswTriggerSourceRef=ReleasedTrigger_ToNvM
      BswInstance_Det: category=TOOL_CONFIGURED, RteBswModuleConfigurationRef=Det, RteBswImplementationRef=BswImplementation_Det
        RAM_DATA_PROTECTION (RteBswExclusiveAreaImpl): category=TOOL_CONFIGURED, RteExclusiveAreaImplMechanism=ALL_INTERRUPT_BLOCKING, RteBswExclusiveAreaRef=RAM_DATA_PROTECTION
      BswInstance_EcuM: category=TOOL_CONFIGURED, RteBswModuleConfigurationRef=EcuM, RteBswImplementationRef=BswImplementation_EcuM
        7 x RteBswExclusiveAreaImpl, all with category=TOOL_CONFIGURED, RteExclusiveAreaImplMechanism=ALL_INTERRUPT_BLOCKING:
          ALARM_TIME_PROTECTION: RteBswExclusiveAreaRef=ALARM_TIME_PROTECTION
          BOOT_TARGET_PROTECTION: RteBswExclusiveAreaRef=BOOT_TARGET_PROTECTION
          SHUTDOWN_CAUSE: RteBswExclusiveAreaRef=SHUTDOWN_CAUSE
          SHUTDOWN_OR_SLEEP_FLAG_PROTECTION: RteBswExclusiveAreaRef=SHUTDOWN_OR_SLEEP_FLAG_PROTECTION
          SHUTDOWN_TARGET_PROTECTION: RteBswExclusiveAreaRef=SHUTDOWN_TARGET_PROTECTION
          STATE_PROTECTION: RteBswExclusiveAreaRef=STATE_PROTECTION
          WAKEUP_STATUS_PROTECTION: RteBswExclusiveAreaRef=WAKEUP_STATUS_PROTECTION
        BswTE_EcuM_LoopDetection (RteBswEventToTaskMapping):
          category = TOOL_CONFIGURED
          RteBswImmediateRestart = false
          RteBswPositionInTask = 3
          RteBswEventRef = BswTE_EcuM_LoopDetection
          RteBswMappedToTaskRef = OsTask_BSW_FG1_10ms
          RteBswUsedOsAlarmRef = OsAlarm_BSW_10ms
        BswTE_EcuM_MainFunction (RteBswEventToTaskMapping):
          category = TOOL_CONFIGURED
          RteBswImmediateRestart = false
          RteBswPositionInTask = 2
          RteBswEventRef = BswTE_EcuM_MainFunction
          RteBswMappedToTaskRef = OsTask_BSW_FG1_10ms
          RteBswUsedOsAlarmRef = OsAlarm_BSW_10ms
      BswInstance_Fee: category=TOOL_CONFIGURED, RteBswModuleConfigurationRef=Fee, RteBswImplementationRef=BswImplementation_Fee
        Main (RteBswExclusiveAreaImpl): category=TOOL_CONFIGURED, RteExclusiveAreaImplMechanism=ALL_INTERRUPT_BLOCKING, RteBswExclusiveAreaRef=Main
      BswInstance_Fls: category=TOOL_CONFIGURED, RteBswModuleConfigurationRef=Fls, RteBswImplementationRef=BswImplementation_Fls
        5 x RteBswExclusiveAreaImpl, all with category=TOOL_CONFIGURED, RteExclusiveAreaImplMechanism=ALL_INTERRUPT_BLOCKING:
          Init: RteBswExclusiveAreaRef=Init
          Erase: RteBswExclusiveAreaRef=Erase
          Write: RteBswExclusiveAreaRef=Write
          Main: RteBswExclusiveAreaRef=Main
          ResumeErase: RteBswExclusiveAreaRef=ResumeErase
      BswInstance_FlsLoader: category=TOOL_CONFIGURED, RteBswModuleConfigurationRef=FlsLoader, RteBswImplementationRef=BswImplementation_FlsLoader
        3 x RteBswExclusiveAreaImpl, all with category=TOOL_CONFIGURED, RteExclusiveAreaImplMechanism=ALL_INTERRUPT_BLOCKING:
          Write: RteBswExclusiveAreaRef=Write
          Erase: RteBswExclusiveAreaRef=Erase
          lLock: RteBswExclusiveAreaRef=lLock
      BswInstance_Icu: category=TOOL_CONFIGURED, RteBswModuleConfigurationRef=Icu, RteBswImplementationRef=BswImplementation_Icu_17
        6 x RteBswExclusiveAreaImpl, all with category=TOOL_CONFIGURED, RteExclusiveAreaImplMechanism=ALL_INTERRUPT_BLOCKING:
          EnableWakeup: RteBswExclusiveAreaRef=EnableWakeup
          EnableNotification: RteBswExclusiveAreaRef=EnableNotification
          ResetEdgeCount: RteBswExclusiveAreaRef=ResetEdgeCount
          CcuInterruptHandle: RteBswExclusiveAreaRef=CcuInterruptHandle
          CcuVariableupdate: RteBswExclusiveAreaRef=CcuVariableupdate
          Ccu6IenUpdate: RteBswExclusiveAreaRef=Ccu6IenUpdate
      BswInstance_IoHwAb: category=TOOL_CONFIGURED, RteBswModuleConfigurationRef=IoHwAb, RteBswImplementationRef=BswImplementation_IoHwAb
        IoHwAbProtection (RteBswExclusiveAreaImpl): category=TOOL_CONFIGURED, RteExclusiveAreaImplMechanism=ALL_INTERRUPT_BLOCKING, RteBswExclusiveAreaRef=IoHwAbProtection
      BswInstance_NvM: category=TOOL_CONFIGURED, RteBswModuleConfigurationRef=NvM, RteBswImplementationRef=BswImplementation_NvM
        RAM_INDEX (RteBswExclusiveAreaImpl): category=TOOL_CONFIGURED, RteExclusiveAreaImplMechanism=ALL_INTERRUPT_BLOCKING, RteBswExclusiveAreaRef=RAM_INDEX
        RAM_STATUS_PROTECTION (RteBswExclusiveAreaImpl): category=TOOL_CONFIGURED, RteExclusiveAreaImplMechanism=ALL_INTERRUPT_BLOCKING, RteBswExclusiveAreaRef=RAM_STATUS_PROTECTION
        BTE_NvM (RteBswEventToTaskMapping):
          category = TOOL_CONFIGURED
          RteBswImmediateRestart = false
          RteBswPositionInTask = 1
          RteBswEventRef = BTE_NvM
          RteBswMappedToTaskRef = OsTask_BSW_FG1_5ms_Mem
          RteBswUsedOsAlarmRef = OsAlarm_BSW_5ms_Mem
        BITP_CallCyclicMemFunction (RteBswInternalTriggerConfig): category=TOOL_CONFIGURED, RteBswTriggerSourceQueueLength=1, RteBswTriggerSourceRef=BITP_CallCyclicMemFunction
        BITOE_MemMemFunction (RteBswEventToTaskMapping):
          category = TOOL_CONFIGURED
          RteBswImmediateRestart = false
          RteBswPositionInTask = 1
          RteBswEventRef = BITOE_MemMemFunction
          RteBswMappedToTaskRef = OsTask_BSW_Mem_Process
        RequiredTrigger_FromDem (RteBswRequiredTriggerConnection):
          category = TOOL_CONFIGURED
          RteBswRequiredTriggerRef = RequiredTrigger_FromDem
          RteBswReleasedTriggerRef = ReleasedTrigger_ToNvM
          RteBswReleasedTriggerModInstRef = BswInstance_Dem
        BETOE_CallCyclicMemFunction (RteBswEventToTaskMapping):
          category = TOOL_CONFIGURED
          RteBswImmediateRestart = false
          RteBswPositionInTask = 2
          RteBswEventRef = BETOE_CallCyclicMemFunction
          RteBswMappedToTaskRef = OsTask_BSW_Mem_Process
        MemCyclicMode_R (RteBswRequiredModeGroupConnection):
          category = TOOL_CONFIGURED
          RteBswRequiredModeGroupRef = MemCyclicMode_R
          RteBswProvidedModeGroupRef = MemCyclicMode
          RteBswProvidedModeGrpModInstRef = BswInstance_NvM
      BswInstance_PduR: category=TOOL_CONFIGURED, RteBswModuleConfigurationRef=PduR, RteBswImplementationRef=BswImplementation_PduR
        6 x RteBswExclusiveAreaImpl, all with category=TOOL_CONFIGURED, RteExclusiveAreaImplMechanism=ALL_INTERRUPT_BLOCKING:
          TP_TX_PROTECTION_AREA: RteBswExclusiveAreaRef=TP_TX_PROTECTION_AREA
          GROUP_STATUS_PROTECTION_AREA: RteBswExclusiveAreaRef=GROUP_STATUS_PROTECTION_AREA
          FIFO_STATUS_PROTECTION_AREA: RteBswExclusiveAreaRef=FIFO_STATUS_PROTECTION_AREA
          DATA_BUFFER_PROTECTION_AREA: RteBswExclusiveAreaRef=DATA_BUFFER_PROTECTION_AREA
          MULTICAST_PROTECTION_AREA: RteBswExclusiveAreaRef=MULTICAST_PROTECTION_AREA
          TP_GATEWAY_PROTECTION_AREA: RteBswExclusiveAreaRef=TP_GATEWAY_PROTECTION_AREA
      BswInstance_Spi: category=TOOL_CONFIGURED, RteBswModuleConfigurationRef=Spi, RteBswImplementationRef=BswImplementation_Spi
        6 x RteBswExclusiveAreaImpl, all with category=TOOL_CONFIGURED, RteExclusiveAreaImplMechanism=ALL_INTERRUPT_BLOCKING:
          AsyncTransmit: RteBswExclusiveAreaRef=AsyncTransmit
          GetSequenceResult: RteBswExclusiveAreaRef=GetSequenceResult
          Cancel: RteBswExclusiveAreaRef=Cancel
          Init: RteBswExclusiveAreaRef=Init
          DeInit: RteBswExclusiveAreaRef=DeInit
          SyncTransmit: RteBswExclusiveAreaRef=SyncTransmit
      BswInstance_Wdg: category=TOOL_CONFIGURED, RteBswModuleConfigurationRef=Wdg, RteBswImplementationRef=BswImplementation_Wdg_17
        6 x RteBswExclusiveAreaImpl, all with category=TOOL_CONFIGURED, RteExclusiveAreaImplMechanism=ALL_INTERRUPT_BLOCKING:
          TimerHandling: RteBswExclusiveAreaRef=TimerHandling
          ChangeMode: RteBswExclusiveAreaRef=ChangeMode
          Trigger: RteBswExclusiveAreaRef=Trigger
          SafetyTrigger: RteBswExclusiveAreaRef=SafetyTrigger
          SafetyInit: RteBswExclusiveAreaRef=SafetyInit
          SafetyOffMode: RteBswExclusiveAreaRef=SafetyOffMode
      BswInstance_WdgM: category=TOOL_CONFIGURED, RteBswModuleConfigurationRef=WdgM, RteBswImplementationRef=BswImplementation_WdgM
        GLOBALSUPVSNSTATUS_PROTECTION (RteBswExclusiveAreaImpl): category=TOOL_CONFIGURED, RteExclusiveAreaImplMechanism=ALL_INTERRUPT_BLOCKING, RteBswExclusiveAreaRef=GLOBALSUPVSNSTATUS_PROTECTION
        BswTE_WdgM_MainFunction (RteBswEventToTaskMapping):
          category = TOOL_CONFIGURED
          RteBswImmediateRestart = false
          RteBswPositionInTask = 1
          RteBswEventRef = BswTE_WdgM_MainFunction
          RteBswMappedToTaskRef = OsTask_BSW_FG1_10ms
          RteBswUsedOsAlarmRef = OsAlarm_BSW_10ms
        modeNotificationPort_EcuMode (RteBswRequiredModeGroupConnection):
          category = TOOL_CONFIGURED
          RteBswRequiredModeGroupRef = modeNotificationPort_EcuMode
          RteBswProvidedModeGroupRef = modeSwitchPort_EcuMode
          RteBswProvidedModeGrpModInstRef = BswInstance_BswM
      BswInstance_Xcp: category=TOOL_CONFIGURED, RteBswModuleConfigurationRef=Xcp, RteBswImplementationRef=BswImplementation_Xcp
        DATA_PROTECTION_AREA (RteBswExclusiveAreaImpl): category=TOOL_CONFIGURED, RteExclusiveAreaImplMechanism=ALL_INTERRUPT_BLOCKING, RteBswExclusiveAreaRef=DATA_PROTECTION_AREA
        BUSY_STATE_PROTECTION_AREA (RteBswExclusiveAreaImpl):
          category = TOOL_CONFIGURED
          RteExclusiveAreaImplMechanism = OS_RESOURCE
          RteBswExclusiveAreaRef = BUSY_STATE_PROTECTION_AREA
          RteBswExclusiveAreaOsResourceRef = XcpResource0
        Xcp_Main_TE (RteBswEventToTaskMapping):
          category = TOOL_CONFIGURED
          RteBswImmediateRestart = false
          RteBswPositionInTask = 14
          RteBswEventRef = Xcp_Main_TE
          RteBswMappedToTaskRef = OsTask_BSW_FG1_5ms_Com
          RteBswUsedOsAlarmRef = OsAlarm_BSW_5ms_Com
      BswInstance_CanTrcv: category=TOOL_CONFIGURED, RteBswModuleConfigurationRef=CanTrcv, RteBswImplementationRef=BswImplementation_CanTrcv
        INTERRUPT_PROTECTION_AREA (RteBswExclusiveAreaImpl): category=TOOL_CONFIGURED, RteExclusiveAreaImplMechanism=ALL_INTERRUPT_BLOCKING, RteBswExclusiveAreaRef=INTERRUPT_PROTECTION_AREA
      BswInstance_RamTst: category=TOOL_CONFIGURED, RteBswModuleConfigurationRef=RamTst, RteBswImplementationRef=BswImplementation_RamTst
        RAM_PROTECTION (RteBswExclusiveAreaImpl): category=TOOL_CONFIGURED, RteExclusiveAreaImplMechanism=ALL_INTERRUPT_BLOCKING, RteBswExclusiveAreaRef=RAM_PROTECTION
        PATTERN_CHECK_PROTECT (RteBswExclusiveAreaImpl): category=TOOL_CONFIGURED, RteExclusiveAreaImplMechanism=ALL_INTERRUPT_BLOCKING, RteBswExclusiveAreaRef=PATTERN_CHECK_PROTECT
        BswTE_RamTst_MainFunction (RteBswEventToTaskMapping):
          category = TOOL_CONFIGURED
          RteBswImmediateRestart = false
          RteBswPositionInTask = 0
          RteBswEventRef = BswTE_RamTst_MainFunction
          RteBswMappedToTaskRef = OsTask_BSW_FG1_100ms
          RteBswUsedOsAlarmRef = OsAlarm_BSW_100ms
      BswInstance_RomTst: RteBswImplementationRef=BswImplementation_RomTst, RteBswModuleConfigurationRef=RomTst
        RteBswEventToTaskMapping0 (RteBswEventToTaskMapping): RteBswImmediateRestart=0, RteBswPositionInTask=10, RteBswEventRef=BITOE_RomTst, RteBswMappedToTaskRef=OsTask_BSW_RomTst
        RteBswInternalTriggerConfig0 (RteBswInternalTriggerConfig): RteBswTriggerSourceQueueLength=1, RteBswTriggerSourceRef=BITP_RomTst
      BswInstance_RegMon: RteBswImplementationRef=BswImplementation_RegMon, RteBswModuleConfigurationRef=RegMon
        BswTE_RegMon_Monitor (RteBswEventToTaskMapping):
          RteBswImmediateRestart = 0
          RteBswPositionInTask = 8
          RteBswEventRef = BswTE_RegMon_RegisterMonitor
          RteBswMappedToTaskRef = OsTask_BSW_FG1_100ms
          RteBswUsedOsAlarmRef = OsAlarm_BSW_100ms
    RteInitializationBehavior0 (RteInitializationBehavior): RteSectionInitializationPolicy=INIT, RteInitializationStrategy=
    RteSwComponentType_SWC_AppMode (RteSwComponentType): RteComponentTypeRef=SWC_AppMode
      RteComponentTypeCalibration: category=TOOL_CONFIGURED, RteCalibrationSupportEnabled=0
    SwcInstance_SWC_DiagnosticMonitor (RteSwComponentInstance): category=TOOL_CONFIGURED, RteSoftwareComponentInstanceRef=SWC_DiagnosticMonitor
      9 x RteEventToTaskMapping, all with category=TOOL_CONFIGURED, RteImmediateRestart=false:
        RteEventToTaskMapping_OIE_InitMonitorForEvent: RteEventRef=OIE_InitMonitorForEvent
        RteEventToTaskMapping_OIE_CBReadData_DE_0001: RteEventRef=OIE_CBReadData_DE_0001
        RteEventToTaskMapping_OIE_CBReadData_DE_0002: RteEventRef=OIE_CBReadData_DE_0002
        RteEventToTaskMapping_TimingEvent_DiagnosticMonitor: RtePositionInTask=1, RteEventRef=TimingEvent_DiagnosticMonitor, RteMappedToTaskRef=OsTask_ASW_FG1_10ms, RteUsedOsAlarmRef=OsAlarm_ASW_10ms
        RteEventToTaskMapping_OIE_CBStatusEvt_DEM_E_TEST_EVENT: RteEventRef=OIE_CBStatusEvt_DEM_E_TEST_EVENT
        RteEventToTaskMapping_OIE_CBStatusEvt_E_MODE_CHANGE_LCANFD_CBStatusEvt_E_MODE_CHANGE_LCANFD_EventStatusChanged: RteEventRef=OIE_CBStatusEvt_E_MODE_CHANGE_LCANFD_CBStatusEvt_E_MODE_CHANGE_LCANFD_EventStatusChanged
        RteEventToTaskMapping_OIE_CBStatusEvt_E_MODE_CHANGE_Reserved_CBStatusEvt_E_MODE_CHANGE_Reserved_EventStatusChanged: RteEventRef=OIE_CBStatusEvt_E_MODE_CHANGE_Reserved_CBStatusEvt_E_MODE_CHANGE_Reserved_EventStatusChanged
        RteEventToTaskMapping_OIE_CBStatusEvt_E_MODE_CHANGE_CCANFD_CBStatusEvt_E_MODE_CHANGE_CCANFD_EventStatusChanged: RteEventRef=OIE_CBStatusEvt_E_MODE_CHANGE_CCANFD_CBStatusEvt_E_MODE_CHANGE_CCANFD_EventStatusChanged
        RteEventToTaskMapping_OIE_CBStatusEvt_E_MODE_CHANGE_zDEBUGCAN_CBStatusEvt_E_MODE_CHANGE_zDEBUGCAN_EventStatusChanged: RteEventRef=OIE_CBStatusEvt_E_MODE_CHANGE_zDEBUGCAN_CBStatusEvt_E_MODE_CHANGE_zDEBUGCAN_EventStatusChanged
    RteSwComponentType_SWC_DiagnosticMonitor (RteSwComponentType): RteComponentTypeRef=SWC_DiagnosticMonitor
      RteComponentTypeCalibration: category=TOOL_CONFIGURED, RteCalibrationSupportEnabled=0
    SwcInstance_SWC_DiagnosticService (RteSwComponentInstance): category=TOOL_CONFIGURED, RteSoftwareComponentInstanceRef=SWC_DiagnosticService
      45 x RteEventToTaskMapping, all with category=TOOL_CONFIGURED, RteImmediateRestart=false:
        RteEventToTaskMapping_OIE_CallbackDCMRequestServices_StartProtocol: RteEventRef=OIE_CallbackDCMRequestServices_StartProtocol
        RteEventToTaskMapping_OIE_CallbackDCMRequestServices_StopProtocol: RteEventRef=OIE_CallbackDCMRequestServices_StopProtocol
        RteEventToTaskMapping_OIE_L1_GetSeed: RteEventRef=OIE_L1_GetSeed
        RteEventToTaskMapping_OIE_L1_CompareKey: RteEventRef=OIE_L1_CompareKey
        RteEventToTaskMapping_OIE_RID_0200h_CalibrationActuator_Start: RteEventRef=OIE_RID_0200h_CalibrationActuator_Start
        RteEventToTaskMapping_OIE_RID_0200h_CalibrationActuator_Stop: RteEventRef=OIE_RID_0200h_CalibrationActuator_Stop
        RteEventToTaskMapping_OIE_RID_0200h_CalibrationActuator_RequestResults: RteEventRef=OIE_RID_0200h_CalibrationActuator_RequestResults
        RteEventToTaskMapping_OIE_DID_0100h_0110h_ReadDidData: RteEventRef=OIE_DID_0100h_0110h_ReadDidData
        RteEventToTaskMapping_OIE_DID_0100h_0110h_WriteDidData: RteEventRef=OIE_DID_0100h_0110h_WriteDidData
        RteEventToTaskMapping_OIE_DID_0100h_0110h_IsDidAvailable: RteEventRef=OIE_DID_0100h_0110h_IsDidAvailable
        RteEventToTaskMapping_OIE_ActuatorControl_ReadData: RteEventRef=OIE_ActuatorControl_ReadData
        RteEventToTaskMapping_OIE_ActuatorControl_WriteData: RteEventRef=OIE_ActuatorControl_WriteData
        RteEventToTaskMapping_OIE_ActuatorControl_ConditionCheckRead: RteEventRef=OIE_ActuatorControl_ConditionCheckRead
        RteEventToTaskMapping_OIE_ActuatorControl_ReturnControlToECU: RteEventRef=OIE_ActuatorControl_ReturnControlToECU
        RteEventToTaskMapping_OIE_ActuatorControl_ResetToDefault: RteEventRef=OIE_ActuatorControl_ResetToDefault
        RteEventToTaskMapping_OIE_ActuatorControl_FreezeCurrentState: RteEventRef=OIE_ActuatorControl_FreezeCurrentState
        RteEventToTaskMapping_OIE_ActuatorControl_ShortTermAdjustment: RteEventRef=OIE_ActuatorControl_ShortTermAdjustment
        RteEventToTaskMapping_OIE_VINDataIdentifier_ReadData: RteEventRef=OIE_VINDataIdentifier_ReadData
        RteEventToTaskMapping_OIE_VINDataIdentifier_ConditionCheckRead: RteEventRef=OIE_VINDataIdentifier_ConditionCheckRead
        RteEventToTaskMapping_OIE_VINDataIdentifier_WriteData: RteEventRef=OIE_VINDataIdentifier_WriteData
        RteEventToTaskMapping_OIE_VINDataIdentifier_GetScalingInformation: RteEventRef=OIE_VINDataIdentifier_GetScalingInformation
        RteEventToTaskMapping_OIE_VehicleManufacturerECUSoftwareVersionNumber_ReadData: RteEventRef=OIE_VehicleManufacturerECUSoftwareVersionNumber_ReadData
        RteEventToTaskMapping_OIE_VehicleManufacturerECUSoftwareVersionNumber_ConditionCheckRead: RteEventRef=OIE_VehicleManufacturerECUSoftwareVersionNumber_ConditionCheckRead
        RteEventToTaskMapping_OIE_SystemSupplierECUHardwareVersionNumber_ReadData: RteEventRef=OIE_SystemSupplierECUHardwareVersionNumber_ReadData
        RteEventToTaskMapping_OIE_SystemSupplierECUHardwareVersionNumber_ConditionCheckRead: RteEventRef=OIE_SystemSupplierECUHardwareVersionNumber_ConditionCheckRead
        RteEventToTaskMapping_OIE_SystemSupplierECUSoftwareNumber_ReadData: RteEventRef=OIE_SystemSupplierECUSoftwareNumber_ReadData
        RteEventToTaskMapping_OIE_SystemSupplierECUSoftwareNumber_ConditionCheckRead: RteEventRef=OIE_SystemSupplierECUSoftwareNumber_ConditionCheckRead
        RteEventToTaskMapping_OIE_VehicleSpeed_ReadData: RteEventRef=OIE_VehicleSpeed_ReadData
        RteEventToTaskMapping_OIE_VehicleSpeed_ConditionCheckRead: RteEventRef=OIE_VehicleSpeed_ConditionCheckRead
        RteEventToTaskMapping_OIE_VehicleSpeed_GetScalingInformation: RteEventRef=OIE_VehicleSpeed_GetScalingInformation
        RteEventToTaskMapping_OIE_BatVolt_ReadData: RteEventRef=OIE_BatVolt_ReadData
        RteEventToTaskMapping_OIE_BatVolt_WriteData: RteEventRef=OIE_BatVolt_WriteData
        RteEventToTaskMapping_OIE_BatVolt_ConditionCheckRead: RteEventRef=OIE_BatVolt_ConditionCheckRead
        RteEventToTaskMapping_OIE_ECT_ReadData: RteEventRef=OIE_ECT_ReadData
        RteEventToTaskMapping_OIE_ECT_ConditionCheckRead: RteEventRef=OIE_ECT_ConditionCheckRead
        RteEventToTaskMapping_OIE_ECT_WriteData: RteEventRef=OIE_ECT_WriteData
        RteEventToTaskMapping_OIE_RPM_ConditionCheckRead: RteEventRef=OIE_RPM_ConditionCheckRead
        RteEventToTaskMapping_OIE_RPM_ReadData: RteEventRef=OIE_RPM_ReadData
        RteEventToTaskMapping_OIE_RPM_ShortTermAdjustment: RteEventRef=OIE_RPM_ShortTermAdjustment
        RteEventToTaskMapping_OIE_RPM_ReturnControlToECU: RteEventRef=OIE_RPM_ReturnControlToECU
        RteEventToTaskMapping_OIE_RPM_FreezeCurrentState: RteEventRef=OIE_RPM_FreezeCurrentState
        RteEventToTaskMapping_OIE_RPM_WriteData: RteEventRef=OIE_RPM_WriteData
        RteEventToTaskMapping_OIE_ServiceRequestSupplierNotification_Confirmation: RteEventRef=OIE_ServiceRequestSupplierNotification_Confirmation
        RteEventToTaskMapping_OIE_ServiceRequestSupplierNotification_Indication: RteEventRef=OIE_ServiceRequestSupplierNotification_Indication
        RteEventToTaskMapping_SMSE_Entry_DiagnosticSessionControlNotification_modeNotificationPort_SessionControl_DcmDiagnosticSessionControl_DCM_EXTENDED_DIAGNOSTIC_SESSION: RteEventRef=SMSE_Entry_DiagnosticSessionControlNotification_modeNotificationPort_SessionControl_DcmDiagnosticSessionControl_DCM_EXTENDED_DIAGNOSTIC_SESSION
    RteSwComponentType_SWC_DiagnosticService (RteSwComponentType): RteComponentTypeRef=SWC_DiagnosticService
      RteComponentTypeCalibration: category=TOOL_CONFIGURED, RteCalibrationSupportEnabled=0
    SwcInstance_Swc_WdgMTest (RteSwComponentInstance): category=TOOL_CONFIGURED, RteSoftwareComponentInstanceRef=SWC_WdgMTest
      5 x RteEventToTaskMapping, all with category=TOOL_CONFIGURED, RteImmediateRestart=false:
        RteEventToTaskMapping_TE_WdgMTest: RtePositionInTask=2, RteEventRef=TE_WdgMTest, RteMappedToTaskRef=OsTask_ASW_FG1_10ms, RteUsedOsAlarmRef=OsAlarm_ASW_10ms
        RteEventToTaskMapping_SwcModeSwitchEvent_globalMode_OK: RtePositionInTask=0, RteEventRef=SwcModeSwitchEvent_globalMode_OK, RteMappedToTaskRef=OsTask_ASW_FG2_WdgMTestMode
        RteEventToTaskMapping_SwcModeSwitchEvent_globalMode_FAILED: RtePositionInTask=1, RteEventRef=SwcModeSwitchEvent_globalMode_FAILED, RteMappedToTaskRef=OsTask_ASW_FG2_WdgMTestMode
        RteEventToTaskMapping_SwcModeSwitchEvent_globalMode_EXPIRED: RtePositionInTask=2, RteEventRef=SwcModeSwitchEvent_globalMode_EXPIRED, RteMappedToTaskRef=OsTask_ASW_FG2_WdgMTestMode
        RteEventToTaskMapping_SwcModeSwitchEvent_globalMode_STOPPED: RtePositionInTask=3, RteEventRef=SwcModeSwitchEvent_globalMode_STOPPED, RteMappedToTaskRef=OsTask_ASW_FG2_WdgMTestMode
    RteSwComponentType_Swc_WdgMTest (RteSwComponentType): RteComponentTypeRef=SWC_WdgMTest
      RteComponentTypeCalibration: category=TOOL_CONFIGURED, RteCalibrationSupportEnabled=0
    SwcInstance_Svc_IoHwAb (RteSwComponentInstance): category=TOOL_CONFIGURED, RteSoftwareComponentInstanceRef=Svc_IoHwAb
    RteSwComponentType_IoHwAb (RteSwComponentType): RteComponentTypeRef=IoHwAb
      RteComponentTypeCalibration: category=TOOL_CONFIGURED, RteCalibrationSupportEnabled=0
    RteSwComponentType_BswM (RteSwComponentType): RteComponentTypeRef=BswM
      RteComponentTypeCalibration: category=TOOL_CONFIGURED, RteCalibrationSupportEnabled=0
    SwcInstance_ComM (RteSwComponentInstance): category=TOOL_CONFIGURED, RteSoftwareComponentInstanceRef=ComM
      31 x RteEventToTaskMapping, all with category=TOOL_CONFIGURED, RteImmediateRestart=false:
        RteEventToTaskMapping_OIE_ResetInhibitCounter_ML: RteEventRef=OIE_ResetInhibitCounter_ML
        RteEventToTaskMapping_OIE_SetECUGroupClassification_ML: RteEventRef=OIE_SetECUGroupClassification_ML
        RteEventToTaskMapping_OIE_GetStatus_ML: RteEventRef=OIE_GetStatus_ML
        RteEventToTaskMapping_OIE_LimitECUToNoComMode_ML: RteEventRef=OIE_LimitECUToNoComMode_ML
        RteEventToTaskMapping_OIE_ReadInhibitCounter_ML: RteEventRef=OIE_ReadInhibitCounter_ML
        RteEventToTaskMapping_OIE_GetInhibitionStatus_CL000: RteEventRef=OIE_GetInhibitionStatus_CL000
        RteEventToTaskMapping_OIE_LimitChannelToNoComMode_CL000: RteEventRef=OIE_LimitChannelToNoComMode_CL000
        RteEventToTaskMapping_OIE_PreventWakeup_CL000: RteEventRef=OIE_PreventWakeup_CL000
        RteEventToTaskMapping_OIE_GetState_CL000: RteEventRef=OIE_GetState_CL000
        RteEventToTaskMapping_OIE_GetInhibitionStatus_CL001: RteEventRef=OIE_GetInhibitionStatus_CL001
        RteEventToTaskMapping_OIE_LimitChannelToNoComMode_CL001: RteEventRef=OIE_LimitChannelToNoComMode_CL001
        RteEventToTaskMapping_OIE_PreventWakeup_CL001: RteEventRef=OIE_PreventWakeup_CL001
        RteEventToTaskMapping_OIE_GetState_CL001: RteEventRef=OIE_GetState_CL001
        RteEventToTaskMapping_OIE_RequestComMode_UR000: RteEventRef=OIE_RequestComMode_UR000
        RteEventToTaskMapping_OIE_GetRequestedComMode_UR000: RteEventRef=OIE_GetRequestedComMode_UR000
        RteEventToTaskMapping_OIE_GetCurrentComMode_UR000: RteEventRef=OIE_GetCurrentComMode_UR000
        RteEventToTaskMapping_OIE_RequestComMode_UR001: RteEventRef=OIE_RequestComMode_UR001
        RteEventToTaskMapping_OIE_GetRequestedComMode_UR001: RteEventRef=OIE_GetRequestedComMode_UR001
        RteEventToTaskMapping_OIE_GetCurrentComMode_UR001: RteEventRef=OIE_GetCurrentComMode_UR001
        RteEventToTaskMapping_OperationInvokedEvent_RequestComMode_ComMChannel_LCANFD: RteEventRef=OperationInvokedEvent_RequestComMode_ComMChannel_LCANFD
        RteEventToTaskMapping_OperationInvokedEvent_GetCurrentComMode_ComMChannel_LCANFD: RteEventRef=OperationInvokedEvent_GetCurrentComMode_ComMChannel_LCANFD
        RteEventToTaskMapping_OperationInvokedEvent_GetRequestedComMode_ComMChannel_LCANFD: RteEventRef=OperationInvokedEvent_GetRequestedComMode_ComMChannel_LCANFD
        RteEventToTaskMapping_OperationInvokedEvent_RequestComMode_ComMChannel_Reserved: RteEventRef=OperationInvokedEvent_RequestComMode_ComMChannel_Reserved
        RteEventToTaskMapping_OperationInvokedEvent_GetCurrentComMode_ComMChannel_Reserved: RteEventRef=OperationInvokedEvent_GetCurrentComMode_ComMChannel_Reserved
        RteEventToTaskMapping_OperationInvokedEvent_GetRequestedComMode_ComMChannel_Reserved: RteEventRef=OperationInvokedEvent_GetRequestedComMode_ComMChannel_Reserved
        RteEventToTaskMapping_OperationInvokedEvent_RequestComMode_ComMChannel_CCANFD: RteEventRef=OperationInvokedEvent_RequestComMode_ComMChannel_CCANFD
        RteEventToTaskMapping_OperationInvokedEvent_GetCurrentComMode_ComMChannel_CCANFD: RteEventRef=OperationInvokedEvent_GetCurrentComMode_ComMChannel_CCANFD
        RteEventToTaskMapping_OperationInvokedEvent_GetRequestedComMode_ComMChannel_CCANFD: RteEventRef=OperationInvokedEvent_GetRequestedComMode_ComMChannel_CCANFD
        RteEventToTaskMapping_OperationInvokedEvent_RequestComMode_ComMChannel_zDEBUGCAN: RteEventRef=OperationInvokedEvent_RequestComMode_ComMChannel_zDEBUGCAN
        RteEventToTaskMapping_OperationInvokedEvent_GetCurrentComMode_ComMChannel_zDEBUGCAN: RteEventRef=OperationInvokedEvent_GetCurrentComMode_ComMChannel_zDEBUGCAN
        RteEventToTaskMapping_OperationInvokedEvent_GetRequestedComMode_ComMChannel_zDEBUGCAN: RteEventRef=OperationInvokedEvent_GetRequestedComMode_ComMChannel_zDEBUGCAN
    RteSwComponentType_ComM (RteSwComponentType): RteComponentTypeRef=ComM
      RteComponentTypeCalibration: category=TOOL_CONFIGURED, RteCalibrationSupportEnabled=0
    SwcInstance_Csm (RteSwComponentInstance): category=TOOL_CONFIGURED, RteSoftwareComponentInstanceRef=Csm
    RteSwComponentType_Csm (RteSwComponentType): RteComponentTypeRef=Csm
      RteComponentTypeCalibration: category=TOOL_CONFIGURED, RteCalibrationSupportEnabled=0
    SwcInstance_DET (RteSwComponentInstance): category=TOOL_CONFIGURED, RteSoftwareComponentInstanceRef=DET
      RteEventToTaskMapping_OperationInvokedEvent_Det (RteEventToTaskMapping): category=TOOL_CONFIGURED, RteImmediateRestart=false, RteEventRef=OperationInvokedEvent_Det
    RteSwComponentType_DET (RteSwComponentType): RteComponentTypeRef=DET
      RteComponentTypeCalibration: category=TOOL_CONFIGURED, RteCalibrationSupportEnabled=0
    SwcInstance_Dcm (RteSwComponentInstance): category=TOOL_CONFIGURED, RteSoftwareComponentInstanceRef=Dcm
      4 x RteEventToTaskMapping, all with category=TOOL_CONFIGURED, RteImmediateRestart=false:
        RteEventToTaskMapping_OIE_DCMServices_ResetToDefaultSession: RteEventRef=OIE_DCMServices_ResetToDefaultSession
        RteEventToTaskMapping_OIE_DCMServices_GetSecurityLevel: RteEventRef=OIE_DCMServices_GetSecurityLevel
        RteEventToTaskMapping_OIE_DCMServices_GetActiveProtocol: RteEventRef=OIE_DCMServices_GetActiveProtocol
        RteEventToTaskMapping_OIE_DCMServices_GetSesCtrlType: RteEventRef=OIE_DCMServices_GetSesCtrlType
    RteSwComponentType_Dcm (RteSwComponentType): RteComponentTypeRef=Dcm
      RteComponentTypeCalibration: category=TOOL_CONFIGURED, RteCalibrationSupportEnabled=0
    SwcInstance_Dem (RteSwComponentInstance): category=TOOL_CONFIGURED, RteSoftwareComponentInstanceRef=Dem
      652 x RteEventToTaskMapping, all with category=TOOL_CONFIGURED, RteImmediateRestart=false:
        RteEventToTaskMapping_OIE_Event_DEM_E_TEST_EVENT6_SetEventStatus: RteEventRef=OIE_Event_DEM_E_TEST_EVENT6_SetEventStatus
        RteEventToTaskMapping_OIE_Event_DEM_E_TEST_EVENT6_ResetEventStatus: RteEventRef=OIE_Event_DEM_E_TEST_EVENT6_ResetEventStatus
        RteEventToTaskMapping_OIE_Event_DEM_E_TEST_EVENT6_SetEventDisabled: RteEventRef=OIE_Event_DEM_E_TEST_EVENT6_SetEventDisabled
        RteEventToTaskMapping_OIE_EventInfo_WDGM_E_IMPROPER_CALLER_GetDTCOfEvent: RteEventRef=OIE_EventInfo_WDGM_E_IMPROPER_CALLER_GetDTCOfEvent
        RteEventToTaskMapping_OIE_EventInfo_WDGM_E_IMPROPER_CALLER_GetEventFailed: RteEventRef=OIE_EventInfo_WDGM_E_IMPROPER_CALLER_GetEventFailed
        RteEventToTaskMapping_OIE_EventInfo_WDGM_E_IMPROPER_CALLER_GetEventExtendedDataRecord: RteEventRef=OIE_EventInfo_WDGM_E_IMPROPER_CALLER_GetEventExtendedDataRecord
        RteEventToTaskMapping_OIE_EventInfo_WDGM_E_IMPROPER_CALLER_GetFaultDetectionCounter: RteEventRef=OIE_EventInfo_WDGM_E_IMPROPER_CALLER_GetFaultDetectionCounter
        RteEventToTaskMapping_OIE_EventInfo_WDGM_E_IMPROPER_CALLER_GetEventTested: RteEventRef=OIE_EventInfo_WDGM_E_IMPROPER_CALLER_GetEventTested
        RteEventToTaskMapping_OIE_EventInfo_WDGM_E_IMPROPER_CALLER_GetEventFreezeFrameData: RteEventRef=OIE_EventInfo_WDGM_E_IMPROPER_CALLER_GetEventFreezeFrameData
        RteEventToTaskMapping_OIE_EventInfo_WDGM_E_IMPROPER_CALLER_GetEventStatus: RteEventRef=OIE_EventInfo_WDGM_E_IMPROPER_CALLER_GetEventStatus
        RteEventToTaskMapping_OIE_EventInfo_MCU_E_QUARTZ_FAILURE_GetDTCOfEvent: RteEventRef=OIE_EventInfo_MCU_E_QUARTZ_FAILURE_GetDTCOfEvent
        RteEventToTaskMapping_OIE_EventInfo_MCU_E_QUARTZ_FAILURE_GetEventFailed: RteEventRef=OIE_EventInfo_MCU_E_QUARTZ_FAILURE_GetEventFailed
        RteEventToTaskMapping_OIE_EventInfo_MCU_E_QUARTZ_FAILURE_GetEventExtendedDataRecord: RteEventRef=OIE_EventInfo_MCU_E_QUARTZ_FAILURE_GetEventExtendedDataRecord
        RteEventToTaskMapping_OIE_EventInfo_MCU_E_QUARTZ_FAILURE_GetFaultDetectionCounter: RteEventRef=OIE_EventInfo_MCU_E_QUARTZ_FAILURE_GetFaultDetectionCounter
        RteEventToTaskMapping_OIE_EventInfo_MCU_E_QUARTZ_FAILURE_GetEventTested: RteEventRef=OIE_EventInfo_MCU_E_QUARTZ_FAILURE_GetEventTested
        RteEventToTaskMapping_OIE_EventInfo_MCU_E_QUARTZ_FAILURE_GetEventFreezeFrameData: RteEventRef=OIE_EventInfo_MCU_E_QUARTZ_FAILURE_GetEventFreezeFrameData
        RteEventToTaskMapping_OIE_EventInfo_MCU_E_QUARTZ_FAILURE_GetEventStatus: RteEventRef=OIE_EventInfo_MCU_E_QUARTZ_FAILURE_GetEventStatus
        RteEventToTaskMapping_OIE_EventInfo_Dem_FLS_READ_ERROR_GetDTCOfEvent: RteEventRef=OIE_EventInfo_Dem_FLS_READ_ERROR_GetDTCOfEvent
        RteEventToTaskMapping_OIE_EventInfo_Dem_FLS_READ_ERROR_GetEventFailed: RteEventRef=OIE_EventInfo_Dem_FLS_READ_ERROR_GetEventFailed
        RteEventToTaskMapping_OIE_EventInfo_Dem_FLS_READ_ERROR_GetEventExtendedDataRecord: RteEventRef=OIE_EventInfo_Dem_FLS_READ_ERROR_GetEventExtendedDataRecord
        RteEventToTaskMapping_OIE_EventInfo_Dem_FLS_READ_ERROR_GetFaultDetectionCounter: RteEventRef=OIE_EventInfo_Dem_FLS_READ_ERROR_GetFaultDetectionCounter
        RteEventToTaskMapping_OIE_EventInfo_Dem_FLS_READ_ERROR_GetEventTested: RteEventRef=OIE_EventInfo_Dem_FLS_READ_ERROR_GetEventTested
        RteEventToTaskMapping_OIE_EventInfo_Dem_FLS_READ_ERROR_GetEventFreezeFrameData: RteEventRef=OIE_EventInfo_Dem_FLS_READ_ERROR_GetEventFreezeFrameData
        RteEventToTaskMapping_OIE_EventInfo_Dem_FLS_READ_ERROR_GetEventStatus: RteEventRef=OIE_EventInfo_Dem_FLS_READ_ERROR_GetEventStatus
        RteEventToTaskMapping_OIE_EventInfo_NVM_E_VERIFY_FAILED_GetDTCOfEvent: RteEventRef=OIE_EventInfo_NVM_E_VERIFY_FAILED_GetDTCOfEvent
        RteEventToTaskMapping_OIE_EventInfo_NVM_E_VERIFY_FAILED_GetEventFailed: RteEventRef=OIE_EventInfo_NVM_E_VERIFY_FAILED_GetEventFailed
        RteEventToTaskMapping_OIE_EventInfo_NVM_E_VERIFY_FAILED_GetEventExtendedDataRecord: RteEventRef=OIE_EventInfo_NVM_E_VERIFY_FAILED_GetEventExtendedDataRecord
        RteEventToTaskMapping_OIE_EventInfo_NVM_E_VERIFY_FAILED_GetFaultDetectionCounter: RteEventRef=OIE_EventInfo_NVM_E_VERIFY_FAILED_GetFaultDetectionCounter
        RteEventToTaskMapping_OIE_EventInfo_NVM_E_VERIFY_FAILED_GetEventTested: RteEventRef=OIE_EventInfo_NVM_E_VERIFY_FAILED_GetEventTested
        RteEventToTaskMapping_OIE_EventInfo_NVM_E_VERIFY_FAILED_GetEventFreezeFrameData: RteEventRef=OIE_EventInfo_NVM_E_VERIFY_FAILED_GetEventFreezeFrameData
        RteEventToTaskMapping_OIE_EventInfo_NVM_E_VERIFY_FAILED_GetEventStatus: RteEventRef=OIE_EventInfo_NVM_E_VERIFY_FAILED_GetEventStatus
        RteEventToTaskMapping_OIE_EventInfo_IOHWAB_E_SETUP_FAIL_GetDTCOfEvent: RteEventRef=OIE_EventInfo_IOHWAB_E_SETUP_FAIL_GetDTCOfEvent
        RteEventToTaskMapping_OIE_EventInfo_IOHWAB_E_SETUP_FAIL_GetEventFailed: RteEventRef=OIE_EventInfo_IOHWAB_E_SETUP_FAIL_GetEventFailed
        RteEventToTaskMapping_OIE_EventInfo_IOHWAB_E_SETUP_FAIL_GetEventExtendedDataRecord: RteEventRef=OIE_EventInfo_IOHWAB_E_SETUP_FAIL_GetEventExtendedDataRecord
        RteEventToTaskMapping_OIE_EventInfo_IOHWAB_E_SETUP_FAIL_GetFaultDetectionCounter: RteEventRef=OIE_EventInfo_IOHWAB_E_SETUP_FAIL_GetFaultDetectionCounter
        RteEventToTaskMapping_OIE_EventInfo_IOHWAB_E_SETUP_FAIL_GetEventTested: RteEventRef=OIE_EventInfo_IOHWAB_E_SETUP_FAIL_GetEventTested
        RteEventToTaskMapping_OIE_EventInfo_IOHWAB_E_SETUP_FAIL_GetEventFreezeFrameData: RteEventRef=OIE_EventInfo_IOHWAB_E_SETUP_FAIL_GetEventFreezeFrameData
        RteEventToTaskMapping_OIE_EventInfo_IOHWAB_E_SETUP_FAIL_GetEventStatus: RteEventRef=OIE_EventInfo_IOHWAB_E_SETUP_FAIL_GetEventStatus
        RteEventToTaskMapping_OIE_EventInfo_NVM_E_WRITE_PROTECTED_GetDTCOfEvent: RteEventRef=OIE_EventInfo_NVM_E_WRITE_PROTECTED_GetDTCOfEvent
        RteEventToTaskMapping_OIE_EventInfo_NVM_E_WRITE_PROTECTED_GetEventFailed: RteEventRef=OIE_EventInfo_NVM_E_WRITE_PROTECTED_GetEventFailed
        RteEventToTaskMapping_OIE_EventInfo_NVM_E_WRITE_PROTECTED_GetEventExtendedDataRecord: RteEventRef=OIE_EventInfo_NVM_E_WRITE_PROTECTED_GetEventExtendedDataRecord
        RteEventToTaskMapping_OIE_EventInfo_NVM_E_WRITE_PROTECTED_GetFaultDetectionCounter: RteEventRef=OIE_EventInfo_NVM_E_WRITE_PROTECTED_GetFaultDetectionCounter
        RteEventToTaskMapping_OIE_EventInfo_NVM_E_WRITE_PROTECTED_GetEventTested: RteEventRef=OIE_EventInfo_NVM_E_WRITE_PROTECTED_GetEventTested
        RteEventToTaskMapping_OIE_EventInfo_NVM_E_WRITE_PROTECTED_GetEventFreezeFrameData: RteEventRef=OIE_EventInfo_NVM_E_WRITE_PROTECTED_GetEventFreezeFrameData
        RteEventToTaskMapping_OIE_EventInfo_NVM_E_WRITE_PROTECTED_GetEventStatus: RteEventRef=OIE_EventInfo_NVM_E_WRITE_PROTECTED_GetEventStatus
        RteEventToTaskMapping_OIE_EventInfo_SPI_E_TIMEOUT_GetDTCOfEvent: RteEventRef=OIE_EventInfo_SPI_E_TIMEOUT_GetDTCOfEvent
        RteEventToTaskMapping_OIE_EventInfo_SPI_E_TIMEOUT_GetEventFailed: RteEventRef=OIE_EventInfo_SPI_E_TIMEOUT_GetEventFailed
        RteEventToTaskMapping_OIE_EventInfo_SPI_E_TIMEOUT_GetEventExtendedDataRecord: RteEventRef=OIE_EventInfo_SPI_E_TIMEOUT_GetEventExtendedDataRecord
        RteEventToTaskMapping_OIE_EventInfo_SPI_E_TIMEOUT_GetFaultDetectionCounter: RteEventRef=OIE_EventInfo_SPI_E_TIMEOUT_GetFaultDetectionCounter
        RteEventToTaskMapping_OIE_EventInfo_SPI_E_TIMEOUT_GetEventTested: RteEventRef=OIE_EventInfo_SPI_E_TIMEOUT_GetEventTested
        RteEventToTaskMapping_OIE_EventInfo_SPI_E_TIMEOUT_GetEventFreezeFrameData: RteEventRef=OIE_EventInfo_SPI_E_TIMEOUT_GetEventFreezeFrameData
        RteEventToTaskMapping_OIE_EventInfo_SPI_E_TIMEOUT_GetEventStatus: RteEventRef=OIE_EventInfo_SPI_E_TIMEOUT_GetEventStatus
        RteEventToTaskMapping_OIE_OverflowIndPrimaryMemory_GetEventMemoryOverflow: RteEventRef=OIE_OverflowIndPrimaryMemory_GetEventMemoryOverflow
        RteEventToTaskMapping_OIE_EventInfo_NVM_E_REQ_FAILED_GetDTCOfEvent: RteEventRef=OIE_EventInfo_NVM_E_REQ_FAILED_GetDTCOfEvent
        RteEventToTaskMapping_OIE_EventInfo_NVM_E_REQ_FAILED_GetEventFailed: RteEventRef=OIE_EventInfo_NVM_E_REQ_FAILED_GetEventFailed
        RteEventToTaskMapping_OIE_EventInfo_NVM_E_REQ_FAILED_GetEventExtendedDataRecord: RteEventRef=OIE_EventInfo_NVM_E_REQ_FAILED_GetEventExtendedDataRecord
        RteEventToTaskMapping_OIE_EventInfo_NVM_E_REQ_FAILED_GetFaultDetectionCounter: RteEventRef=OIE_EventInfo_NVM_E_REQ_FAILED_GetFaultDetectionCounter
        RteEventToTaskMapping_OIE_EventInfo_NVM_E_REQ_FAILED_GetEventTested: RteEventRef=OIE_EventInfo_NVM_E_REQ_FAILED_GetEventTested
        RteEventToTaskMapping_OIE_EventInfo_NVM_E_REQ_FAILED_GetEventFreezeFrameData: RteEventRef=OIE_EventInfo_NVM_E_REQ_FAILED_GetEventFreezeFrameData
        RteEventToTaskMapping_OIE_EventInfo_NVM_E_REQ_FAILED_GetEventStatus: RteEventRef=OIE_EventInfo_NVM_E_REQ_FAILED_GetEventStatus
        RteEventToTaskMapping_OIE_EventInfo_NVM_E_QUEUE_OVERFLOW_GetDTCOfEvent: RteEventRef=OIE_EventInfo_NVM_E_QUEUE_OVERFLOW_GetDTCOfEvent
        RteEventToTaskMapping_OIE_EventInfo_NVM_E_QUEUE_OVERFLOW_GetEventFailed: RteEventRef=OIE_EventInfo_NVM_E_QUEUE_OVERFLOW_GetEventFailed
        RteEventToTaskMapping_OIE_EventInfo_NVM_E_QUEUE_OVERFLOW_GetEventExtendedDataRecord: RteEventRef=OIE_EventInfo_NVM_E_QUEUE_OVERFLOW_GetEventExtendedDataRecord
        RteEventToTaskMapping_OIE_EventInfo_NVM_E_QUEUE_OVERFLOW_GetFaultDetectionCounter: RteEventRef=OIE_EventInfo_NVM_E_QUEUE_OVERFLOW_GetFaultDetectionCounter
        RteEventToTaskMapping_OIE_EventInfo_NVM_E_QUEUE_OVERFLOW_GetEventTested: RteEventRef=OIE_EventInfo_NVM_E_QUEUE_OVERFLOW_GetEventTested
        RteEventToTaskMapping_OIE_EventInfo_NVM_E_QUEUE_OVERFLOW_GetEventFreezeFrameData: RteEventRef=OIE_EventInfo_NVM_E_QUEUE_OVERFLOW_GetEventFreezeFrameData
        RteEventToTaskMapping_OIE_EventInfo_NVM_E_QUEUE_OVERFLOW_GetEventStatus: RteEventRef=OIE_EventInfo_NVM_E_QUEUE_OVERFLOW_GetEventStatus
        RteEventToTaskMapping_OIE_Event_DEM_E_TEST_EVENT4_SetEventStatus: RteEventRef=OIE_Event_DEM_E_TEST_EVENT4_SetEventStatus
        RteEventToTaskMapping_OIE_Event_DEM_E_TEST_EVENT4_ResetEventStatus: RteEventRef=OIE_Event_DEM_E_TEST_EVENT4_ResetEventStatus
        RteEventToTaskMapping_OIE_Event_DEM_E_TEST_EVENT4_SetEventDisabled: RteEventRef=OIE_Event_DEM_E_TEST_EVENT4_SetEventDisabled
        RteEventToTaskMapping_OIE_EventInfo_FLS_E_WRITE_FAILED_GetDTCOfEvent: RteEventRef=OIE_EventInfo_FLS_E_WRITE_FAILED_GetDTCOfEvent
        RteEventToTaskMapping_OIE_EventInfo_FLS_E_WRITE_FAILED_GetEventFailed: RteEventRef=OIE_EventInfo_FLS_E_WRITE_FAILED_GetEventFailed
        RteEventToTaskMapping_OIE_EventInfo_FLS_E_WRITE_FAILED_GetEventExtendedDataRecord: RteEventRef=OIE_EventInfo_FLS_E_WRITE_FAILED_GetEventExtendedDataRecord
        RteEventToTaskMapping_OIE_EventInfo_FLS_E_WRITE_FAILED_GetFaultDetectionCounter: RteEventRef=OIE_EventInfo_FLS_E_WRITE_FAILED_GetFaultDetectionCounter
        RteEventToTaskMapping_OIE_EventInfo_FLS_E_WRITE_FAILED_GetEventTested: RteEventRef=OIE_EventInfo_FLS_E_WRITE_FAILED_GetEventTested
        RteEventToTaskMapping_OIE_EventInfo_FLS_E_WRITE_FAILED_GetEventFreezeFrameData: RteEventRef=OIE_EventInfo_FLS_E_WRITE_FAILED_GetEventFreezeFrameData
        RteEventToTaskMapping_OIE_EventInfo_FLS_E_WRITE_FAILED_GetEventStatus: RteEventRef=OIE_EventInfo_FLS_E_WRITE_FAILED_GetEventStatus
        RteEventToTaskMapping_OIE_EventInfo_DEM_E_TEST_EVENT3_GetDTCOfEvent: RteEventRef=OIE_EventInfo_DEM_E_TEST_EVENT3_GetDTCOfEvent
        RteEventToTaskMapping_OIE_EventInfo_DEM_E_TEST_EVENT3_GetEventFailed: RteEventRef=OIE_EventInfo_DEM_E_TEST_EVENT3_GetEventFailed
        RteEventToTaskMapping_OIE_EventInfo_DEM_E_TEST_EVENT3_GetEventExtendedDataRecord: RteEventRef=OIE_EventInfo_DEM_E_TEST_EVENT3_GetEventExtendedDataRecord
        RteEventToTaskMapping_OIE_EventInfo_DEM_E_TEST_EVENT3_GetFaultDetectionCounter: RteEventRef=OIE_EventInfo_DEM_E_TEST_EVENT3_GetFaultDetectionCounter
        RteEventToTaskMapping_OIE_EventInfo_DEM_E_TEST_EVENT3_GetEventTested: RteEventRef=OIE_EventInfo_DEM_E_TEST_EVENT3_GetEventTested
        RteEventToTaskMapping_OIE_EventInfo_DEM_E_TEST_EVENT3_GetEventFreezeFrameData: RteEventRef=OIE_EventInfo_DEM_E_TEST_EVENT3_GetEventFreezeFrameData
        RteEventToTaskMapping_OIE_EventInfo_DEM_E_TEST_EVENT3_GetEventStatus: RteEventRef=OIE_EventInfo_DEM_E_TEST_EVENT3_GetEventStatus
        RteEventToTaskMapping_OIE_EventInfo_MCU_E_LOCK_FAILURE_GetDTCOfEvent: RteEventRef=OIE_EventInfo_MCU_E_LOCK_FAILURE_GetDTCOfEvent
        RteEventToTaskMapping_OIE_EventInfo_MCU_E_LOCK_FAILURE_GetEventFailed: RteEventRef=OIE_EventInfo_MCU_E_LOCK_FAILURE_GetEventFailed
        RteEventToTaskMapping_OIE_EventInfo_MCU_E_LOCK_FAILURE_GetEventExtendedDataRecord: RteEventRef=OIE_EventInfo_MCU_E_LOCK_FAILURE_GetEventExtendedDataRecord
        RteEventToTaskMapping_OIE_EventInfo_MCU_E_LOCK_FAILURE_GetFaultDetectionCounter: RteEventRef=OIE_EventInfo_MCU_E_LOCK_FAILURE_GetFaultDetectionCounter
        RteEventToTaskMapping_OIE_EventInfo_MCU_E_LOCK_FAILURE_GetEventTested: RteEventRef=OIE_EventInfo_MCU_E_LOCK_FAILURE_GetEventTested
        RteEventToTaskMapping_OIE_EventInfo_MCU_E_LOCK_FAILURE_GetEventFreezeFrameData: RteEventRef=OIE_EventInfo_MCU_E_LOCK_FAILURE_GetEventFreezeFrameData
        RteEventToTaskMapping_OIE_EventInfo_MCU_E_LOCK_FAILURE_GetEventStatus: RteEventRef=OIE_EventInfo_MCU_E_LOCK_FAILURE_GetEventStatus
        RteEventToTaskMapping_OIE_EventInfo_Dem_FLS_ERASE_ERROR_GetDTCOfEvent: RteEventRef=OIE_EventInfo_Dem_FLS_ERASE_ERROR_GetDTCOfEvent
        RteEventToTaskMapping_OIE_EventInfo_Dem_FLS_ERASE_ERROR_GetEventFailed: RteEventRef=OIE_EventInfo_Dem_FLS_ERASE_ERROR_GetEventFailed
        RteEventToTaskMapping_OIE_EventInfo_Dem_FLS_ERASE_ERROR_GetEventExtendedDataRecord: RteEventRef=OIE_EventInfo_Dem_FLS_ERASE_ERROR_GetEventExtendedDataRecord
        RteEventToTaskMapping_OIE_EventInfo_Dem_FLS_ERASE_ERROR_GetFaultDetectionCounter: RteEventRef=OIE_EventInfo_Dem_FLS_ERASE_ERROR_GetFaultDetectionCounter
        RteEventToTaskMapping_OIE_EventInfo_Dem_FLS_ERASE_ERROR_GetEventTested: RteEventRef=OIE_EventInfo_Dem_FLS_ERASE_ERROR_GetEventTested
        RteEventToTaskMapping_OIE_EventInfo_Dem_FLS_ERASE_ERROR_GetEventFreezeFrameData: RteEventRef=OIE_EventInfo_Dem_FLS_ERASE_ERROR_GetEventFreezeFrameData
        RteEventToTaskMapping_OIE_EventInfo_Dem_FLS_ERASE_ERROR_GetEventStatus: RteEventRef=OIE_EventInfo_Dem_FLS_ERASE_ERROR_GetEventStatus
        RteEventToTaskMapping_OIE_EventInfo_ECUM_E_CONFIGURATION_DATA_INCONSISTENT_GetDTCOfEvent: RteEventRef=OIE_EventInfo_ECUM_E_CONFIGURATION_DATA_INCONSISTENT_GetDTCOfEvent
        RteEventToTaskMapping_OIE_EventInfo_ECUM_E_CONFIGURATION_DATA_INCONSISTENT_GetEventFailed: RteEventRef=OIE_EventInfo_ECUM_E_CONFIGURATION_DATA_INCONSISTENT_GetEventFailed
        RteEventToTaskMapping_OIE_EventInfo_ECUM_E_CONFIGURATION_DATA_INCONSISTENT_GetEventExtendedDataRecord: RteEventRef=OIE_EventInfo_ECUM_E_CONFIGURATION_DATA_INCONSISTENT_GetEventExtendedDataRecord
        RteEventToTaskMapping_OIE_EventInfo_ECUM_E_CONFIGURATION_DATA_INCONSISTENT_GetFaultDetectionCounter: RteEventRef=OIE_EventInfo_ECUM_E_CONFIGURATION_DATA_INCONSISTENT_GetFaultDetectionCounter
        RteEventToTaskMapping_OIE_EventInfo_ECUM_E_CONFIGURATION_DATA_INCONSISTENT_GetEventTested: RteEventRef=OIE_EventInfo_ECUM_E_CONFIGURATION_DATA_INCONSISTENT_GetEventTested
        RteEventToTaskMapping_OIE_EventInfo_ECUM_E_CONFIGURATION_DATA_INCONSISTENT_GetEventFreezeFrameData: RteEventRef=OIE_EventInfo_ECUM_E_CONFIGURATION_DATA_INCONSISTENT_GetEventFreezeFrameData
        RteEventToTaskMapping_OIE_EventInfo_ECUM_E_CONFIGURATION_DATA_INCONSISTENT_GetEventStatus: RteEventRef=OIE_EventInfo_ECUM_E_CONFIGURATION_DATA_INCONSISTENT_GetEventStatus
        RteEventToTaskMapping_OIE_EventInfo_Dem_FEE_GC_WRITE_ERROR_GetDTCOfEvent: RteEventRef=OIE_EventInfo_Dem_FEE_GC_WRITE_ERROR_GetDTCOfEvent
        RteEventToTaskMapping_OIE_EventInfo_Dem_FEE_GC_WRITE_ERROR_GetEventFailed: RteEventRef=OIE_EventInfo_Dem_FEE_GC_WRITE_ERROR_GetEventFailed
        RteEventToTaskMapping_OIE_EventInfo_Dem_FEE_GC_WRITE_ERROR_GetEventExtendedDataRecord: RteEventRef=OIE_EventInfo_Dem_FEE_GC_WRITE_ERROR_GetEventExtendedDataRecord
        RteEventToTaskMapping_OIE_EventInfo_Dem_FEE_GC_WRITE_ERROR_GetFaultDetectionCounter: RteEventRef=OIE_EventInfo_Dem_FEE_GC_WRITE_ERROR_GetFaultDetectionCounter
        RteEventToTaskMapping_OIE_EventInfo_Dem_FEE_GC_WRITE_ERROR_GetEventTested: RteEventRef=OIE_EventInfo_Dem_FEE_GC_WRITE_ERROR_GetEventTested
        RteEventToTaskMapping_OIE_EventInfo_Dem_FEE_GC_WRITE_ERROR_GetEventFreezeFrameData: RteEventRef=OIE_EventInfo_Dem_FEE_GC_WRITE_ERROR_GetEventFreezeFrameData
        RteEventToTaskMapping_OIE_EventInfo_Dem_FEE_GC_WRITE_ERROR_GetEventStatus: RteEventRef=OIE_EventInfo_Dem_FEE_GC_WRITE_ERROR_GetEventStatus
        RteEventToTaskMapping_OIE_EventInfo_DEM_E_TEST_EVENT1_GetDTCOfEvent: RteEventRef=OIE_EventInfo_DEM_E_TEST_EVENT1_GetDTCOfEvent
        RteEventToTaskMapping_OIE_EventInfo_DEM_E_TEST_EVENT1_GetEventFailed: RteEventRef=OIE_EventInfo_DEM_E_TEST_EVENT1_GetEventFailed
        RteEventToTaskMapping_OIE_EventInfo_DEM_E_TEST_EVENT1_GetEventExtendedDataRecord: RteEventRef=OIE_EventInfo_DEM_E_TEST_EVENT1_GetEventExtendedDataRecord
        RteEventToTaskMapping_OIE_EventInfo_DEM_E_TEST_EVENT1_GetFaultDetectionCounter: RteEventRef=OIE_EventInfo_DEM_E_TEST_EVENT1_GetFaultDetectionCounter
        RteEventToTaskMapping_OIE_EventInfo_DEM_E_TEST_EVENT1_GetEventTested: RteEventRef=OIE_EventInfo_DEM_E_TEST_EVENT1_GetEventTested
        RteEventToTaskMapping_OIE_EventInfo_DEM_E_TEST_EVENT1_GetEventFreezeFrameData: RteEventRef=OIE_EventInfo_DEM_E_TEST_EVENT1_GetEventFreezeFrameData
        RteEventToTaskMapping_OIE_EventInfo_DEM_E_TEST_EVENT1_GetEventStatus: RteEventRef=OIE_EventInfo_DEM_E_TEST_EVENT1_GetEventStatus
        RteEventToTaskMapping_OIE_EventInfo_WDGM_E_MONITORING_GetDTCOfEvent: RteEventRef=OIE_EventInfo_WDGM_E_MONITORING_GetDTCOfEvent
        RteEventToTaskMapping_OIE_EventInfo_WDGM_E_MONITORING_GetEventFailed: RteEventRef=OIE_EventInfo_WDGM_E_MONITORING_GetEventFailed
        RteEventToTaskMapping_OIE_EventInfo_WDGM_E_MONITORING_GetEventExtendedDataRecord: RteEventRef=OIE_EventInfo_WDGM_E_MONITORING_GetEventExtendedDataRecord
        RteEventToTaskMapping_OIE_EventInfo_WDGM_E_MONITORING_GetFaultDetectionCounter: RteEventRef=OIE_EventInfo_WDGM_E_MONITORING_GetFaultDetectionCounter
        RteEventToTaskMapping_OIE_EventInfo_WDGM_E_MONITORING_GetEventTested: RteEventRef=OIE_EventInfo_WDGM_E_MONITORING_GetEventTested
        RteEventToTaskMapping_OIE_EventInfo_WDGM_E_MONITORING_GetEventFreezeFrameData: RteEventRef=OIE_EventInfo_WDGM_E_MONITORING_GetEventFreezeFrameData
        RteEventToTaskMapping_OIE_EventInfo_WDGM_E_MONITORING_GetEventStatus: RteEventRef=OIE_EventInfo_WDGM_E_MONITORING_GetEventStatus
        RteEventToTaskMapping_OIE_IndStatus_DemIndicator_1_GetIndicatorStatus: RteEventRef=OIE_IndStatus_DemIndicator_1_GetIndicatorStatus
        RteEventToTaskMapping_OIE_EventInfo_NVM_E_INTEGRITY_FAILED_GetDTCOfEvent: RteEventRef=OIE_EventInfo_NVM_E_INTEGRITY_FAILED_GetDTCOfEvent
        RteEventToTaskMapping_OIE_EventInfo_NVM_E_INTEGRITY_FAILED_GetEventFailed: RteEventRef=OIE_EventInfo_NVM_E_INTEGRITY_FAILED_GetEventFailed
        RteEventToTaskMapping_OIE_EventInfo_NVM_E_INTEGRITY_FAILED_GetEventExtendedDataRecord: RteEventRef=OIE_EventInfo_NVM_E_INTEGRITY_FAILED_GetEventExtendedDataRecord
        RteEventToTaskMapping_OIE_EventInfo_NVM_E_INTEGRITY_FAILED_GetFaultDetectionCounter: RteEventRef=OIE_EventInfo_NVM_E_INTEGRITY_FAILED_GetFaultDetectionCounter
        RteEventToTaskMapping_OIE_EventInfo_NVM_E_INTEGRITY_FAILED_GetEventTested: RteEventRef=OIE_EventInfo_NVM_E_INTEGRITY_FAILED_GetEventTested
        RteEventToTaskMapping_OIE_EventInfo_NVM_E_INTEGRITY_FAILED_GetEventFreezeFrameData: RteEventRef=OIE_EventInfo_NVM_E_INTEGRITY_FAILED_GetEventFreezeFrameData
        RteEventToTaskMapping_OIE_EventInfo_NVM_E_INTEGRITY_FAILED_GetEventStatus: RteEventRef=OIE_EventInfo_NVM_E_INTEGRITY_FAILED_GetEventStatus
        RteEventToTaskMapping_OIE_Event_DEM_E_TEST_EVENT3_SetEventStatus: RteEventRef=OIE_Event_DEM_E_TEST_EVENT3_SetEventStatus
        RteEventToTaskMapping_OIE_Event_DEM_E_TEST_EVENT3_ResetEventStatus: RteEventRef=OIE_Event_DEM_E_TEST_EVENT3_ResetEventStatus
        RteEventToTaskMapping_OIE_Event_DEM_E_TEST_EVENT3_SetEventDisabled: RteEventRef=OIE_Event_DEM_E_TEST_EVENT3_SetEventDisabled
        RteEventToTaskMapping_OIE_EventInfo_EEP_E_READ_FAILED_GetDTCOfEvent: RteEventRef=OIE_EventInfo_EEP_E_READ_FAILED_GetDTCOfEvent
        RteEventToTaskMapping_OIE_EventInfo_EEP_E_READ_FAILED_GetEventFailed: RteEventRef=OIE_EventInfo_EEP_E_READ_FAILED_GetEventFailed
        RteEventToTaskMapping_OIE_EventInfo_EEP_E_READ_FAILED_GetEventExtendedDataRecord: RteEventRef=OIE_EventInfo_EEP_E_READ_FAILED_GetEventExtendedDataRecord
        RteEventToTaskMapping_OIE_EventInfo_EEP_E_READ_FAILED_GetFaultDetectionCounter: RteEventRef=OIE_EventInfo_EEP_E_READ_FAILED_GetFaultDetectionCounter
        RteEventToTaskMapping_OIE_EventInfo_EEP_E_READ_FAILED_GetEventTested: RteEventRef=OIE_EventInfo_EEP_E_READ_FAILED_GetEventTested
        RteEventToTaskMapping_OIE_EventInfo_EEP_E_READ_FAILED_GetEventFreezeFrameData: RteEventRef=OIE_EventInfo_EEP_E_READ_FAILED_GetEventFreezeFrameData
        RteEventToTaskMapping_OIE_EventInfo_EEP_E_READ_FAILED_GetEventStatus: RteEventRef=OIE_EventInfo_EEP_E_READ_FAILED_GetEventStatus
        RteEventToTaskMapping_OIE_EventInfo_MCU_E_TIMEOUT_TRANSITION_GetDTCOfEvent: RteEventRef=OIE_EventInfo_MCU_E_TIMEOUT_TRANSITION_GetDTCOfEvent
        RteEventToTaskMapping_OIE_EventInfo_MCU_E_TIMEOUT_TRANSITION_GetEventFailed: RteEventRef=OIE_EventInfo_MCU_E_TIMEOUT_TRANSITION_GetEventFailed
        RteEventToTaskMapping_OIE_EventInfo_MCU_E_TIMEOUT_TRANSITION_GetEventExtendedDataRecord: RteEventRef=OIE_EventInfo_MCU_E_TIMEOUT_TRANSITION_GetEventExtendedDataRecord
        RteEventToTaskMapping_OIE_EventInfo_MCU_E_TIMEOUT_TRANSITION_GetFaultDetectionCounter: RteEventRef=OIE_EventInfo_MCU_E_TIMEOUT_TRANSITION_GetFaultDetectionCounter
        RteEventToTaskMapping_OIE_EventInfo_MCU_E_TIMEOUT_TRANSITION_GetEventTested: RteEventRef=OIE_EventInfo_MCU_E_TIMEOUT_TRANSITION_GetEventTested
        RteEventToTaskMapping_OIE_EventInfo_MCU_E_TIMEOUT_TRANSITION_GetEventFreezeFrameData: RteEventRef=OIE_EventInfo_MCU_E_TIMEOUT_TRANSITION_GetEventFreezeFrameData
        RteEventToTaskMapping_OIE_EventInfo_MCU_E_TIMEOUT_TRANSITION_GetEventStatus: RteEventRef=OIE_EventInfo_MCU_E_TIMEOUT_TRANSITION_GetEventStatus
        RteEventToTaskMapping_OIE_EventInfo_CANSM_E_BUS_OFF_LCANFD_GetDTCOfEvent: RteEventRef=OIE_EventInfo_CANSM_E_BUS_OFF_LCANFD_GetDTCOfEvent
        RteEventToTaskMapping_OIE_EventInfo_CANSM_E_BUS_OFF_LCANFD_GetEventFailed: RteEventRef=OIE_EventInfo_CANSM_E_BUS_OFF_LCANFD_GetEventFailed
        RteEventToTaskMapping_OIE_EventInfo_CANSM_E_BUS_OFF_LCANFD_GetEventExtendedDataRecord: RteEventRef=OIE_EventInfo_CANSM_E_BUS_OFF_LCANFD_GetEventExtendedDataRecord
        RteEventToTaskMapping_OIE_EventInfo_CANSM_E_BUS_OFF_LCANFD_GetFaultDetectionCounter: RteEventRef=OIE_EventInfo_CANSM_E_BUS_OFF_LCANFD_GetFaultDetectionCounter
        RteEventToTaskMapping_OIE_EventInfo_CANSM_E_BUS_OFF_LCANFD_GetEventTested: RteEventRef=OIE_EventInfo_CANSM_E_BUS_OFF_LCANFD_GetEventTested
        RteEventToTaskMapping_OIE_EventInfo_CANSM_E_BUS_OFF_LCANFD_GetEventFreezeFrameData: RteEventRef=OIE_EventInfo_CANSM_E_BUS_OFF_LCANFD_GetEventFreezeFrameData
        RteEventToTaskMapping_OIE_EventInfo_CANSM_E_BUS_OFF_LCANFD_GetEventStatus: RteEventRef=OIE_EventInfo_CANSM_E_BUS_OFF_LCANFD_GetEventStatus
        RteEventToTaskMapping_OIE_EventInfo_CANSM_E_BUS_OFF_Reserved_GetDTCOfEvent: RteEventRef=OIE_EventInfo_CANSM_E_BUS_OFF_Reserved_GetDTCOfEvent
        RteEventToTaskMapping_OIE_EventInfo_CANSM_E_BUS_OFF_Reserved_GetEventFailed: RteEventRef=OIE_EventInfo_CANSM_E_BUS_OFF_Reserved_GetEventFailed
        RteEventToTaskMapping_OIE_EventInfo_CANSM_E_BUS_OFF_Reserved_GetEventExtendedDataRecord: RteEventRef=OIE_EventInfo_CANSM_E_BUS_OFF_Reserved_GetEventExtendedDataRecord
        RteEventToTaskMapping_OIE_EventInfo_CANSM_E_BUS_OFF_Reserved_GetFaultDetectionCounter: RteEventRef=OIE_EventInfo_CANSM_E_BUS_OFF_Reserved_GetFaultDetectionCounter
        RteEventToTaskMapping_OIE_EventInfo_CANSM_E_BUS_OFF_Reserved_GetEventTested: RteEventRef=OIE_EventInfo_CANSM_E_BUS_OFF_Reserved_GetEventTested
        RteEventToTaskMapping_OIE_EventInfo_CANSM_E_BUS_OFF_Reserved_GetEventFreezeFrameData: RteEventRef=OIE_EventInfo_CANSM_E_BUS_OFF_Reserved_GetEventFreezeFrameData
        RteEventToTaskMapping_OIE_EventInfo_CANSM_E_BUS_OFF_Reserved_GetEventStatus: RteEventRef=OIE_EventInfo_CANSM_E_BUS_OFF_Reserved_GetEventStatus
        RteEventToTaskMapping_OIE_EventInfo_CANSM_E_BUS_OFF_CCANFD_GetDTCOfEvent: RteEventRef=OIE_EventInfo_CANSM_E_BUS_OFF_CCANFD_GetDTCOfEvent
        RteEventToTaskMapping_OIE_EventInfo_CANSM_E_BUS_OFF_CCANFD_GetEventFailed: RteEventRef=OIE_EventInfo_CANSM_E_BUS_OFF_CCANFD_GetEventFailed
        RteEventToTaskMapping_OIE_EventInfo_CANSM_E_BUS_OFF_CCANFD_GetEventExtendedDataRecord: RteEventRef=OIE_EventInfo_CANSM_E_BUS_OFF_CCANFD_GetEventExtendedDataRecord
        RteEventToTaskMapping_OIE_EventInfo_CANSM_E_BUS_OFF_CCANFD_GetFaultDetectionCounter: RteEventRef=OIE_EventInfo_CANSM_E_BUS_OFF_CCANFD_GetFaultDetectionCounter
        RteEventToTaskMapping_OIE_EventInfo_CANSM_E_BUS_OFF_CCANFD_GetEventTested: RteEventRef=OIE_EventInfo_CANSM_E_BUS_OFF_CCANFD_GetEventTested
        RteEventToTaskMapping_OIE_EventInfo_CANSM_E_BUS_OFF_CCANFD_GetEventFreezeFrameData: RteEventRef=OIE_EventInfo_CANSM_E_BUS_OFF_CCANFD_GetEventFreezeFrameData
        RteEventToTaskMapping_OIE_EventInfo_CANSM_E_BUS_OFF_CCANFD_GetEventStatus: RteEventRef=OIE_EventInfo_CANSM_E_BUS_OFF_CCANFD_GetEventStatus
        RteEventToTaskMapping_OIE_EventInfo_CANSM_E_BUS_OFF_zDEBUGCAN_GetDTCOfEvent: RteEventRef=OIE_EventInfo_CANSM_E_BUS_OFF_zDEBUGCAN_GetDTCOfEvent
        RteEventToTaskMapping_OIE_EventInfo_CANSM_E_BUS_OFF_zDEBUGCAN_GetEventFailed: RteEventRef=OIE_EventInfo_CANSM_E_BUS_OFF_zDEBUGCAN_GetEventFailed
        RteEventToTaskMapping_OIE_EventInfo_CANSM_E_BUS_OFF_zDEBUGCAN_GetEventExtendedDataRecord: RteEventRef=OIE_EventInfo_CANSM_E_BUS_OFF_zDEBUGCAN_GetEventExtendedDataRecord
        RteEventToTaskMapping_OIE_EventInfo_CANSM_E_BUS_OFF_zDEBUGCAN_GetFaultDetectionCounter: RteEventRef=OIE_EventInfo_CANSM_E_BUS_OFF_zDEBUGCAN_GetFaultDetectionCounter
        RteEventToTaskMapping_OIE_EventInfo_CANSM_E_BUS_OFF_zDEBUGCAN_GetEventTested: RteEventRef=OIE_EventInfo_CANSM_E_BUS_OFF_zDEBUGCAN_GetEventTested
        RteEventToTaskMapping_OIE_EventInfo_CANSM_E_BUS_OFF_zDEBUGCAN_GetEventFreezeFrameData: RteEventRef=OIE_EventInfo_CANSM_E_BUS_OFF_zDEBUGCAN_GetEventFreezeFrameData
        RteEventToTaskMapping_OIE_EventInfo_CANSM_E_BUS_OFF_zDEBUGCAN_GetEventStatus: RteEventRef=OIE_EventInfo_CANSM_E_BUS_OFF_zDEBUGCAN_GetEventStatus
        RteEventToTaskMapping_OIE_EventInfo_Dem_FEE_WRITE_ERROR_GetDTCOfEvent: RteEventRef=OIE_EventInfo_Dem_FEE_WRITE_ERROR_GetDTCOfEvent
        RteEventToTaskMapping_OIE_EventInfo_Dem_FEE_WRITE_ERROR_GetEventFailed: RteEventRef=OIE_EventInfo_Dem_FEE_WRITE_ERROR_GetEventFailed
        RteEventToTaskMapping_OIE_EventInfo_Dem_FEE_WRITE_ERROR_GetEventExtendedDataRecord: RteEventRef=OIE_EventInfo_Dem_FEE_WRITE_ERROR_GetEventExtendedDataRecord
        RteEventToTaskMapping_OIE_EventInfo_Dem_FEE_WRITE_ERROR_GetFaultDetectionCounter: RteEventRef=OIE_EventInfo_Dem_FEE_WRITE_ERROR_GetFaultDetectionCounter
        RteEventToTaskMapping_OIE_EventInfo_Dem_FEE_WRITE_ERROR_GetEventTested: RteEventRef=OIE_EventInfo_Dem_FEE_WRITE_ERROR_GetEventTested
        RteEventToTaskMapping_OIE_EventInfo_Dem_FEE_WRITE_ERROR_GetEventFreezeFrameData: RteEventRef=OIE_EventInfo_Dem_FEE_WRITE_ERROR_GetEventFreezeFrameData
        RteEventToTaskMapping_OIE_EventInfo_Dem_FEE_WRITE_ERROR_GetEventStatus: RteEventRef=OIE_EventInfo_Dem_FEE_WRITE_ERROR_GetEventStatus
        RteEventToTaskMapping_OIE_GeneralEvtInfo_GetEventStatus: RteEventRef=OIE_GeneralEvtInfo_GetEventStatus
        RteEventToTaskMapping_OIE_GeneralEvtInfo_GetEventFreezeFrameData: RteEventRef=OIE_GeneralEvtInfo_GetEventFreezeFrameData
        RteEventToTaskMapping_OIE_GeneralEvtInfo_GetEventTested: RteEventRef=OIE_GeneralEvtInfo_GetEventTested
        RteEventToTaskMapping_OIE_GeneralEvtInfo_GetFaultDetectionCounter: RteEventRef=OIE_GeneralEvtInfo_GetFaultDetectionCounter
        RteEventToTaskMapping_OIE_GeneralEvtInfo_GetEventExtendedDataRecord: RteEventRef=OIE_GeneralEvtInfo_GetEventExtendedDataRecord
        RteEventToTaskMapping_OIE_GeneralEvtInfo_GetEventFailed: RteEventRef=OIE_GeneralEvtInfo_GetEventFailed
        RteEventToTaskMapping_OIE_GeneralEvtInfo_GetDTCOfEvent: RteEventRef=OIE_GeneralEvtInfo_GetDTCOfEvent
        RteEventToTaskMapping_OIE_EventInfo_ECUM_E_RAM_CHECK_FAILED_GetDTCOfEvent: RteEventRef=OIE_EventInfo_ECUM_E_RAM_CHECK_FAILED_GetDTCOfEvent
        RteEventToTaskMapping_OIE_EventInfo_ECUM_E_RAM_CHECK_FAILED_GetEventFailed: RteEventRef=OIE_EventInfo_ECUM_E_RAM_CHECK_FAILED_GetEventFailed
        RteEventToTaskMapping_OIE_EventInfo_ECUM_E_RAM_CHECK_FAILED_GetEventExtendedDataRecord: RteEventRef=OIE_EventInfo_ECUM_E_RAM_CHECK_FAILED_GetEventExtendedDataRecord
        RteEventToTaskMapping_OIE_EventInfo_ECUM_E_RAM_CHECK_FAILED_GetFaultDetectionCounter: RteEventRef=OIE_EventInfo_ECUM_E_RAM_CHECK_FAILED_GetFaultDetectionCounter
        RteEventToTaskMapping_OIE_EventInfo_ECUM_E_RAM_CHECK_FAILED_GetEventTested: RteEventRef=OIE_EventInfo_ECUM_E_RAM_CHECK_FAILED_GetEventTested
        RteEventToTaskMapping_OIE_EventInfo_ECUM_E_RAM_CHECK_FAILED_GetEventFreezeFrameData: RteEventRef=OIE_EventInfo_ECUM_E_RAM_CHECK_FAILED_GetEventFreezeFrameData
        RteEventToTaskMapping_OIE_EventInfo_ECUM_E_RAM_CHECK_FAILED_GetEventStatus: RteEventRef=OIE_EventInfo_ECUM_E_RAM_CHECK_FAILED_GetEventStatus
        RteEventToTaskMapping_OIE_EventInfo_Dem_FEE_READ_ERROR_GetDTCOfEvent: RteEventRef=OIE_EventInfo_Dem_FEE_READ_ERROR_GetDTCOfEvent
        RteEventToTaskMapping_OIE_EventInfo_Dem_FEE_READ_ERROR_GetEventFailed: RteEventRef=OIE_EventInfo_Dem_FEE_READ_ERROR_GetEventFailed
        RteEventToTaskMapping_OIE_EventInfo_Dem_FEE_READ_ERROR_GetEventExtendedDataRecord: RteEventRef=OIE_EventInfo_Dem_FEE_READ_ERROR_GetEventExtendedDataRecord
        RteEventToTaskMapping_OIE_EventInfo_Dem_FEE_READ_ERROR_GetFaultDetectionCounter: RteEventRef=OIE_EventInfo_Dem_FEE_READ_ERROR_GetFaultDetectionCounter
        RteEventToTaskMapping_OIE_EventInfo_Dem_FEE_READ_ERROR_GetEventTested: RteEventRef=OIE_EventInfo_Dem_FEE_READ_ERROR_GetEventTested
        RteEventToTaskMapping_OIE_EventInfo_Dem_FEE_READ_ERROR_GetEventFreezeFrameData: RteEventRef=OIE_EventInfo_Dem_FEE_READ_ERROR_GetEventFreezeFrameData
        RteEventToTaskMapping_OIE_EventInfo_Dem_FEE_READ_ERROR_GetEventStatus: RteEventRef=OIE_EventInfo_Dem_FEE_READ_ERROR_GetEventStatus
        RteEventToTaskMapping_OIE_EventInfo_WDG_76_ACW_E_MODE_FAILED_GetDTCOfEvent: RteEventRef=OIE_EventInfo_WDG_76_ACW_E_MODE_FAILED_GetDTCOfEvent
        RteEventToTaskMapping_OIE_EventInfo_WDG_76_ACW_E_MODE_FAILED_GetEventFailed: RteEventRef=OIE_EventInfo_WDG_76_ACW_E_MODE_FAILED_GetEventFailed
        RteEventToTaskMapping_OIE_EventInfo_WDG_76_ACW_E_MODE_FAILED_GetEventExtendedDataRecord: RteEventRef=OIE_EventInfo_WDG_76_ACW_E_MODE_FAILED_GetEventExtendedDataRecord
        RteEventToTaskMapping_OIE_EventInfo_WDG_76_ACW_E_MODE_FAILED_GetFaultDetectionCounter: RteEventRef=OIE_EventInfo_WDG_76_ACW_E_MODE_FAILED_GetFaultDetectionCounter
        RteEventToTaskMapping_OIE_EventInfo_WDG_76_ACW_E_MODE_FAILED_GetEventTested: RteEventRef=OIE_EventInfo_WDG_76_ACW_E_MODE_FAILED_GetEventTested
        RteEventToTaskMapping_OIE_EventInfo_WDG_76_ACW_E_MODE_FAILED_GetEventFreezeFrameData: RteEventRef=OIE_EventInfo_WDG_76_ACW_E_MODE_FAILED_GetEventFreezeFrameData
        RteEventToTaskMapping_OIE_EventInfo_WDG_76_ACW_E_MODE_FAILED_GetEventStatus: RteEventRef=OIE_EventInfo_WDG_76_ACW_E_MODE_FAILED_GetEventStatus
        RteEventToTaskMapping_OIE_EventInfo_NVM_E_LOSS_OF_REDUNDANCY_GetDTCOfEvent: RteEventRef=OIE_EventInfo_NVM_E_LOSS_OF_REDUNDANCY_GetDTCOfEvent
        RteEventToTaskMapping_OIE_EventInfo_NVM_E_LOSS_OF_REDUNDANCY_GetEventFailed: RteEventRef=OIE_EventInfo_NVM_E_LOSS_OF_REDUNDANCY_GetEventFailed
        RteEventToTaskMapping_OIE_EventInfo_NVM_E_LOSS_OF_REDUNDANCY_GetEventExtendedDataRecord: RteEventRef=OIE_EventInfo_NVM_E_LOSS_OF_REDUNDANCY_GetEventExtendedDataRecord
        RteEventToTaskMapping_OIE_EventInfo_NVM_E_LOSS_OF_REDUNDANCY_GetFaultDetectionCounter: RteEventRef=OIE_EventInfo_NVM_E_LOSS_OF_REDUNDANCY_GetFaultDetectionCounter
        RteEventToTaskMapping_OIE_EventInfo_NVM_E_LOSS_OF_REDUNDANCY_GetEventTested: RteEventRef=OIE_EventInfo_NVM_E_LOSS_OF_REDUNDANCY_GetEventTested
        RteEventToTaskMapping_OIE_EventInfo_NVM_E_LOSS_OF_REDUNDANCY_GetEventFreezeFrameData: RteEventRef=OIE_EventInfo_NVM_E_LOSS_OF_REDUNDANCY_GetEventFreezeFrameData
        RteEventToTaskMapping_OIE_EventInfo_NVM_E_LOSS_OF_REDUNDANCY_GetEventStatus: RteEventRef=OIE_EventInfo_NVM_E_LOSS_OF_REDUNDANCY_GetEventStatus
        RteEventToTaskMapping_OIE_EventInfo_Dem_FLS_WRITE_ERROR_GetDTCOfEvent: RteEventRef=OIE_EventInfo_Dem_FLS_WRITE_ERROR_GetDTCOfEvent
        RteEventToTaskMapping_OIE_EventInfo_Dem_FLS_WRITE_ERROR_GetEventFailed: RteEventRef=OIE_EventInfo_Dem_FLS_WRITE_ERROR_GetEventFailed
        RteEventToTaskMapping_OIE_EventInfo_Dem_FLS_WRITE_ERROR_GetEventExtendedDataRecord: RteEventRef=OIE_EventInfo_Dem_FLS_WRITE_ERROR_GetEventExtendedDataRecord
        RteEventToTaskMapping_OIE_EventInfo_Dem_FLS_WRITE_ERROR_GetFaultDetectionCounter: RteEventRef=OIE_EventInfo_Dem_FLS_WRITE_ERROR_GetFaultDetectionCounter
        RteEventToTaskMapping_OIE_EventInfo_Dem_FLS_WRITE_ERROR_GetEventTested: RteEventRef=OIE_EventInfo_Dem_FLS_WRITE_ERROR_GetEventTested
        RteEventToTaskMapping_OIE_EventInfo_Dem_FLS_WRITE_ERROR_GetEventFreezeFrameData: RteEventRef=OIE_EventInfo_Dem_FLS_WRITE_ERROR_GetEventFreezeFrameData
        RteEventToTaskMapping_OIE_EventInfo_Dem_FLS_WRITE_ERROR_GetEventStatus: RteEventRef=OIE_EventInfo_Dem_FLS_WRITE_ERROR_GetEventStatus
        RteEventToTaskMapping_OIE_Event_DEM_E_TEST_EVENT2_SetEventStatus: RteEventRef=OIE_Event_DEM_E_TEST_EVENT2_SetEventStatus
        RteEventToTaskMapping_OIE_Event_DEM_E_TEST_EVENT2_ResetEventStatus: RteEventRef=OIE_Event_DEM_E_TEST_EVENT2_ResetEventStatus
        RteEventToTaskMapping_OIE_Event_DEM_E_TEST_EVENT2_SetEventDisabled: RteEventRef=OIE_Event_DEM_E_TEST_EVENT2_SetEventDisabled
        RteEventToTaskMapping_OIE_EventInfo_Dem_FEE_UNCONFIG_BLK_EXCEEDED_ERROR_GetDTCOfEvent: RteEventRef=OIE_EventInfo_Dem_FEE_UNCONFIG_BLK_EXCEEDED_ERROR_GetDTCOfEvent
        RteEventToTaskMapping_OIE_EventInfo_Dem_FEE_UNCONFIG_BLK_EXCEEDED_ERROR_GetEventFailed: RteEventRef=OIE_EventInfo_Dem_FEE_UNCONFIG_BLK_EXCEEDED_ERROR_GetEventFailed
        RteEventToTaskMapping_OIE_EventInfo_Dem_FEE_UNCONFIG_BLK_EXCEEDED_ERROR_GetEventExtendedDataRecord: RteEventRef=OIE_EventInfo_Dem_FEE_UNCONFIG_BLK_EXCEEDED_ERROR_GetEventExtendedDataRecord
        RteEventToTaskMapping_OIE_EventInfo_Dem_FEE_UNCONFIG_BLK_EXCEEDED_ERROR_GetFaultDetectionCounter: RteEventRef=OIE_EventInfo_Dem_FEE_UNCONFIG_BLK_EXCEEDED_ERROR_GetFaultDetectionCounter
        RteEventToTaskMapping_OIE_EventInfo_Dem_FEE_UNCONFIG_BLK_EXCEEDED_ERROR_GetEventTested: RteEventRef=OIE_EventInfo_Dem_FEE_UNCONFIG_BLK_EXCEEDED_ERROR_GetEventTested
        RteEventToTaskMapping_OIE_EventInfo_Dem_FEE_UNCONFIG_BLK_EXCEEDED_ERROR_GetEventFreezeFrameData: RteEventRef=OIE_EventInfo_Dem_FEE_UNCONFIG_BLK_EXCEEDED_ERROR_GetEventFreezeFrameData
        RteEventToTaskMapping_OIE_EventInfo_Dem_FEE_UNCONFIG_BLK_EXCEEDED_ERROR_GetEventStatus: RteEventRef=OIE_EventInfo_Dem_FEE_UNCONFIG_BLK_EXCEEDED_ERROR_GetEventStatus
        RteEventToTaskMapping_OIE_EventInfo_DEM_E_TEST_EVENT6_GetDTCOfEvent: RteEventRef=OIE_EventInfo_DEM_E_TEST_EVENT6_GetDTCOfEvent
        RteEventToTaskMapping_OIE_EventInfo_DEM_E_TEST_EVENT6_GetEventFailed: RteEventRef=OIE_EventInfo_DEM_E_TEST_EVENT6_GetEventFailed
        RteEventToTaskMapping_OIE_EventInfo_DEM_E_TEST_EVENT6_GetEventExtendedDataRecord: RteEventRef=OIE_EventInfo_DEM_E_TEST_EVENT6_GetEventExtendedDataRecord
        RteEventToTaskMapping_OIE_EventInfo_DEM_E_TEST_EVENT6_GetFaultDetectionCounter: RteEventRef=OIE_EventInfo_DEM_E_TEST_EVENT6_GetFaultDetectionCounter
        RteEventToTaskMapping_OIE_EventInfo_DEM_E_TEST_EVENT6_GetEventTested: RteEventRef=OIE_EventInfo_DEM_E_TEST_EVENT6_GetEventTested
        RteEventToTaskMapping_OIE_EventInfo_DEM_E_TEST_EVENT6_GetEventFreezeFrameData: RteEventRef=OIE_EventInfo_DEM_E_TEST_EVENT6_GetEventFreezeFrameData
        RteEventToTaskMapping_OIE_EventInfo_DEM_E_TEST_EVENT6_GetEventStatus: RteEventRef=OIE_EventInfo_DEM_E_TEST_EVENT6_GetEventStatus
        RteEventToTaskMapping_OIE_EventInfo_LIN_E_TIMEOUT_GetDTCOfEvent: RteEventRef=OIE_EventInfo_LIN_E_TIMEOUT_GetDTCOfEvent
        RteEventToTaskMapping_OIE_EventInfo_LIN_E_TIMEOUT_GetEventFailed: RteEventRef=OIE_EventInfo_LIN_E_TIMEOUT_GetEventFailed
        RteEventToTaskMapping_OIE_EventInfo_LIN_E_TIMEOUT_GetEventExtendedDataRecord: RteEventRef=OIE_EventInfo_LIN_E_TIMEOUT_GetEventExtendedDataRecord
        RteEventToTaskMapping_OIE_EventInfo_LIN_E_TIMEOUT_GetFaultDetectionCounter: RteEventRef=OIE_EventInfo_LIN_E_TIMEOUT_GetFaultDetectionCounter
        RteEventToTaskMapping_OIE_EventInfo_LIN_E_TIMEOUT_GetEventTested: RteEventRef=OIE_EventInfo_LIN_E_TIMEOUT_GetEventTested
        RteEventToTaskMapping_OIE_EventInfo_LIN_E_TIMEOUT_GetEventFreezeFrameData: RteEventRef=OIE_EventInfo_LIN_E_TIMEOUT_GetEventFreezeFrameData
        RteEventToTaskMapping_OIE_EventInfo_LIN_E_TIMEOUT_GetEventStatus: RteEventRef=OIE_EventInfo_LIN_E_TIMEOUT_GetEventStatus
        RteEventToTaskMapping_OIE_EventInfo_FR_E_ACCESS_GetDTCOfEvent: RteEventRef=OIE_EventInfo_FR_E_ACCESS_GetDTCOfEvent
        RteEventToTaskMapping_OIE_EventInfo_FR_E_ACCESS_GetEventFailed: RteEventRef=OIE_EventInfo_FR_E_ACCESS_GetEventFailed
        RteEventToTaskMapping_OIE_EventInfo_FR_E_ACCESS_GetEventExtendedDataRecord: RteEventRef=OIE_EventInfo_FR_E_ACCESS_GetEventExtendedDataRecord
        RteEventToTaskMapping_OIE_EventInfo_FR_E_ACCESS_GetFaultDetectionCounter: RteEventRef=OIE_EventInfo_FR_E_ACCESS_GetFaultDetectionCounter
        RteEventToTaskMapping_OIE_EventInfo_FR_E_ACCESS_GetEventTested: RteEventRef=OIE_EventInfo_FR_E_ACCESS_GetEventTested
        RteEventToTaskMapping_OIE_EventInfo_FR_E_ACCESS_GetEventFreezeFrameData: RteEventRef=OIE_EventInfo_FR_E_ACCESS_GetEventFreezeFrameData
        RteEventToTaskMapping_OIE_EventInfo_FR_E_ACCESS_GetEventStatus: RteEventRef=OIE_EventInfo_FR_E_ACCESS_GetEventStatus
        RteEventToTaskMapping_OIE_EventInfo_Dem_FEE_GC_TRIG_ERROR_GetDTCOfEvent: RteEventRef=OIE_EventInfo_Dem_FEE_GC_TRIG_ERROR_GetDTCOfEvent
        RteEventToTaskMapping_OIE_EventInfo_Dem_FEE_GC_TRIG_ERROR_GetEventFailed: RteEventRef=OIE_EventInfo_Dem_FEE_GC_TRIG_ERROR_GetEventFailed
        RteEventToTaskMapping_OIE_EventInfo_Dem_FEE_GC_TRIG_ERROR_GetEventExtendedDataRecord: RteEventRef=OIE_EventInfo_Dem_FEE_GC_TRIG_ERROR_GetEventExtendedDataRecord
        RteEventToTaskMapping_OIE_EventInfo_Dem_FEE_GC_TRIG_ERROR_GetFaultDetectionCounter: RteEventRef=OIE_EventInfo_Dem_FEE_GC_TRIG_ERROR_GetFaultDetectionCounter
        RteEventToTaskMapping_OIE_EventInfo_Dem_FEE_GC_TRIG_ERROR_GetEventTested: RteEventRef=OIE_EventInfo_Dem_FEE_GC_TRIG_ERROR_GetEventTested
        RteEventToTaskMapping_OIE_EventInfo_Dem_FEE_GC_TRIG_ERROR_GetEventFreezeFrameData: RteEventRef=OIE_EventInfo_Dem_FEE_GC_TRIG_ERROR_GetEventFreezeFrameData
        RteEventToTaskMapping_OIE_EventInfo_Dem_FEE_GC_TRIG_ERROR_GetEventStatus: RteEventRef=OIE_EventInfo_Dem_FEE_GC_TRIG_ERROR_GetEventStatus
        RteEventToTaskMapping_OIE_EventInfo_ETH_E_ACCESS_GetDTCOfEvent: RteEventRef=OIE_EventInfo_ETH_E_ACCESS_GetDTCOfEvent
        RteEventToTaskMapping_OIE_EventInfo_ETH_E_ACCESS_GetEventFailed: RteEventRef=OIE_EventInfo_ETH_E_ACCESS_GetEventFailed
        RteEventToTaskMapping_OIE_EventInfo_ETH_E_ACCESS_GetEventExtendedDataRecord: RteEventRef=OIE_EventInfo_ETH_E_ACCESS_GetEventExtendedDataRecord
        RteEventToTaskMapping_OIE_EventInfo_ETH_E_ACCESS_GetFaultDetectionCounter: RteEventRef=OIE_EventInfo_ETH_E_ACCESS_GetFaultDetectionCounter
        RteEventToTaskMapping_OIE_EventInfo_ETH_E_ACCESS_GetEventTested: RteEventRef=OIE_EventInfo_ETH_E_ACCESS_GetEventTested
        RteEventToTaskMapping_OIE_EventInfo_ETH_E_ACCESS_GetEventFreezeFrameData: RteEventRef=OIE_EventInfo_ETH_E_ACCESS_GetEventFreezeFrameData
        RteEventToTaskMapping_OIE_EventInfo_ETH_E_ACCESS_GetEventStatus: RteEventRef=OIE_EventInfo_ETH_E_ACCESS_GetEventStatus
        RteEventToTaskMapping_OIE_EventInfo_DEM_E_TEST_EVENT4_GetDTCOfEvent: RteEventRef=OIE_EventInfo_DEM_E_TEST_EVENT4_GetDTCOfEvent
        RteEventToTaskMapping_OIE_EventInfo_DEM_E_TEST_EVENT4_GetEventFailed: RteEventRef=OIE_EventInfo_DEM_E_TEST_EVENT4_GetEventFailed
        RteEventToTaskMapping_OIE_EventInfo_DEM_E_TEST_EVENT4_GetEventExtendedDataRecord: RteEventRef=OIE_EventInfo_DEM_E_TEST_EVENT4_GetEventExtendedDataRecord
        RteEventToTaskMapping_OIE_EventInfo_DEM_E_TEST_EVENT4_GetFaultDetectionCounter: RteEventRef=OIE_EventInfo_DEM_E_TEST_EVENT4_GetFaultDetectionCounter
        RteEventToTaskMapping_OIE_EventInfo_DEM_E_TEST_EVENT4_GetEventTested: RteEventRef=OIE_EventInfo_DEM_E_TEST_EVENT4_GetEventTested
        RteEventToTaskMapping_OIE_EventInfo_DEM_E_TEST_EVENT4_GetEventFreezeFrameData: RteEventRef=OIE_EventInfo_DEM_E_TEST_EVENT4_GetEventFreezeFrameData
        RteEventToTaskMapping_OIE_EventInfo_DEM_E_TEST_EVENT4_GetEventStatus: RteEventRef=OIE_EventInfo_DEM_E_TEST_EVENT4_GetEventStatus
        RteEventToTaskMapping_OIE_EventInfo_Dem_FEE_GC_ERASE_ERROR_GetDTCOfEvent: RteEventRef=OIE_EventInfo_Dem_FEE_GC_ERASE_ERROR_GetDTCOfEvent
        RteEventToTaskMapping_OIE_EventInfo_Dem_FEE_GC_ERASE_ERROR_GetEventFailed: RteEventRef=OIE_EventInfo_Dem_FEE_GC_ERASE_ERROR_GetEventFailed
        RteEventToTaskMapping_OIE_EventInfo_Dem_FEE_GC_ERASE_ERROR_GetEventExtendedDataRecord: RteEventRef=OIE_EventInfo_Dem_FEE_GC_ERASE_ERROR_GetEventExtendedDataRecord
        RteEventToTaskMapping_OIE_EventInfo_Dem_FEE_GC_ERASE_ERROR_GetFaultDetectionCounter: RteEventRef=OIE_EventInfo_Dem_FEE_GC_ERASE_ERROR_GetFaultDetectionCounter
        RteEventToTaskMapping_OIE_EventInfo_Dem_FEE_GC_ERASE_ERROR_GetEventTested: RteEventRef=OIE_EventInfo_Dem_FEE_GC_ERASE_ERROR_GetEventTested
        RteEventToTaskMapping_OIE_EventInfo_Dem_FEE_GC_ERASE_ERROR_GetEventFreezeFrameData: RteEventRef=OIE_EventInfo_Dem_FEE_GC_ERASE_ERROR_GetEventFreezeFrameData
        RteEventToTaskMapping_OIE_EventInfo_Dem_FEE_GC_ERASE_ERROR_GetEventStatus: RteEventRef=OIE_EventInfo_Dem_FEE_GC_ERASE_ERROR_GetEventStatus
        RteEventToTaskMapping_OIE_EventInfo_WDG_E_MODE_FAILED_GetDTCOfEvent: RteEventRef=OIE_EventInfo_WDG_E_MODE_FAILED_GetDTCOfEvent
        RteEventToTaskMapping_OIE_EventInfo_WDG_E_MODE_FAILED_GetEventFailed: RteEventRef=OIE_EventInfo_WDG_E_MODE_FAILED_GetEventFailed
        RteEventToTaskMapping_OIE_EventInfo_WDG_E_MODE_FAILED_GetEventExtendedDataRecord: RteEventRef=OIE_EventInfo_WDG_E_MODE_FAILED_GetEventExtendedDataRecord
        RteEventToTaskMapping_OIE_EventInfo_WDG_E_MODE_FAILED_GetFaultDetectionCounter: RteEventRef=OIE_EventInfo_WDG_E_MODE_FAILED_GetFaultDetectionCounter
        RteEventToTaskMapping_OIE_EventInfo_WDG_E_MODE_FAILED_GetEventTested: RteEventRef=OIE_EventInfo_WDG_E_MODE_FAILED_GetEventTested
        RteEventToTaskMapping_OIE_EventInfo_WDG_E_MODE_FAILED_GetEventFreezeFrameData: RteEventRef=OIE_EventInfo_WDG_E_MODE_FAILED_GetEventFreezeFrameData
        RteEventToTaskMapping_OIE_EventInfo_WDG_E_MODE_FAILED_GetEventStatus: RteEventRef=OIE_EventInfo_WDG_E_MODE_FAILED_GetEventStatus
        RteEventToTaskMapping_OIE_EventInfo_Dem_FLS_COMPARE_ERROR_GetDTCOfEvent: RteEventRef=OIE_EventInfo_Dem_FLS_COMPARE_ERROR_GetDTCOfEvent
        RteEventToTaskMapping_OIE_EventInfo_Dem_FLS_COMPARE_ERROR_GetEventFailed: RteEventRef=OIE_EventInfo_Dem_FLS_COMPARE_ERROR_GetEventFailed
        RteEventToTaskMapping_OIE_EventInfo_Dem_FLS_COMPARE_ERROR_GetEventExtendedDataRecord: RteEventRef=OIE_EventInfo_Dem_FLS_COMPARE_ERROR_GetEventExtendedDataRecord
        RteEventToTaskMapping_OIE_EventInfo_Dem_FLS_COMPARE_ERROR_GetFaultDetectionCounter: RteEventRef=OIE_EventInfo_Dem_FLS_COMPARE_ERROR_GetFaultDetectionCounter
        RteEventToTaskMapping_OIE_EventInfo_Dem_FLS_COMPARE_ERROR_GetEventTested: RteEventRef=OIE_EventInfo_Dem_FLS_COMPARE_ERROR_GetEventTested
        RteEventToTaskMapping_OIE_EventInfo_Dem_FLS_COMPARE_ERROR_GetEventFreezeFrameData: RteEventRef=OIE_EventInfo_Dem_FLS_COMPARE_ERROR_GetEventFreezeFrameData
        RteEventToTaskMapping_OIE_EventInfo_Dem_FLS_COMPARE_ERROR_GetEventStatus: RteEventRef=OIE_EventInfo_Dem_FLS_COMPARE_ERROR_GetEventStatus
        RteEventToTaskMapping_OIE_IndStatus_DemIndicator_0_GetIndicatorStatus: RteEventRef=OIE_IndStatus_DemIndicator_0_GetIndicatorStatus
        RteEventToTaskMapping_OIE_EventInfo_Dem_FEE_GC_READ_ERROR_GetDTCOfEvent: RteEventRef=OIE_EventInfo_Dem_FEE_GC_READ_ERROR_GetDTCOfEvent
        RteEventToTaskMapping_OIE_EventInfo_Dem_FEE_GC_READ_ERROR_GetEventFailed: RteEventRef=OIE_EventInfo_Dem_FEE_GC_READ_ERROR_GetEventFailed
        RteEventToTaskMapping_OIE_EventInfo_Dem_FEE_GC_READ_ERROR_GetEventExtendedDataRecord: RteEventRef=OIE_EventInfo_Dem_FEE_GC_READ_ERROR_GetEventExtendedDataRecord
        RteEventToTaskMapping_OIE_EventInfo_Dem_FEE_GC_READ_ERROR_GetFaultDetectionCounter: RteEventRef=OIE_EventInfo_Dem_FEE_GC_READ_ERROR_GetFaultDetectionCounter
        RteEventToTaskMapping_OIE_EventInfo_Dem_FEE_GC_READ_ERROR_GetEventTested: RteEventRef=OIE_EventInfo_Dem_FEE_GC_READ_ERROR_GetEventTested
        RteEventToTaskMapping_OIE_EventInfo_Dem_FEE_GC_READ_ERROR_GetEventFreezeFrameData: RteEventRef=OIE_EventInfo_Dem_FEE_GC_READ_ERROR_GetEventFreezeFrameData
        RteEventToTaskMapping_OIE_EventInfo_Dem_FEE_GC_READ_ERROR_GetEventStatus: RteEventRef=OIE_EventInfo_Dem_FEE_GC_READ_ERROR_GetEventStatus
        RteEventToTaskMapping_OIE_EventInfo_FLS_E_ERASE_FAILED_GetDTCOfEvent: RteEventRef=OIE_EventInfo_FLS_E_ERASE_FAILED_GetDTCOfEvent
        RteEventToTaskMapping_OIE_EventInfo_FLS_E_ERASE_FAILED_GetEventFailed: RteEventRef=OIE_EventInfo_FLS_E_ERASE_FAILED_GetEventFailed
        RteEventToTaskMapping_OIE_EventInfo_FLS_E_ERASE_FAILED_GetEventExtendedDataRecord: RteEventRef=OIE_EventInfo_FLS_E_ERASE_FAILED_GetEventExtendedDataRecord
        RteEventToTaskMapping_OIE_EventInfo_FLS_E_ERASE_FAILED_GetFaultDetectionCounter: RteEventRef=OIE_EventInfo_FLS_E_ERASE_FAILED_GetFaultDetectionCounter
        RteEventToTaskMapping_OIE_EventInfo_FLS_E_ERASE_FAILED_GetEventTested: RteEventRef=OIE_EventInfo_FLS_E_ERASE_FAILED_GetEventTested
        RteEventToTaskMapping_OIE_EventInfo_FLS_E_ERASE_FAILED_GetEventFreezeFrameData: RteEventRef=OIE_EventInfo_FLS_E_ERASE_FAILED_GetEventFreezeFrameData
        RteEventToTaskMapping_OIE_EventInfo_FLS_E_ERASE_FAILED_GetEventStatus: RteEventRef=OIE_EventInfo_FLS_E_ERASE_FAILED_GetEventStatus
        RteEventToTaskMapping_OIE_EventInfo_IOHWAB_E_WRONG_PARAM_GetDTCOfEvent: RteEventRef=OIE_EventInfo_IOHWAB_E_WRONG_PARAM_GetDTCOfEvent
        RteEventToTaskMapping_OIE_EventInfo_IOHWAB_E_WRONG_PARAM_GetEventFailed: RteEventRef=OIE_EventInfo_IOHWAB_E_WRONG_PARAM_GetEventFailed
        RteEventToTaskMapping_OIE_EventInfo_IOHWAB_E_WRONG_PARAM_GetEventExtendedDataRecord: RteEventRef=OIE_EventInfo_IOHWAB_E_WRONG_PARAM_GetEventExtendedDataRecord
        RteEventToTaskMapping_OIE_EventInfo_IOHWAB_E_WRONG_PARAM_GetFaultDetectionCounter: RteEventRef=OIE_EventInfo_IOHWAB_E_WRONG_PARAM_GetFaultDetectionCounter
        RteEventToTaskMapping_OIE_EventInfo_IOHWAB_E_WRONG_PARAM_GetEventTested: RteEventRef=OIE_EventInfo_IOHWAB_E_WRONG_PARAM_GetEventTested
        RteEventToTaskMapping_OIE_EventInfo_IOHWAB_E_WRONG_PARAM_GetEventFreezeFrameData: RteEventRef=OIE_EventInfo_IOHWAB_E_WRONG_PARAM_GetEventFreezeFrameData
        RteEventToTaskMapping_OIE_EventInfo_IOHWAB_E_WRONG_PARAM_GetEventStatus: RteEventRef=OIE_EventInfo_IOHWAB_E_WRONG_PARAM_GetEventStatus
        RteEventToTaskMapping_OIE_EventInfo_ECUM_E_IMPROPER_CALLER_GetDTCOfEvent: RteEventRef=OIE_EventInfo_ECUM_E_IMPROPER_CALLER_GetDTCOfEvent
        RteEventToTaskMapping_OIE_EventInfo_ECUM_E_IMPROPER_CALLER_GetEventFailed: RteEventRef=OIE_EventInfo_ECUM_E_IMPROPER_CALLER_GetEventFailed
        RteEventToTaskMapping_OIE_EventInfo_ECUM_E_IMPROPER_CALLER_GetEventExtendedDataRecord: RteEventRef=OIE_EventInfo_ECUM_E_IMPROPER_CALLER_GetEventExtendedDataRecord
        RteEventToTaskMapping_OIE_EventInfo_ECUM_E_IMPROPER_CALLER_GetFaultDetectionCounter: RteEventRef=OIE_EventInfo_ECUM_E_IMPROPER_CALLER_GetFaultDetectionCounter
        RteEventToTaskMapping_OIE_EventInfo_ECUM_E_IMPROPER_CALLER_GetEventTested: RteEventRef=OIE_EventInfo_ECUM_E_IMPROPER_CALLER_GetEventTested
        RteEventToTaskMapping_OIE_EventInfo_ECUM_E_IMPROPER_CALLER_GetEventFreezeFrameData: RteEventRef=OIE_EventInfo_ECUM_E_IMPROPER_CALLER_GetEventFreezeFrameData
        RteEventToTaskMapping_OIE_EventInfo_ECUM_E_IMPROPER_CALLER_GetEventStatus: RteEventRef=OIE_EventInfo_ECUM_E_IMPROPER_CALLER_GetEventStatus
        RteEventToTaskMapping_OIE_EventInfo_FLS_E_READ_FAILED_GetDTCOfEvent: RteEventRef=OIE_EventInfo_FLS_E_READ_FAILED_GetDTCOfEvent
        RteEventToTaskMapping_OIE_EventInfo_FLS_E_READ_FAILED_GetEventFailed: RteEventRef=OIE_EventInfo_FLS_E_READ_FAILED_GetEventFailed
        RteEventToTaskMapping_OIE_EventInfo_FLS_E_READ_FAILED_GetEventExtendedDataRecord: RteEventRef=OIE_EventInfo_FLS_E_READ_FAILED_GetEventExtendedDataRecord
        RteEventToTaskMapping_OIE_EventInfo_FLS_E_READ_FAILED_GetFaultDetectionCounter: RteEventRef=OIE_EventInfo_FLS_E_READ_FAILED_GetFaultDetectionCounter
        RteEventToTaskMapping_OIE_EventInfo_FLS_E_READ_FAILED_GetEventTested: RteEventRef=OIE_EventInfo_FLS_E_READ_FAILED_GetEventTested
        RteEventToTaskMapping_OIE_EventInfo_FLS_E_READ_FAILED_GetEventFreezeFrameData: RteEventRef=OIE_EventInfo_FLS_E_READ_FAILED_GetEventFreezeFrameData
        RteEventToTaskMapping_OIE_EventInfo_FLS_E_READ_FAILED_GetEventStatus: RteEventRef=OIE_EventInfo_FLS_E_READ_FAILED_GetEventStatus
        RteEventToTaskMapping_OIE_EventInfo_IOHWAB_E_PROC_FAIL_GetDTCOfEvent: RteEventRef=OIE_EventInfo_IOHWAB_E_PROC_FAIL_GetDTCOfEvent
        RteEventToTaskMapping_OIE_EventInfo_IOHWAB_E_PROC_FAIL_GetEventFailed: RteEventRef=OIE_EventInfo_IOHWAB_E_PROC_FAIL_GetEventFailed
        RteEventToTaskMapping_OIE_EventInfo_IOHWAB_E_PROC_FAIL_GetEventExtendedDataRecord: RteEventRef=OIE_EventInfo_IOHWAB_E_PROC_FAIL_GetEventExtendedDataRecord
        RteEventToTaskMapping_OIE_EventInfo_IOHWAB_E_PROC_FAIL_GetFaultDetectionCounter: RteEventRef=OIE_EventInfo_IOHWAB_E_PROC_FAIL_GetFaultDetectionCounter
        RteEventToTaskMapping_OIE_EventInfo_IOHWAB_E_PROC_FAIL_GetEventTested: RteEventRef=OIE_EventInfo_IOHWAB_E_PROC_FAIL_GetEventTested
        RteEventToTaskMapping_OIE_EventInfo_IOHWAB_E_PROC_FAIL_GetEventFreezeFrameData: RteEventRef=OIE_EventInfo_IOHWAB_E_PROC_FAIL_GetEventFreezeFrameData
        RteEventToTaskMapping_OIE_EventInfo_IOHWAB_E_PROC_FAIL_GetEventStatus: RteEventRef=OIE_EventInfo_IOHWAB_E_PROC_FAIL_GetEventStatus
        RteEventToTaskMapping_OIE_EventInfo_WDGM_E_SET_MODE_GetDTCOfEvent: RteEventRef=OIE_EventInfo_WDGM_E_SET_MODE_GetDTCOfEvent
        RteEventToTaskMapping_OIE_EventInfo_WDGM_E_SET_MODE_GetEventFailed: RteEventRef=OIE_EventInfo_WDGM_E_SET_MODE_GetEventFailed
        RteEventToTaskMapping_OIE_EventInfo_WDGM_E_SET_MODE_GetEventExtendedDataRecord: RteEventRef=OIE_EventInfo_WDGM_E_SET_MODE_GetEventExtendedDataRecord
        RteEventToTaskMapping_OIE_EventInfo_WDGM_E_SET_MODE_GetFaultDetectionCounter: RteEventRef=OIE_EventInfo_WDGM_E_SET_MODE_GetFaultDetectionCounter
        RteEventToTaskMapping_OIE_EventInfo_WDGM_E_SET_MODE_GetEventTested: RteEventRef=OIE_EventInfo_WDGM_E_SET_MODE_GetEventTested
        RteEventToTaskMapping_OIE_EventInfo_WDGM_E_SET_MODE_GetEventFreezeFrameData: RteEventRef=OIE_EventInfo_WDGM_E_SET_MODE_GetEventFreezeFrameData
        RteEventToTaskMapping_OIE_EventInfo_WDGM_E_SET_MODE_GetEventStatus: RteEventRef=OIE_EventInfo_WDGM_E_SET_MODE_GetEventStatus
        RteEventToTaskMapping_OIE_EventInfo_IOHWAB_E_BUSY_GetDTCOfEvent: RteEventRef=OIE_EventInfo_IOHWAB_E_BUSY_GetDTCOfEvent
        RteEventToTaskMapping_OIE_EventInfo_IOHWAB_E_BUSY_GetEventFailed: RteEventRef=OIE_EventInfo_IOHWAB_E_BUSY_GetEventFailed
        RteEventToTaskMapping_OIE_EventInfo_IOHWAB_E_BUSY_GetEventExtendedDataRecord: RteEventRef=OIE_EventInfo_IOHWAB_E_BUSY_GetEventExtendedDataRecord
        RteEventToTaskMapping_OIE_EventInfo_IOHWAB_E_BUSY_GetFaultDetectionCounter: RteEventRef=OIE_EventInfo_IOHWAB_E_BUSY_GetFaultDetectionCounter
        RteEventToTaskMapping_OIE_EventInfo_IOHWAB_E_BUSY_GetEventTested: RteEventRef=OIE_EventInfo_IOHWAB_E_BUSY_GetEventTested
        RteEventToTaskMapping_OIE_EventInfo_IOHWAB_E_BUSY_GetEventFreezeFrameData: RteEventRef=OIE_EventInfo_IOHWAB_E_BUSY_GetEventFreezeFrameData
        RteEventToTaskMapping_OIE_EventInfo_IOHWAB_E_BUSY_GetEventStatus: RteEventRef=OIE_EventInfo_IOHWAB_E_BUSY_GetEventStatus
        RteEventToTaskMapping_OIE_EventInfo_FLS_E_COMPARE_FAILED_GetDTCOfEvent: RteEventRef=OIE_EventInfo_FLS_E_COMPARE_FAILED_GetDTCOfEvent
        RteEventToTaskMapping_OIE_EventInfo_FLS_E_COMPARE_FAILED_GetEventFailed: RteEventRef=OIE_EventInfo_FLS_E_COMPARE_FAILED_GetEventFailed
        RteEventToTaskMapping_OIE_EventInfo_FLS_E_COMPARE_FAILED_GetEventExtendedDataRecord: RteEventRef=OIE_EventInfo_FLS_E_COMPARE_FAILED_GetEventExtendedDataRecord
        RteEventToTaskMapping_OIE_EventInfo_FLS_E_COMPARE_FAILED_GetFaultDetectionCounter: RteEventRef=OIE_EventInfo_FLS_E_COMPARE_FAILED_GetFaultDetectionCounter
        RteEventToTaskMapping_OIE_EventInfo_FLS_E_COMPARE_FAILED_GetEventTested: RteEventRef=OIE_EventInfo_FLS_E_COMPARE_FAILED_GetEventTested
        RteEventToTaskMapping_OIE_EventInfo_FLS_E_COMPARE_FAILED_GetEventFreezeFrameData: RteEventRef=OIE_EventInfo_FLS_E_COMPARE_FAILED_GetEventFreezeFrameData
        RteEventToTaskMapping_OIE_EventInfo_FLS_E_COMPARE_FAILED_GetEventStatus: RteEventRef=OIE_EventInfo_FLS_E_COMPARE_FAILED_GetEventStatus
        RteEventToTaskMapping_OIE_EventInfo_EEP_E_WRITE_FAILED_GetDTCOfEvent: RteEventRef=OIE_EventInfo_EEP_E_WRITE_FAILED_GetDTCOfEvent
        RteEventToTaskMapping_OIE_EventInfo_EEP_E_WRITE_FAILED_GetEventFailed: RteEventRef=OIE_EventInfo_EEP_E_WRITE_FAILED_GetEventFailed
        RteEventToTaskMapping_OIE_EventInfo_EEP_E_WRITE_FAILED_GetEventExtendedDataRecord: RteEventRef=OIE_EventInfo_EEP_E_WRITE_FAILED_GetEventExtendedDataRecord
        RteEventToTaskMapping_OIE_EventInfo_EEP_E_WRITE_FAILED_GetFaultDetectionCounter: RteEventRef=OIE_EventInfo_EEP_E_WRITE_FAILED_GetFaultDetectionCounter
        RteEventToTaskMapping_OIE_EventInfo_EEP_E_WRITE_FAILED_GetEventTested: RteEventRef=OIE_EventInfo_EEP_E_WRITE_FAILED_GetEventTested
        RteEventToTaskMapping_OIE_EventInfo_EEP_E_WRITE_FAILED_GetEventFreezeFrameData: RteEventRef=OIE_EventInfo_EEP_E_WRITE_FAILED_GetEventFreezeFrameData
        RteEventToTaskMapping_OIE_EventInfo_EEP_E_WRITE_FAILED_GetEventStatus: RteEventRef=OIE_EventInfo_EEP_E_WRITE_FAILED_GetEventStatus
        RteEventToTaskMapping_OIE_OpCycle_DemOperationCycle0_SetOperationCycleState: RteEventRef=OIE_OpCycle_DemOperationCycle0_SetOperationCycleState
        RteEventToTaskMapping_OIE_EventInfo_RAMTST_E_RAM_FAILURE_GetDTCOfEvent: RteEventRef=OIE_EventInfo_RAMTST_E_RAM_FAILURE_GetDTCOfEvent
        RteEventToTaskMapping_OIE_EventInfo_RAMTST_E_RAM_FAILURE_GetEventFailed: RteEventRef=OIE_EventInfo_RAMTST_E_RAM_FAILURE_GetEventFailed
        RteEventToTaskMapping_OIE_EventInfo_RAMTST_E_RAM_FAILURE_GetEventExtendedDataRecord: RteEventRef=OIE_EventInfo_RAMTST_E_RAM_FAILURE_GetEventExtendedDataRecord
        RteEventToTaskMapping_OIE_EventInfo_RAMTST_E_RAM_FAILURE_GetFaultDetectionCounter: RteEventRef=OIE_EventInfo_RAMTST_E_RAM_FAILURE_GetFaultDetectionCounter
        RteEventToTaskMapping_OIE_EventInfo_RAMTST_E_RAM_FAILURE_GetEventTested: RteEventRef=OIE_EventInfo_RAMTST_E_RAM_FAILURE_GetEventTested
        RteEventToTaskMapping_OIE_EventInfo_RAMTST_E_RAM_FAILURE_GetEventFreezeFrameData: RteEventRef=OIE_EventInfo_RAMTST_E_RAM_FAILURE_GetEventFreezeFrameData
        RteEventToTaskMapping_OIE_EventInfo_RAMTST_E_RAM_FAILURE_GetEventStatus: RteEventRef=OIE_EventInfo_RAMTST_E_RAM_FAILURE_GetEventStatus
        RteEventToTaskMapping_OIE_EventInfo_DEM_E_TEST_EVENT5_GetDTCOfEvent: RteEventRef=OIE_EventInfo_DEM_E_TEST_EVENT5_GetDTCOfEvent
        RteEventToTaskMapping_OIE_EventInfo_DEM_E_TEST_EVENT5_GetEventFailed: RteEventRef=OIE_EventInfo_DEM_E_TEST_EVENT5_GetEventFailed
        RteEventToTaskMapping_OIE_EventInfo_DEM_E_TEST_EVENT5_GetEventExtendedDataRecord: RteEventRef=OIE_EventInfo_DEM_E_TEST_EVENT5_GetEventExtendedDataRecord
        RteEventToTaskMapping_OIE_EventInfo_DEM_E_TEST_EVENT5_GetFaultDetectionCounter: RteEventRef=OIE_EventInfo_DEM_E_TEST_EVENT5_GetFaultDetectionCounter
        RteEventToTaskMapping_OIE_EventInfo_DEM_E_TEST_EVENT5_GetEventTested: RteEventRef=OIE_EventInfo_DEM_E_TEST_EVENT5_GetEventTested
        RteEventToTaskMapping_OIE_EventInfo_DEM_E_TEST_EVENT5_GetEventFreezeFrameData: RteEventRef=OIE_EventInfo_DEM_E_TEST_EVENT5_GetEventFreezeFrameData
        RteEventToTaskMapping_OIE_EventInfo_DEM_E_TEST_EVENT5_GetEventStatus: RteEventRef=OIE_EventInfo_DEM_E_TEST_EVENT5_GetEventStatus
        RteEventToTaskMapping_OIE_EventInfo_CANCM_E_BAT_FAIL_GetDTCOfEvent: RteEventRef=OIE_EventInfo_CANCM_E_BAT_FAIL_GetDTCOfEvent
        RteEventToTaskMapping_OIE_EventInfo_CANCM_E_BAT_FAIL_GetEventFailed: RteEventRef=OIE_EventInfo_CANCM_E_BAT_FAIL_GetEventFailed
        RteEventToTaskMapping_OIE_EventInfo_CANCM_E_BAT_FAIL_GetEventExtendedDataRecord: RteEventRef=OIE_EventInfo_CANCM_E_BAT_FAIL_GetEventExtendedDataRecord
        RteEventToTaskMapping_OIE_EventInfo_CANCM_E_BAT_FAIL_GetFaultDetectionCounter: RteEventRef=OIE_EventInfo_CANCM_E_BAT_FAIL_GetFaultDetectionCounter
        RteEventToTaskMapping_OIE_EventInfo_CANCM_E_BAT_FAIL_GetEventTested: RteEventRef=OIE_EventInfo_CANCM_E_BAT_FAIL_GetEventTested
        RteEventToTaskMapping_OIE_EventInfo_CANCM_E_BAT_FAIL_GetEventFreezeFrameData: RteEventRef=OIE_EventInfo_CANCM_E_BAT_FAIL_GetEventFreezeFrameData
        RteEventToTaskMapping_OIE_EventInfo_CANCM_E_BAT_FAIL_GetEventStatus: RteEventRef=OIE_EventInfo_CANCM_E_BAT_FAIL_GetEventStatus
        RteEventToTaskMapping_OIE_EventInfo_CANSM_E_MODE_CHANGE_LCANFD_GetDTCOfEvent: RteEventRef=OIE_EventInfo_CANSM_E_MODE_CHANGE_LCANFD_GetDTCOfEvent
        RteEventToTaskMapping_OIE_EventInfo_CANSM_E_MODE_CHANGE_LCANFD_GetEventFailed: RteEventRef=OIE_EventInfo_CANSM_E_MODE_CHANGE_LCANFD_GetEventFailed
        RteEventToTaskMapping_OIE_EventInfo_CANSM_E_MODE_CHANGE_LCANFD_GetEventExtendedDataRecord: RteEventRef=OIE_EventInfo_CANSM_E_MODE_CHANGE_LCANFD_GetEventExtendedDataRecord
        RteEventToTaskMapping_OIE_EventInfo_CANSM_E_MODE_CHANGE_LCANFD_GetFaultDetectionCounter: RteEventRef=OIE_EventInfo_CANSM_E_MODE_CHANGE_LCANFD_GetFaultDetectionCounter
        RteEventToTaskMapping_OIE_EventInfo_CANSM_E_MODE_CHANGE_LCANFD_GetEventTested: RteEventRef=OIE_EventInfo_CANSM_E_MODE_CHANGE_LCANFD_GetEventTested
        RteEventToTaskMapping_OIE_EventInfo_CANSM_E_MODE_CHANGE_LCANFD_GetEventFreezeFrameData: RteEventRef=OIE_EventInfo_CANSM_E_MODE_CHANGE_LCANFD_GetEventFreezeFrameData
        RteEventToTaskMapping_OIE_EventInfo_CANSM_E_MODE_CHANGE_LCANFD_GetEventStatus: RteEventRef=OIE_EventInfo_CANSM_E_MODE_CHANGE_LCANFD_GetEventStatus
        RteEventToTaskMapping_OIE_EventInfo_CANSM_E_MODE_CHANGE_Reserved_GetDTCOfEvent: RteEventRef=OIE_EventInfo_CANSM_E_MODE_CHANGE_Reserved_GetDTCOfEvent
        RteEventToTaskMapping_OIE_EventInfo_CANSM_E_MODE_CHANGE_Reserved_GetEventFailed: RteEventRef=OIE_EventInfo_CANSM_E_MODE_CHANGE_Reserved_GetEventFailed
        RteEventToTaskMapping_OIE_EventInfo_CANSM_E_MODE_CHANGE_Reserved_GetEventExtendedDataRecord: RteEventRef=OIE_EventInfo_CANSM_E_MODE_CHANGE_Reserved_GetEventExtendedDataRecord
        RteEventToTaskMapping_OIE_EventInfo_CANSM_E_MODE_CHANGE_Reserved_GetFaultDetectionCounter: RteEventRef=OIE_EventInfo_CANSM_E_MODE_CHANGE_Reserved_GetFaultDetectionCounter
        RteEventToTaskMapping_OIE_EventInfo_CANSM_E_MODE_CHANGE_Reserved_GetEventTested: RteEventRef=OIE_EventInfo_CANSM_E_MODE_CHANGE_Reserved_GetEventTested
        RteEventToTaskMapping_OIE_EventInfo_CANSM_E_MODE_CHANGE_Reserved_GetEventFreezeFrameData: RteEventRef=OIE_EventInfo_CANSM_E_MODE_CHANGE_Reserved_GetEventFreezeFrameData
        RteEventToTaskMapping_OIE_EventInfo_CANSM_E_MODE_CHANGE_Reserved_GetEventStatus: RteEventRef=OIE_EventInfo_CANSM_E_MODE_CHANGE_Reserved_GetEventStatus
        RteEventToTaskMapping_OIE_EventInfo_CANSM_E_MODE_CHANGE_CCANFD_GetDTCOfEvent: RteEventRef=OIE_EventInfo_CANSM_E_MODE_CHANGE_CCANFD_GetDTCOfEvent
        RteEventToTaskMapping_OIE_EventInfo_CANSM_E_MODE_CHANGE_CCANFD_GetEventFailed: RteEventRef=OIE_EventInfo_CANSM_E_MODE_CHANGE_CCANFD_GetEventFailed
        RteEventToTaskMapping_OIE_EventInfo_CANSM_E_MODE_CHANGE_CCANFD_GetEventExtendedDataRecord: RteEventRef=OIE_EventInfo_CANSM_E_MODE_CHANGE_CCANFD_GetEventExtendedDataRecord
        RteEventToTaskMapping_OIE_EventInfo_CANSM_E_MODE_CHANGE_CCANFD_GetFaultDetectionCounter: RteEventRef=OIE_EventInfo_CANSM_E_MODE_CHANGE_CCANFD_GetFaultDetectionCounter
        RteEventToTaskMapping_OIE_EventInfo_CANSM_E_MODE_CHANGE_CCANFD_GetEventTested: RteEventRef=OIE_EventInfo_CANSM_E_MODE_CHANGE_CCANFD_GetEventTested
        RteEventToTaskMapping_OIE_EventInfo_CANSM_E_MODE_CHANGE_CCANFD_GetEventFreezeFrameData: RteEventRef=OIE_EventInfo_CANSM_E_MODE_CHANGE_CCANFD_GetEventFreezeFrameData
        RteEventToTaskMapping_OIE_EventInfo_CANSM_E_MODE_CHANGE_CCANFD_GetEventStatus: RteEventRef=OIE_EventInfo_CANSM_E_MODE_CHANGE_CCANFD_GetEventStatus
        RteEventToTaskMapping_OIE_EventInfo_CANSM_E_MODE_CHANGE_zDEBUGCAN_GetDTCOfEvent: RteEventRef=OIE_EventInfo_CANSM_E_MODE_CHANGE_zDEBUGCAN_GetDTCOfEvent
        RteEventToTaskMapping_OIE_EventInfo_CANSM_E_MODE_CHANGE_zDEBUGCAN_GetEventFailed: RteEventRef=OIE_EventInfo_CANSM_E_MODE_CHANGE_zDEBUGCAN_GetEventFailed
        RteEventToTaskMapping_OIE_EventInfo_CANSM_E_MODE_CHANGE_zDEBUGCAN_GetEventExtendedDataRecord: RteEventRef=OIE_EventInfo_CANSM_E_MODE_CHANGE_zDEBUGCAN_GetEventExtendedDataRecord
        RteEventToTaskMapping_OIE_EventInfo_CANSM_E_MODE_CHANGE_zDEBUGCAN_GetFaultDetectionCounter: RteEventRef=OIE_EventInfo_CANSM_E_MODE_CHANGE_zDEBUGCAN_GetFaultDetectionCounter
        RteEventToTaskMapping_OIE_EventInfo_CANSM_E_MODE_CHANGE_zDEBUGCAN_GetEventTested: RteEventRef=OIE_EventInfo_CANSM_E_MODE_CHANGE_zDEBUGCAN_GetEventTested
        RteEventToTaskMapping_OIE_EventInfo_CANSM_E_MODE_CHANGE_zDEBUGCAN_GetEventFreezeFrameData: RteEventRef=OIE_EventInfo_CANSM_E_MODE_CHANGE_zDEBUGCAN_GetEventFreezeFrameData
        RteEventToTaskMapping_OIE_EventInfo_CANSM_E_MODE_CHANGE_zDEBUGCAN_GetEventStatus: RteEventRef=OIE_EventInfo_CANSM_E_MODE_CHANGE_zDEBUGCAN_GetEventStatus
        RteEventToTaskMapping_OIE_EventInfo_FLS_E_UNEXPECTED_FLASH_ID_GetDTCOfEvent: RteEventRef=OIE_EventInfo_FLS_E_UNEXPECTED_FLASH_ID_GetDTCOfEvent
        RteEventToTaskMapping_OIE_EventInfo_FLS_E_UNEXPECTED_FLASH_ID_GetEventFailed: RteEventRef=OIE_EventInfo_FLS_E_UNEXPECTED_FLASH_ID_GetEventFailed
        RteEventToTaskMapping_OIE_EventInfo_FLS_E_UNEXPECTED_FLASH_ID_GetEventExtendedDataRecord: RteEventRef=OIE_EventInfo_FLS_E_UNEXPECTED_FLASH_ID_GetEventExtendedDataRecord
        RteEventToTaskMapping_OIE_EventInfo_FLS_E_UNEXPECTED_FLASH_ID_GetFaultDetectionCounter: RteEventRef=OIE_EventInfo_FLS_E_UNEXPECTED_FLASH_ID_GetFaultDetectionCounter
        RteEventToTaskMapping_OIE_EventInfo_FLS_E_UNEXPECTED_FLASH_ID_GetEventTested: RteEventRef=OIE_EventInfo_FLS_E_UNEXPECTED_FLASH_ID_GetEventTested
        RteEventToTaskMapping_OIE_EventInfo_FLS_E_UNEXPECTED_FLASH_ID_GetEventFreezeFrameData: RteEventRef=OIE_EventInfo_FLS_E_UNEXPECTED_FLASH_ID_GetEventFreezeFrameData
        RteEventToTaskMapping_OIE_EventInfo_FLS_E_UNEXPECTED_FLASH_ID_GetEventStatus: RteEventRef=OIE_EventInfo_FLS_E_UNEXPECTED_FLASH_ID_GetEventStatus
        RteEventToTaskMapping_OIE_EventInfo_ADC_E_TIMEOUT_GetDTCOfEvent: RteEventRef=OIE_EventInfo_ADC_E_TIMEOUT_GetDTCOfEvent
        RteEventToTaskMapping_OIE_EventInfo_ADC_E_TIMEOUT_GetEventFailed: RteEventRef=OIE_EventInfo_ADC_E_TIMEOUT_GetEventFailed
        RteEventToTaskMapping_OIE_EventInfo_ADC_E_TIMEOUT_GetEventExtendedDataRecord: RteEventRef=OIE_EventInfo_ADC_E_TIMEOUT_GetEventExtendedDataRecord
        RteEventToTaskMapping_OIE_EventInfo_ADC_E_TIMEOUT_GetFaultDetectionCounter: RteEventRef=OIE_EventInfo_ADC_E_TIMEOUT_GetFaultDetectionCounter
        RteEventToTaskMapping_OIE_EventInfo_ADC_E_TIMEOUT_GetEventTested: RteEventRef=OIE_EventInfo_ADC_E_TIMEOUT_GetEventTested
        RteEventToTaskMapping_OIE_EventInfo_ADC_E_TIMEOUT_GetEventFreezeFrameData: RteEventRef=OIE_EventInfo_ADC_E_TIMEOUT_GetEventFreezeFrameData
        RteEventToTaskMapping_OIE_EventInfo_ADC_E_TIMEOUT_GetEventStatus: RteEventRef=OIE_EventInfo_ADC_E_TIMEOUT_GetEventStatus
        RteEventToTaskMapping_OIE_EventInfo_Dem_FEE_GC_INIT_ERROR_GetDTCOfEvent: RteEventRef=OIE_EventInfo_Dem_FEE_GC_INIT_ERROR_GetDTCOfEvent
        RteEventToTaskMapping_OIE_EventInfo_Dem_FEE_GC_INIT_ERROR_GetEventFailed: RteEventRef=OIE_EventInfo_Dem_FEE_GC_INIT_ERROR_GetEventFailed
        RteEventToTaskMapping_OIE_EventInfo_Dem_FEE_GC_INIT_ERROR_GetEventExtendedDataRecord: RteEventRef=OIE_EventInfo_Dem_FEE_GC_INIT_ERROR_GetEventExtendedDataRecord
        RteEventToTaskMapping_OIE_EventInfo_Dem_FEE_GC_INIT_ERROR_GetFaultDetectionCounter: RteEventRef=OIE_EventInfo_Dem_FEE_GC_INIT_ERROR_GetFaultDetectionCounter
        RteEventToTaskMapping_OIE_EventInfo_Dem_FEE_GC_INIT_ERROR_GetEventTested: RteEventRef=OIE_EventInfo_Dem_FEE_GC_INIT_ERROR_GetEventTested
        RteEventToTaskMapping_OIE_EventInfo_Dem_FEE_GC_INIT_ERROR_GetEventFreezeFrameData: RteEventRef=OIE_EventInfo_Dem_FEE_GC_INIT_ERROR_GetEventFreezeFrameData
        RteEventToTaskMapping_OIE_EventInfo_Dem_FEE_GC_INIT_ERROR_GetEventStatus: RteEventRef=OIE_EventInfo_Dem_FEE_GC_INIT_ERROR_GetEventStatus
        RteEventToTaskMapping_OIE_EventInfo_ETHTRCV_E_ACCESS_GetDTCOfEvent: RteEventRef=OIE_EventInfo_ETHTRCV_E_ACCESS_GetDTCOfEvent
        RteEventToTaskMapping_OIE_EventInfo_ETHTRCV_E_ACCESS_GetEventFailed: RteEventRef=OIE_EventInfo_ETHTRCV_E_ACCESS_GetEventFailed
        RteEventToTaskMapping_OIE_EventInfo_ETHTRCV_E_ACCESS_GetEventExtendedDataRecord: RteEventRef=OIE_EventInfo_ETHTRCV_E_ACCESS_GetEventExtendedDataRecord
        RteEventToTaskMapping_OIE_EventInfo_ETHTRCV_E_ACCESS_GetFaultDetectionCounter: RteEventRef=OIE_EventInfo_ETHTRCV_E_ACCESS_GetFaultDetectionCounter
        RteEventToTaskMapping_OIE_EventInfo_ETHTRCV_E_ACCESS_GetEventTested: RteEventRef=OIE_EventInfo_ETHTRCV_E_ACCESS_GetEventTested
        RteEventToTaskMapping_OIE_EventInfo_ETHTRCV_E_ACCESS_GetEventFreezeFrameData: RteEventRef=OIE_EventInfo_ETHTRCV_E_ACCESS_GetEventFreezeFrameData
        RteEventToTaskMapping_OIE_EventInfo_ETHTRCV_E_ACCESS_GetEventStatus: RteEventRef=OIE_EventInfo_ETHTRCV_E_ACCESS_GetEventStatus
        RteEventToTaskMapping_OIE_EventInfo_MCU_E_CLOCK_FAILURE_GetDTCOfEvent: RteEventRef=OIE_EventInfo_MCU_E_CLOCK_FAILURE_GetDTCOfEvent
        RteEventToTaskMapping_OIE_EventInfo_MCU_E_CLOCK_FAILURE_GetEventFailed: RteEventRef=OIE_EventInfo_MCU_E_CLOCK_FAILURE_GetEventFailed
        RteEventToTaskMapping_OIE_EventInfo_MCU_E_CLOCK_FAILURE_GetEventExtendedDataRecord: RteEventRef=OIE_EventInfo_MCU_E_CLOCK_FAILURE_GetEventExtendedDataRecord
        RteEventToTaskMapping_OIE_EventInfo_MCU_E_CLOCK_FAILURE_GetFaultDetectionCounter: RteEventRef=OIE_EventInfo_MCU_E_CLOCK_FAILURE_GetFaultDetectionCounter
        RteEventToTaskMapping_OIE_EventInfo_MCU_E_CLOCK_FAILURE_GetEventTested: RteEventRef=OIE_EventInfo_MCU_E_CLOCK_FAILURE_GetEventTested
        RteEventToTaskMapping_OIE_EventInfo_MCU_E_CLOCK_FAILURE_GetEventFreezeFrameData: RteEventRef=OIE_EventInfo_MCU_E_CLOCK_FAILURE_GetEventFreezeFrameData
        RteEventToTaskMapping_OIE_EventInfo_MCU_E_CLOCK_FAILURE_GetEventStatus: RteEventRef=OIE_EventInfo_MCU_E_CLOCK_FAILURE_GetEventStatus
        RteEventToTaskMapping_OIE_EventInfo_DEM_E_TEST_EVENT2_GetDTCOfEvent: RteEventRef=OIE_EventInfo_DEM_E_TEST_EVENT2_GetDTCOfEvent
        RteEventToTaskMapping_OIE_EventInfo_DEM_E_TEST_EVENT2_GetEventFailed: RteEventRef=OIE_EventInfo_DEM_E_TEST_EVENT2_GetEventFailed
        RteEventToTaskMapping_OIE_EventInfo_DEM_E_TEST_EVENT2_GetEventExtendedDataRecord: RteEventRef=OIE_EventInfo_DEM_E_TEST_EVENT2_GetEventExtendedDataRecord
        RteEventToTaskMapping_OIE_EventInfo_DEM_E_TEST_EVENT2_GetFaultDetectionCounter: RteEventRef=OIE_EventInfo_DEM_E_TEST_EVENT2_GetFaultDetectionCounter
        RteEventToTaskMapping_OIE_EventInfo_DEM_E_TEST_EVENT2_GetEventTested: RteEventRef=OIE_EventInfo_DEM_E_TEST_EVENT2_GetEventTested
        RteEventToTaskMapping_OIE_EventInfo_DEM_E_TEST_EVENT2_GetEventFreezeFrameData: RteEventRef=OIE_EventInfo_DEM_E_TEST_EVENT2_GetEventFreezeFrameData
        RteEventToTaskMapping_OIE_EventInfo_DEM_E_TEST_EVENT2_GetEventStatus: RteEventRef=OIE_EventInfo_DEM_E_TEST_EVENT2_GetEventStatus
        RteEventToTaskMapping_OIE_EventInfo_Dem_FEE_INVALIDATE_ERROR_GetDTCOfEvent: RteEventRef=OIE_EventInfo_Dem_FEE_INVALIDATE_ERROR_GetDTCOfEvent
        RteEventToTaskMapping_OIE_EventInfo_Dem_FEE_INVALIDATE_ERROR_GetEventFailed: RteEventRef=OIE_EventInfo_Dem_FEE_INVALIDATE_ERROR_GetEventFailed
        RteEventToTaskMapping_OIE_EventInfo_Dem_FEE_INVALIDATE_ERROR_GetEventExtendedDataRecord: RteEventRef=OIE_EventInfo_Dem_FEE_INVALIDATE_ERROR_GetEventExtendedDataRecord
        RteEventToTaskMapping_OIE_EventInfo_Dem_FEE_INVALIDATE_ERROR_GetFaultDetectionCounter: RteEventRef=OIE_EventInfo_Dem_FEE_INVALIDATE_ERROR_GetFaultDetectionCounter
        RteEventToTaskMapping_OIE_EventInfo_Dem_FEE_INVALIDATE_ERROR_GetEventTested: RteEventRef=OIE_EventInfo_Dem_FEE_INVALIDATE_ERROR_GetEventTested
        RteEventToTaskMapping_OIE_EventInfo_Dem_FEE_INVALIDATE_ERROR_GetEventFreezeFrameData: RteEventRef=OIE_EventInfo_Dem_FEE_INVALIDATE_ERROR_GetEventFreezeFrameData
        RteEventToTaskMapping_OIE_EventInfo_Dem_FEE_INVALIDATE_ERROR_GetEventStatus: RteEventRef=OIE_EventInfo_Dem_FEE_INVALIDATE_ERROR_GetEventStatus
        RteEventToTaskMapping_OIE_EventInfo_EEP_E_ERASE_FAILED_GetDTCOfEvent: RteEventRef=OIE_EventInfo_EEP_E_ERASE_FAILED_GetDTCOfEvent
        RteEventToTaskMapping_OIE_EventInfo_EEP_E_ERASE_FAILED_GetEventFailed: RteEventRef=OIE_EventInfo_EEP_E_ERASE_FAILED_GetEventFailed
        RteEventToTaskMapping_OIE_EventInfo_EEP_E_ERASE_FAILED_GetEventExtendedDataRecord: RteEventRef=OIE_EventInfo_EEP_E_ERASE_FAILED_GetEventExtendedDataRecord
        RteEventToTaskMapping_OIE_EventInfo_EEP_E_ERASE_FAILED_GetFaultDetectionCounter: RteEventRef=OIE_EventInfo_EEP_E_ERASE_FAILED_GetFaultDetectionCounter
        RteEventToTaskMapping_OIE_EventInfo_EEP_E_ERASE_FAILED_GetEventTested: RteEventRef=OIE_EventInfo_EEP_E_ERASE_FAILED_GetEventTested
        RteEventToTaskMapping_OIE_EventInfo_EEP_E_ERASE_FAILED_GetEventFreezeFrameData: RteEventRef=OIE_EventInfo_EEP_E_ERASE_FAILED_GetEventFreezeFrameData
        RteEventToTaskMapping_OIE_EventInfo_EEP_E_ERASE_FAILED_GetEventStatus: RteEventRef=OIE_EventInfo_EEP_E_ERASE_FAILED_GetEventStatus
        RteEventToTaskMapping_OIE_Event_DEM_E_TEST_EVENT1_SetEventStatus: RteEventRef=OIE_Event_DEM_E_TEST_EVENT1_SetEventStatus
        RteEventToTaskMapping_OIE_Event_DEM_E_TEST_EVENT1_ResetEventStatus: RteEventRef=OIE_Event_DEM_E_TEST_EVENT1_ResetEventStatus
        RteEventToTaskMapping_OIE_Event_DEM_E_TEST_EVENT1_SetEventDisabled: RteEventRef=OIE_Event_DEM_E_TEST_EVENT1_SetEventDisabled
        RteEventToTaskMapping_OIE_Event_DEM_E_TEST_EVENT5_SetEventStatus: RteEventRef=OIE_Event_DEM_E_TEST_EVENT5_SetEventStatus
        RteEventToTaskMapping_OIE_Event_DEM_E_TEST_EVENT5_ResetEventStatus: RteEventRef=OIE_Event_DEM_E_TEST_EVENT5_ResetEventStatus
        RteEventToTaskMapping_OIE_Event_DEM_E_TEST_EVENT5_SetEventDisabled: RteEventRef=OIE_Event_DEM_E_TEST_EVENT5_SetEventDisabled
        RteEventToTaskMapping_OIE_EventInfo_EEP_E_COMPARE_FAILED_GetDTCOfEvent: RteEventRef=OIE_EventInfo_EEP_E_COMPARE_FAILED_GetDTCOfEvent
        RteEventToTaskMapping_OIE_EventInfo_EEP_E_COMPARE_FAILED_GetEventFailed: RteEventRef=OIE_EventInfo_EEP_E_COMPARE_FAILED_GetEventFailed
        RteEventToTaskMapping_OIE_EventInfo_EEP_E_COMPARE_FAILED_GetEventExtendedDataRecord: RteEventRef=OIE_EventInfo_EEP_E_COMPARE_FAILED_GetEventExtendedDataRecord
        RteEventToTaskMapping_OIE_EventInfo_EEP_E_COMPARE_FAILED_GetFaultDetectionCounter: RteEventRef=OIE_EventInfo_EEP_E_COMPARE_FAILED_GetFaultDetectionCounter
        RteEventToTaskMapping_OIE_EventInfo_EEP_E_COMPARE_FAILED_GetEventTested: RteEventRef=OIE_EventInfo_EEP_E_COMPARE_FAILED_GetEventTested
        RteEventToTaskMapping_OIE_EventInfo_EEP_E_COMPARE_FAILED_GetEventFreezeFrameData: RteEventRef=OIE_EventInfo_EEP_E_COMPARE_FAILED_GetEventFreezeFrameData
        RteEventToTaskMapping_OIE_EventInfo_EEP_E_COMPARE_FAILED_GetEventStatus: RteEventRef=OIE_EventInfo_EEP_E_COMPARE_FAILED_GetEventStatus
        RteEventToTaskMapping_OIE_EventInfo_IOHWAB_E_WRONG_SETTING_GetDTCOfEvent: RteEventRef=OIE_EventInfo_IOHWAB_E_WRONG_SETTING_GetDTCOfEvent
        RteEventToTaskMapping_OIE_EventInfo_IOHWAB_E_WRONG_SETTING_GetEventFailed: RteEventRef=OIE_EventInfo_IOHWAB_E_WRONG_SETTING_GetEventFailed
        RteEventToTaskMapping_OIE_EventInfo_IOHWAB_E_WRONG_SETTING_GetEventExtendedDataRecord: RteEventRef=OIE_EventInfo_IOHWAB_E_WRONG_SETTING_GetEventExtendedDataRecord
        RteEventToTaskMapping_OIE_EventInfo_IOHWAB_E_WRONG_SETTING_GetFaultDetectionCounter: RteEventRef=OIE_EventInfo_IOHWAB_E_WRONG_SETTING_GetFaultDetectionCounter
        RteEventToTaskMapping_OIE_EventInfo_IOHWAB_E_WRONG_SETTING_GetEventTested: RteEventRef=OIE_EventInfo_IOHWAB_E_WRONG_SETTING_GetEventTested
        RteEventToTaskMapping_OIE_EventInfo_IOHWAB_E_WRONG_SETTING_GetEventFreezeFrameData: RteEventRef=OIE_EventInfo_IOHWAB_E_WRONG_SETTING_GetEventFreezeFrameData
        RteEventToTaskMapping_OIE_EventInfo_IOHWAB_E_WRONG_SETTING_GetEventStatus: RteEventRef=OIE_EventInfo_IOHWAB_E_WRONG_SETTING_GetEventStatus
        RteEventToTaskMapping_OIE_EventInfo_NVM_E_WRONG_BLOCK_ID_GetDTCOfEvent: RteEventRef=OIE_EventInfo_NVM_E_WRONG_BLOCK_ID_GetDTCOfEvent
        RteEventToTaskMapping_OIE_EventInfo_NVM_E_WRONG_BLOCK_ID_GetEventFailed: RteEventRef=OIE_EventInfo_NVM_E_WRONG_BLOCK_ID_GetEventFailed
        RteEventToTaskMapping_OIE_EventInfo_NVM_E_WRONG_BLOCK_ID_GetEventExtendedDataRecord: RteEventRef=OIE_EventInfo_NVM_E_WRONG_BLOCK_ID_GetEventExtendedDataRecord
        RteEventToTaskMapping_OIE_EventInfo_NVM_E_WRONG_BLOCK_ID_GetFaultDetectionCounter: RteEventRef=OIE_EventInfo_NVM_E_WRONG_BLOCK_ID_GetFaultDetectionCounter
        RteEventToTaskMapping_OIE_EventInfo_NVM_E_WRONG_BLOCK_ID_GetEventTested: RteEventRef=OIE_EventInfo_NVM_E_WRONG_BLOCK_ID_GetEventTested
        RteEventToTaskMapping_OIE_EventInfo_NVM_E_WRONG_BLOCK_ID_GetEventFreezeFrameData: RteEventRef=OIE_EventInfo_NVM_E_WRONG_BLOCK_ID_GetEventFreezeFrameData
        RteEventToTaskMapping_OIE_EventInfo_NVM_E_WRONG_BLOCK_ID_GetEventStatus: RteEventRef=OIE_EventInfo_NVM_E_WRONG_BLOCK_ID_GetEventStatus
        RteEventToTaskMapping_OIE_EventInfo_PWM_E_UNEXPECTED_IRQ_GetDTCOfEvent: RteEventRef=OIE_EventInfo_PWM_E_UNEXPECTED_IRQ_GetDTCOfEvent
        RteEventToTaskMapping_OIE_EventInfo_PWM_E_UNEXPECTED_IRQ_GetEventFailed: RteEventRef=OIE_EventInfo_PWM_E_UNEXPECTED_IRQ_GetEventFailed
        RteEventToTaskMapping_OIE_EventInfo_PWM_E_UNEXPECTED_IRQ_GetEventExtendedDataRecord: RteEventRef=OIE_EventInfo_PWM_E_UNEXPECTED_IRQ_GetEventExtendedDataRecord
        RteEventToTaskMapping_OIE_EventInfo_PWM_E_UNEXPECTED_IRQ_GetFaultDetectionCounter: RteEventRef=OIE_EventInfo_PWM_E_UNEXPECTED_IRQ_GetFaultDetectionCounter
        RteEventToTaskMapping_OIE_EventInfo_PWM_E_UNEXPECTED_IRQ_GetEventTested: RteEventRef=OIE_EventInfo_PWM_E_UNEXPECTED_IRQ_GetEventTested
        RteEventToTaskMapping_OIE_EventInfo_PWM_E_UNEXPECTED_IRQ_GetEventFreezeFrameData: RteEventRef=OIE_EventInfo_PWM_E_UNEXPECTED_IRQ_GetEventFreezeFrameData
        RteEventToTaskMapping_OIE_EventInfo_PWM_E_UNEXPECTED_IRQ_GetEventStatus: RteEventRef=OIE_EventInfo_PWM_E_UNEXPECTED_IRQ_GetEventStatus
        RteEventToTaskMapping_OIE_EventInfo_WDG_E_DISABLE_REJECTED_GetDTCOfEvent: RteEventRef=OIE_EventInfo_WDG_E_DISABLE_REJECTED_GetDTCOfEvent
        RteEventToTaskMapping_OIE_EventInfo_WDG_E_DISABLE_REJECTED_GetEventFailed: RteEventRef=OIE_EventInfo_WDG_E_DISABLE_REJECTED_GetEventFailed
        RteEventToTaskMapping_OIE_EventInfo_WDG_E_DISABLE_REJECTED_GetEventExtendedDataRecord: RteEventRef=OIE_EventInfo_WDG_E_DISABLE_REJECTED_GetEventExtendedDataRecord
        RteEventToTaskMapping_OIE_EventInfo_WDG_E_DISABLE_REJECTED_GetFaultDetectionCounter: RteEventRef=OIE_EventInfo_WDG_E_DISABLE_REJECTED_GetFaultDetectionCounter
        RteEventToTaskMapping_OIE_EventInfo_WDG_E_DISABLE_REJECTED_GetEventTested: RteEventRef=OIE_EventInfo_WDG_E_DISABLE_REJECTED_GetEventTested
        RteEventToTaskMapping_OIE_EventInfo_WDG_E_DISABLE_REJECTED_GetEventFreezeFrameData: RteEventRef=OIE_EventInfo_WDG_E_DISABLE_REJECTED_GetEventFreezeFrameData
        RteEventToTaskMapping_OIE_EventInfo_WDG_E_DISABLE_REJECTED_GetEventStatus: RteEventRef=OIE_EventInfo_WDG_E_DISABLE_REJECTED_GetEventStatus
        RteEventToTaskMapping_OIE_EventInfo_ETHSM_E_LINK_DOWN_GetDTCOfEvent: RteEventRef=OIE_EventInfo_ETHSM_E_LINK_DOWN_GetDTCOfEvent
        RteEventToTaskMapping_OIE_EventInfo_ETHSM_E_LINK_DOWN_GetEventFailed: RteEventRef=OIE_EventInfo_ETHSM_E_LINK_DOWN_GetEventFailed
        RteEventToTaskMapping_OIE_EventInfo_ETHSM_E_LINK_DOWN_GetEventExtendedDataRecord: RteEventRef=OIE_EventInfo_ETHSM_E_LINK_DOWN_GetEventExtendedDataRecord
        RteEventToTaskMapping_OIE_EventInfo_ETHSM_E_LINK_DOWN_GetFaultDetectionCounter: RteEventRef=OIE_EventInfo_ETHSM_E_LINK_DOWN_GetFaultDetectionCounter
        RteEventToTaskMapping_OIE_EventInfo_ETHSM_E_LINK_DOWN_GetEventTested: RteEventRef=OIE_EventInfo_ETHSM_E_LINK_DOWN_GetEventTested
        RteEventToTaskMapping_OIE_EventInfo_ETHSM_E_LINK_DOWN_GetEventFreezeFrameData: RteEventRef=OIE_EventInfo_ETHSM_E_LINK_DOWN_GetEventFreezeFrameData
        RteEventToTaskMapping_OIE_EventInfo_ETHSM_E_LINK_DOWN_GetEventStatus: RteEventRef=OIE_EventInfo_ETHSM_E_LINK_DOWN_GetEventStatus
        RteEventToTaskMapping_OIE_EventInfo_IOHWAB_E_WRONG_STATE_GetDTCOfEvent: RteEventRef=OIE_EventInfo_IOHWAB_E_WRONG_STATE_GetDTCOfEvent
        RteEventToTaskMapping_OIE_EventInfo_IOHWAB_E_WRONG_STATE_GetEventFailed: RteEventRef=OIE_EventInfo_IOHWAB_E_WRONG_STATE_GetEventFailed
        RteEventToTaskMapping_OIE_EventInfo_IOHWAB_E_WRONG_STATE_GetEventExtendedDataRecord: RteEventRef=OIE_EventInfo_IOHWAB_E_WRONG_STATE_GetEventExtendedDataRecord
        RteEventToTaskMapping_OIE_EventInfo_IOHWAB_E_WRONG_STATE_GetFaultDetectionCounter: RteEventRef=OIE_EventInfo_IOHWAB_E_WRONG_STATE_GetFaultDetectionCounter
        RteEventToTaskMapping_OIE_EventInfo_IOHWAB_E_WRONG_STATE_GetEventTested: RteEventRef=OIE_EventInfo_IOHWAB_E_WRONG_STATE_GetEventTested
        RteEventToTaskMapping_OIE_EventInfo_IOHWAB_E_WRONG_STATE_GetEventFreezeFrameData: RteEventRef=OIE_EventInfo_IOHWAB_E_WRONG_STATE_GetEventFreezeFrameData
        RteEventToTaskMapping_OIE_EventInfo_IOHWAB_E_WRONG_STATE_GetEventStatus: RteEventRef=OIE_EventInfo_IOHWAB_E_WRONG_STATE_GetEventStatus
        RteEventToTaskMapping_OIE_EventInfo_WDG_76_ACW_E_DISABLE_REJECTED_GetDTCOfEvent: RteEventRef=OIE_EventInfo_WDG_76_ACW_E_DISABLE_REJECTED_GetDTCOfEvent
        RteEventToTaskMapping_OIE_EventInfo_WDG_76_ACW_E_DISABLE_REJECTED_GetEventFailed: RteEventRef=OIE_EventInfo_WDG_76_ACW_E_DISABLE_REJECTED_GetEventFailed
        RteEventToTaskMapping_OIE_EventInfo_WDG_76_ACW_E_DISABLE_REJECTED_GetEventExtendedDataRecord: RteEventRef=OIE_EventInfo_WDG_76_ACW_E_DISABLE_REJECTED_GetEventExtendedDataRecord
        RteEventToTaskMapping_OIE_EventInfo_WDG_76_ACW_E_DISABLE_REJECTED_GetFaultDetectionCounter: RteEventRef=OIE_EventInfo_WDG_76_ACW_E_DISABLE_REJECTED_GetFaultDetectionCounter
        RteEventToTaskMapping_OIE_EventInfo_WDG_76_ACW_E_DISABLE_REJECTED_GetEventTested: RteEventRef=OIE_EventInfo_WDG_76_ACW_E_DISABLE_REJECTED_GetEventTested
        RteEventToTaskMapping_OIE_EventInfo_WDG_76_ACW_E_DISABLE_REJECTED_GetEventFreezeFrameData: RteEventRef=OIE_EventInfo_WDG_76_ACW_E_DISABLE_REJECTED_GetEventFreezeFrameData
        RteEventToTaskMapping_OIE_EventInfo_WDG_76_ACW_E_DISABLE_REJECTED_GetEventStatus: RteEventRef=OIE_EventInfo_WDG_76_ACW_E_DISABLE_REJECTED_GetEventStatus
        RteEventToTaskMapping_OIE_EventInfo_CAN_E_TIMEOUT_GetDTCOfEvent: RteEventRef=OIE_EventInfo_CAN_E_TIMEOUT_GetDTCOfEvent
        RteEventToTaskMapping_OIE_EventInfo_CAN_E_TIMEOUT_GetEventExtendedDataRecord: RteEventRef=OIE_EventInfo_CAN_E_TIMEOUT_GetEventExtendedDataRecord
        RteEventToTaskMapping_OIE_EventInfo_CAN_E_TIMEOUT_GetEventFailed: RteEventRef=OIE_EventInfo_CAN_E_TIMEOUT_GetEventFailed
        RteEventToTaskMapping_OIE_EventInfo_CAN_E_TIMEOUT_GetEventFreezeFrameData: RteEventRef=OIE_EventInfo_CAN_E_TIMEOUT_GetEventFreezeFrameData
        RteEventToTaskMapping_OIE_EventInfo_CAN_E_TIMEOUT_GetEventStatus: RteEventRef=OIE_EventInfo_CAN_E_TIMEOUT_GetEventStatus
        RteEventToTaskMapping_OIE_EventInfo_CAN_E_TIMEOUT_GetEventTested: RteEventRef=OIE_EventInfo_CAN_E_TIMEOUT_GetEventTested
        RteEventToTaskMapping_OIE_EventInfo_CAN_E_TIMEOUT_GetFaultDetectionCounter: RteEventRef=OIE_EventInfo_CAN_E_TIMEOUT_GetFaultDetectionCounter
        RteEventToTaskMapping_OIE_EventInfo_FEE_E_GC_ERASE_GetDTCOfEvent: RteEventRef=OIE_EventInfo_FEE_E_GC_ERASE_GetDTCOfEvent
        RteEventToTaskMapping_OIE_EventInfo_FEE_E_GC_ERASE_GetEventExtendedDataRecord: RteEventRef=OIE_EventInfo_FEE_E_GC_ERASE_GetEventExtendedDataRecord
        RteEventToTaskMapping_OIE_EventInfo_FEE_E_GC_ERASE_GetEventFailed: RteEventRef=OIE_EventInfo_FEE_E_GC_ERASE_GetEventFailed
        RteEventToTaskMapping_OIE_EventInfo_FEE_E_GC_ERASE_GetEventFreezeFrameData: RteEventRef=OIE_EventInfo_FEE_E_GC_ERASE_GetEventFreezeFrameData
        RteEventToTaskMapping_OIE_EventInfo_FEE_E_GC_ERASE_GetEventStatus: RteEventRef=OIE_EventInfo_FEE_E_GC_ERASE_GetEventStatus
        RteEventToTaskMapping_OIE_EventInfo_FEE_E_GC_ERASE_GetEventTested: RteEventRef=OIE_EventInfo_FEE_E_GC_ERASE_GetEventTested
        RteEventToTaskMapping_OIE_EventInfo_FEE_E_GC_ERASE_GetFaultDetectionCounter: RteEventRef=OIE_EventInfo_FEE_E_GC_ERASE_GetFaultDetectionCounter
        RteEventToTaskMapping_OIE_EventInfo_FEE_E_GC_INIT_GetDTCOfEvent: RteEventRef=OIE_EventInfo_FEE_E_GC_INIT_GetDTCOfEvent
        RteEventToTaskMapping_OIE_EventInfo_FEE_E_GC_INIT_GetEventExtendedDataRecord: RteEventRef=OIE_EventInfo_FEE_E_GC_INIT_GetEventExtendedDataRecord
        RteEventToTaskMapping_OIE_EventInfo_FEE_E_GC_INIT_GetEventFailed: RteEventRef=OIE_EventInfo_FEE_E_GC_INIT_GetEventFailed
        RteEventToTaskMapping_OIE_EventInfo_FEE_E_GC_INIT_GetEventFreezeFrameData: RteEventRef=OIE_EventInfo_FEE_E_GC_INIT_GetEventFreezeFrameData
        RteEventToTaskMapping_OIE_EventInfo_FEE_E_GC_INIT_GetEventStatus: RteEventRef=OIE_EventInfo_FEE_E_GC_INIT_GetEventStatus
        RteEventToTaskMapping_OIE_EventInfo_FEE_E_GC_INIT_GetEventTested: RteEventRef=OIE_EventInfo_FEE_E_GC_INIT_GetEventTested
        RteEventToTaskMapping_OIE_EventInfo_FEE_E_GC_INIT_GetFaultDetectionCounter: RteEventRef=OIE_EventInfo_FEE_E_GC_INIT_GetFaultDetectionCounter
        RteEventToTaskMapping_OIE_EventInfo_FEE_E_GC_READ_GetDTCOfEvent: RteEventRef=OIE_EventInfo_FEE_E_GC_READ_GetDTCOfEvent
        RteEventToTaskMapping_OIE_EventInfo_FEE_E_GC_READ_GetEventExtendedDataRecord: RteEventRef=OIE_EventInfo_FEE_E_GC_READ_GetEventExtendedDataRecord
        RteEventToTaskMapping_OIE_EventInfo_FEE_E_GC_READ_GetEventFailed: RteEventRef=OIE_EventInfo_FEE_E_GC_READ_GetEventFailed
        RteEventToTaskMapping_OIE_EventInfo_FEE_E_GC_READ_GetEventFreezeFrameData: RteEventRef=OIE_EventInfo_FEE_E_GC_READ_GetEventFreezeFrameData
        RteEventToTaskMapping_OIE_EventInfo_FEE_E_GC_READ_GetEventStatus: RteEventRef=OIE_EventInfo_FEE_E_GC_READ_GetEventStatus
        RteEventToTaskMapping_OIE_EventInfo_FEE_E_GC_READ_GetEventTested: RteEventRef=OIE_EventInfo_FEE_E_GC_READ_GetEventTested
        RteEventToTaskMapping_OIE_EventInfo_FEE_E_GC_READ_GetFaultDetectionCounter: RteEventRef=OIE_EventInfo_FEE_E_GC_READ_GetFaultDetectionCounter
        RteEventToTaskMapping_OIE_EventInfo_FEE_E_GC_TRIG_GetDTCOfEvent: RteEventRef=OIE_EventInfo_FEE_E_GC_TRIG_GetDTCOfEvent
        RteEventToTaskMapping_OIE_EventInfo_FEE_E_GC_TRIG_GetEventExtendedDataRecord: RteEventRef=OIE_EventInfo_FEE_E_GC_TRIG_GetEventExtendedDataRecord
        RteEventToTaskMapping_OIE_EventInfo_FEE_E_GC_TRIG_GetEventFailed: RteEventRef=OIE_EventInfo_FEE_E_GC_TRIG_GetEventFailed
        RteEventToTaskMapping_OIE_EventInfo_FEE_E_GC_TRIG_GetEventFreezeFrameData: RteEventRef=OIE_EventInfo_FEE_E_GC_TRIG_GetEventFreezeFrameData
        RteEventToTaskMapping_OIE_EventInfo_FEE_E_GC_TRIG_GetEventStatus: RteEventRef=OIE_EventInfo_FEE_E_GC_TRIG_GetEventStatus
        RteEventToTaskMapping_OIE_EventInfo_FEE_E_GC_TRIG_GetEventTested: RteEventRef=OIE_EventInfo_FEE_E_GC_TRIG_GetEventTested
        RteEventToTaskMapping_OIE_EventInfo_FEE_E_GC_TRIG_GetFaultDetectionCounter: RteEventRef=OIE_EventInfo_FEE_E_GC_TRIG_GetFaultDetectionCounter
        RteEventToTaskMapping_OIE_EventInfo_FEE_E_GC_WRITE_GetDTCOfEvent: RteEventRef=OIE_EventInfo_FEE_E_GC_WRITE_GetDTCOfEvent
        RteEventToTaskMapping_OIE_EventInfo_FEE_E_GC_WRITE_GetEventExtendedDataRecord: RteEventRef=OIE_EventInfo_FEE_E_GC_WRITE_GetEventExtendedDataRecord
        RteEventToTaskMapping_OIE_EventInfo_FEE_E_GC_WRITE_GetEventFailed: RteEventRef=OIE_EventInfo_FEE_E_GC_WRITE_GetEventFailed
        RteEventToTaskMapping_OIE_EventInfo_FEE_E_GC_WRITE_GetEventFreezeFrameData: RteEventRef=OIE_EventInfo_FEE_E_GC_WRITE_GetEventFreezeFrameData
        RteEventToTaskMapping_OIE_EventInfo_FEE_E_GC_WRITE_GetEventStatus: RteEventRef=OIE_EventInfo_FEE_E_GC_WRITE_GetEventStatus
        RteEventToTaskMapping_OIE_EventInfo_FEE_E_GC_WRITE_GetEventTested: RteEventRef=OIE_EventInfo_FEE_E_GC_WRITE_GetEventTested
        RteEventToTaskMapping_OIE_EventInfo_FEE_E_GC_WRITE_GetFaultDetectionCounter: RteEventRef=OIE_EventInfo_FEE_E_GC_WRITE_GetFaultDetectionCounter
        RteEventToTaskMapping_OIE_EventInfo_FEE_E_INVALIDATE_GetDTCOfEvent: RteEventRef=OIE_EventInfo_FEE_E_INVALIDATE_GetDTCOfEvent
        RteEventToTaskMapping_OIE_EventInfo_FEE_E_INVALIDATE_GetEventExtendedDataRecord: RteEventRef=OIE_EventInfo_FEE_E_INVALIDATE_GetEventExtendedDataRecord
        RteEventToTaskMapping_OIE_EventInfo_FEE_E_INVALIDATE_GetEventFailed: RteEventRef=OIE_EventInfo_FEE_E_INVALIDATE_GetEventFailed
        RteEventToTaskMapping_OIE_EventInfo_FEE_E_INVALIDATE_GetEventFreezeFrameData: RteEventRef=OIE_EventInfo_FEE_E_INVALIDATE_GetEventFreezeFrameData
        RteEventToTaskMapping_OIE_EventInfo_FEE_E_INVALIDATE_GetEventStatus: RteEventRef=OIE_EventInfo_FEE_E_INVALIDATE_GetEventStatus
        RteEventToTaskMapping_OIE_EventInfo_FEE_E_INVALIDATE_GetEventTested: RteEventRef=OIE_EventInfo_FEE_E_INVALIDATE_GetEventTested
        RteEventToTaskMapping_OIE_EventInfo_FEE_E_INVALIDATE_GetFaultDetectionCounter: RteEventRef=OIE_EventInfo_FEE_E_INVALIDATE_GetFaultDetectionCounter
        RteEventToTaskMapping_OIE_EventInfo_FEE_E_READ_GetDTCOfEvent: RteEventRef=OIE_EventInfo_FEE_E_READ_GetDTCOfEvent
        RteEventToTaskMapping_OIE_EventInfo_FEE_E_READ_GetEventExtendedDataRecord: RteEventRef=OIE_EventInfo_FEE_E_READ_GetEventExtendedDataRecord
        RteEventToTaskMapping_OIE_EventInfo_FEE_E_READ_GetEventFailed: RteEventRef=OIE_EventInfo_FEE_E_READ_GetEventFailed
        RteEventToTaskMapping_OIE_EventInfo_FEE_E_READ_GetEventFreezeFrameData: RteEventRef=OIE_EventInfo_FEE_E_READ_GetEventFreezeFrameData
        RteEventToTaskMapping_OIE_EventInfo_FEE_E_READ_GetEventStatus: RteEventRef=OIE_EventInfo_FEE_E_READ_GetEventStatus
        RteEventToTaskMapping_OIE_EventInfo_FEE_E_READ_GetEventTested: RteEventRef=OIE_EventInfo_FEE_E_READ_GetEventTested
        RteEventToTaskMapping_OIE_EventInfo_FEE_E_READ_GetFaultDetectionCounter: RteEventRef=OIE_EventInfo_FEE_E_READ_GetFaultDetectionCounter
        RteEventToTaskMapping_OIE_EventInfo_FEE_E_UNCONFIG_BLK_EXCEEDED_GetDTCOfEvent: RteEventRef=OIE_EventInfo_FEE_E_UNCONFIG_BLK_EXCEEDED_GetDTCOfEvent
        RteEventToTaskMapping_OIE_EventInfo_FEE_E_UNCONFIG_BLK_EXCEEDED_GetEventExtendedDataRecord: RteEventRef=OIE_EventInfo_FEE_E_UNCONFIG_BLK_EXCEEDED_GetEventExtendedDataRecord
        RteEventToTaskMapping_OIE_EventInfo_FEE_E_UNCONFIG_BLK_EXCEEDED_GetEventFailed: RteEventRef=OIE_EventInfo_FEE_E_UNCONFIG_BLK_EXCEEDED_GetEventFailed
        RteEventToTaskMapping_OIE_EventInfo_FEE_E_UNCONFIG_BLK_EXCEEDED_GetEventFreezeFrameData: RteEventRef=OIE_EventInfo_FEE_E_UNCONFIG_BLK_EXCEEDED_GetEventFreezeFrameData
        RteEventToTaskMapping_OIE_EventInfo_FEE_E_UNCONFIG_BLK_EXCEEDED_GetEventStatus: RteEventRef=OIE_EventInfo_FEE_E_UNCONFIG_BLK_EXCEEDED_GetEventStatus
        RteEventToTaskMapping_OIE_EventInfo_FEE_E_UNCONFIG_BLK_EXCEEDED_GetEventTested: RteEventRef=OIE_EventInfo_FEE_E_UNCONFIG_BLK_EXCEEDED_GetEventTested
        RteEventToTaskMapping_OIE_EventInfo_FEE_E_UNCONFIG_BLK_EXCEEDED_GetFaultDetectionCounter: RteEventRef=OIE_EventInfo_FEE_E_UNCONFIG_BLK_EXCEEDED_GetFaultDetectionCounter
        RteEventToTaskMapping_OIE_EventInfo_FEE_E_WRITE_GetDTCOfEvent: RteEventRef=OIE_EventInfo_FEE_E_WRITE_GetDTCOfEvent
        RteEventToTaskMapping_OIE_EventInfo_FEE_E_WRITE_GetEventExtendedDataRecord: RteEventRef=OIE_EventInfo_FEE_E_WRITE_GetEventExtendedDataRecord
        RteEventToTaskMapping_OIE_EventInfo_FEE_E_WRITE_GetEventFailed: RteEventRef=OIE_EventInfo_FEE_E_WRITE_GetEventFailed
        RteEventToTaskMapping_OIE_EventInfo_FEE_E_WRITE_GetEventFreezeFrameData: RteEventRef=OIE_EventInfo_FEE_E_WRITE_GetEventFreezeFrameData
        RteEventToTaskMapping_OIE_EventInfo_FEE_E_WRITE_GetEventStatus: RteEventRef=OIE_EventInfo_FEE_E_WRITE_GetEventStatus
        RteEventToTaskMapping_OIE_EventInfo_FEE_E_WRITE_GetEventTested: RteEventRef=OIE_EventInfo_FEE_E_WRITE_GetEventTested
        RteEventToTaskMapping_OIE_EventInfo_FEE_E_WRITE_GetFaultDetectionCounter: RteEventRef=OIE_EventInfo_FEE_E_WRITE_GetFaultDetectionCounter
        RteEventToTaskMapping_OIE_EventInfo_FEE_E_WRITE_CYCLES_EXHAUSTED_GetDTCOfEvent: RteEventRef=OIE_EventInfo_FEE_E_WRITE_CYCLES_EXHAUSTED_GetDTCOfEvent
        RteEventToTaskMapping_OIE_EventInfo_FEE_E_WRITE_CYCLES_EXHAUSTED_GetEventExtendedDataRecord: RteEventRef=OIE_EventInfo_FEE_E_WRITE_CYCLES_EXHAUSTED_GetEventExtendedDataRecord
        RteEventToTaskMapping_OIE_EventInfo_FEE_E_WRITE_CYCLES_EXHAUSTED_GetEventFailed: RteEventRef=OIE_EventInfo_FEE_E_WRITE_CYCLES_EXHAUSTED_GetEventFailed
        RteEventToTaskMapping_OIE_EventInfo_FEE_E_WRITE_CYCLES_EXHAUSTED_GetEventFreezeFrameData: RteEventRef=OIE_EventInfo_FEE_E_WRITE_CYCLES_EXHAUSTED_GetEventFreezeFrameData
        RteEventToTaskMapping_OIE_EventInfo_FEE_E_WRITE_CYCLES_EXHAUSTED_GetEventStatus: RteEventRef=OIE_EventInfo_FEE_E_WRITE_CYCLES_EXHAUSTED_GetEventStatus
        RteEventToTaskMapping_OIE_EventInfo_FEE_E_WRITE_CYCLES_EXHAUSTED_GetEventTested: RteEventRef=OIE_EventInfo_FEE_E_WRITE_CYCLES_EXHAUSTED_GetEventTested
        RteEventToTaskMapping_OIE_EventInfo_FEE_E_WRITE_CYCLES_EXHAUSTED_GetFaultDetectionCounter: RteEventRef=OIE_EventInfo_FEE_E_WRITE_CYCLES_EXHAUSTED_GetFaultDetectionCounter
        RteEventToTaskMapping_OIE_EventInfo_MCU_E_ERAY_TIMEOUT_GetDTCOfEvent: RteEventRef=OIE_EventInfo_MCU_E_ERAY_TIMEOUT_GetDTCOfEvent
        RteEventToTaskMapping_OIE_EventInfo_MCU_E_ERAY_TIMEOUT_GetEventExtendedDataRecord: RteEventRef=OIE_EventInfo_MCU_E_ERAY_TIMEOUT_GetEventExtendedDataRecord
        RteEventToTaskMapping_OIE_EventInfo_MCU_E_ERAY_TIMEOUT_GetEventFailed: RteEventRef=OIE_EventInfo_MCU_E_ERAY_TIMEOUT_GetEventFailed
        RteEventToTaskMapping_OIE_EventInfo_MCU_E_ERAY_TIMEOUT_GetEventFreezeFrameData: RteEventRef=OIE_EventInfo_MCU_E_ERAY_TIMEOUT_GetEventFreezeFrameData
        RteEventToTaskMapping_OIE_EventInfo_MCU_E_ERAY_TIMEOUT_GetEventStatus: RteEventRef=OIE_EventInfo_MCU_E_ERAY_TIMEOUT_GetEventStatus
        RteEventToTaskMapping_OIE_EventInfo_MCU_E_ERAY_TIMEOUT_GetEventTested: RteEventRef=OIE_EventInfo_MCU_E_ERAY_TIMEOUT_GetEventTested
        RteEventToTaskMapping_OIE_EventInfo_MCU_E_ERAY_TIMEOUT_GetFaultDetectionCounter: RteEventRef=OIE_EventInfo_MCU_E_ERAY_TIMEOUT_GetFaultDetectionCounter
        RteEventToTaskMapping_OIE_EventInfo_MCU_E_OSC_FAILURE_GetDTCOfEvent: RteEventRef=OIE_EventInfo_MCU_E_OSC_FAILURE_GetDTCOfEvent
        RteEventToTaskMapping_OIE_EventInfo_MCU_E_OSC_FAILURE_GetEventExtendedDataRecord: RteEventRef=OIE_EventInfo_MCU_E_OSC_FAILURE_GetEventExtendedDataRecord
        RteEventToTaskMapping_OIE_EventInfo_MCU_E_OSC_FAILURE_GetEventFailed: RteEventRef=OIE_EventInfo_MCU_E_OSC_FAILURE_GetEventFailed
        RteEventToTaskMapping_OIE_EventInfo_MCU_E_OSC_FAILURE_GetEventFreezeFrameData: RteEventRef=OIE_EventInfo_MCU_E_OSC_FAILURE_GetEventFreezeFrameData
        RteEventToTaskMapping_OIE_EventInfo_MCU_E_OSC_FAILURE_GetEventStatus: RteEventRef=OIE_EventInfo_MCU_E_OSC_FAILURE_GetEventStatus
        RteEventToTaskMapping_OIE_EventInfo_MCU_E_OSC_FAILURE_GetEventTested: RteEventRef=OIE_EventInfo_MCU_E_OSC_FAILURE_GetEventTested
        RteEventToTaskMapping_OIE_EventInfo_MCU_E_OSC_FAILURE_GetFaultDetectionCounter: RteEventRef=OIE_EventInfo_MCU_E_OSC_FAILURE_GetFaultDetectionCounter
        RteEventToTaskMapping_OIE_EventInfo_SPI_E_DMA_TRANSFER_GetDTCOfEvent: RteEventRef=OIE_EventInfo_SPI_E_DMA_TRANSFER_GetDTCOfEvent
        RteEventToTaskMapping_OIE_EventInfo_SPI_E_DMA_TRANSFER_GetEventExtendedDataRecord: RteEventRef=OIE_EventInfo_SPI_E_DMA_TRANSFER_GetEventExtendedDataRecord
        RteEventToTaskMapping_OIE_EventInfo_SPI_E_DMA_TRANSFER_GetEventFailed: RteEventRef=OIE_EventInfo_SPI_E_DMA_TRANSFER_GetEventFailed
        RteEventToTaskMapping_OIE_EventInfo_SPI_E_DMA_TRANSFER_GetEventFreezeFrameData: RteEventRef=OIE_EventInfo_SPI_E_DMA_TRANSFER_GetEventFreezeFrameData
        RteEventToTaskMapping_OIE_EventInfo_SPI_E_DMA_TRANSFER_GetEventStatus: RteEventRef=OIE_EventInfo_SPI_E_DMA_TRANSFER_GetEventStatus
        RteEventToTaskMapping_OIE_EventInfo_SPI_E_DMA_TRANSFER_GetEventTested: RteEventRef=OIE_EventInfo_SPI_E_DMA_TRANSFER_GetEventTested
        RteEventToTaskMapping_OIE_EventInfo_SPI_E_DMA_TRANSFER_GetFaultDetectionCounter: RteEventRef=OIE_EventInfo_SPI_E_DMA_TRANSFER_GetFaultDetectionCounter
        RteEventToTaskMapping_OIE_EventInfo_SPI_E_HARDWARE_ERROR_GetDTCOfEvent: RteEventRef=OIE_EventInfo_SPI_E_HARDWARE_ERROR_GetDTCOfEvent
        RteEventToTaskMapping_OIE_EventInfo_SPI_E_HARDWARE_ERROR_GetEventExtendedDataRecord: RteEventRef=OIE_EventInfo_SPI_E_HARDWARE_ERROR_GetEventExtendedDataRecord
        RteEventToTaskMapping_OIE_EventInfo_SPI_E_HARDWARE_ERROR_GetEventFailed: RteEventRef=OIE_EventInfo_SPI_E_HARDWARE_ERROR_GetEventFailed
        RteEventToTaskMapping_OIE_EventInfo_SPI_E_HARDWARE_ERROR_GetEventFreezeFrameData: RteEventRef=OIE_EventInfo_SPI_E_HARDWARE_ERROR_GetEventFreezeFrameData
        RteEventToTaskMapping_OIE_EventInfo_SPI_E_HARDWARE_ERROR_GetEventStatus: RteEventRef=OIE_EventInfo_SPI_E_HARDWARE_ERROR_GetEventStatus
        RteEventToTaskMapping_OIE_EventInfo_SPI_E_HARDWARE_ERROR_GetEventTested: RteEventRef=OIE_EventInfo_SPI_E_HARDWARE_ERROR_GetEventTested
        RteEventToTaskMapping_OIE_EventInfo_SPI_E_HARDWARE_ERROR_GetFaultDetectionCounter: RteEventRef=OIE_EventInfo_SPI_E_HARDWARE_ERROR_GetFaultDetectionCounter
        RteEventToTaskMapping_OIE_EventInfo_WDG_E_INIT_FAILED_GetDTCOfEvent: RteEventRef=OIE_EventInfo_WDG_E_INIT_FAILED_GetDTCOfEvent
        RteEventToTaskMapping_OIE_EventInfo_WDG_E_INIT_FAILED_GetEventExtendedDataRecord: RteEventRef=OIE_EventInfo_WDG_E_INIT_FAILED_GetEventExtendedDataRecord
        RteEventToTaskMapping_OIE_EventInfo_WDG_E_INIT_FAILED_GetEventFailed: RteEventRef=OIE_EventInfo_WDG_E_INIT_FAILED_GetEventFailed
        RteEventToTaskMapping_OIE_EventInfo_WDG_E_INIT_FAILED_GetEventFreezeFrameData: RteEventRef=OIE_EventInfo_WDG_E_INIT_FAILED_GetEventFreezeFrameData
        RteEventToTaskMapping_OIE_EventInfo_WDG_E_INIT_FAILED_GetEventStatus: RteEventRef=OIE_EventInfo_WDG_E_INIT_FAILED_GetEventStatus
        RteEventToTaskMapping_OIE_EventInfo_WDG_E_INIT_FAILED_GetEventTested: RteEventRef=OIE_EventInfo_WDG_E_INIT_FAILED_GetEventTested
        RteEventToTaskMapping_OIE_EventInfo_WDG_E_INIT_FAILED_GetFaultDetectionCounter: RteEventRef=OIE_EventInfo_WDG_E_INIT_FAILED_GetFaultDetectionCounter
    RteSwComponentType_Dem (RteSwComponentType): RteComponentTypeRef=Dem
      RteComponentTypeCalibration: category=TOOL_CONFIGURED, RteCalibrationSupportEnabled=0
    SwcInstance_EcuM_Slave1 (RteSwComponentInstance): category=TOOL_CONFIGURED, RteSoftwareComponentInstanceRef=EcuM_Slave1
      RteEventToTaskMapping_EcuM_TE_10ms_Slave1 (RteEventToTaskMapping):
        category = TOOL_CONFIGURED
        RteImmediateRestart = false
        RtePositionInTask = 0
        RteEventRef = EcuM_TE_10ms_Slave1
        RteMappedToTaskRef = OsTask_BSW_FG1_10ms_Sub1
        RteUsedOsAlarmRef = OsAlarm_BSW_10ms_Sub1
    SwcInstance_EcuM (RteSwComponentInstance): category=TOOL_CONFIGURED, RteSoftwareComponentInstanceRef=EcuM
      15 x RteEventToTaskMapping, all with category=TOOL_CONFIGURED, RteImmediateRestart=false:
        RteEventToTaskMapping_OIE_GetBootTarget: RteEventRef=OIE_GetBootTarget
        RteEventToTaskMapping_OIE_SelectBootTarget: RteEventRef=OIE_SelectBootTarget
        RteEventToTaskMapping_OIE_GetLastShutdownTarget: RteEventRef=OIE_GetLastShutdownTarget
        RteEventToTaskMapping_OIE_GetMostRecentShutdown: RteEventRef=OIE_GetMostRecentShutdown
        RteEventToTaskMapping_OIE_GetNextRecentShutdown: RteEventRef=OIE_GetNextRecentShutdown
        RteEventToTaskMapping_OIE_GetShutdownCause: RteEventRef=OIE_GetShutdownCause
        RteEventToTaskMapping_OIE_GetShutdownTarget: RteEventRef=OIE_GetShutdownTarget
        RteEventToTaskMapping_OIE_GoDown: RteEventRef=OIE_GoDown
        RteEventToTaskMapping_OIE_GoHalt: RteEventRef=OIE_GoHalt
        RteEventToTaskMapping_OIE_GoPoll: RteEventRef=OIE_GoPoll
        RteEventToTaskMapping_OIE_SelectShutdownCause: RteEventRef=OIE_SelectShutdownCause
        RteEventToTaskMapping_OIE_SelectShutdownTarget: RteEventRef=OIE_SelectShutdownTarget
        RteEventToTaskMapping_OIE_ClearWakeupEvent: RteEventRef=OIE_ClearWakeupEvent
        RteEventToTaskMapping_OIE_DisableWakeupSources: RteEventRef=OIE_DisableWakeupSources
        RteEventToTaskMapping_OIE_EnableWakeupSources: RteEventRef=OIE_EnableWakeupSources
    RteSwComponentType_EcuM (RteSwComponentType): RteComponentTypeRef=EcuM
      RteComponentTypeCalibration: category=TOOL_CONFIGURED, RteCalibrationSupportEnabled=0
    5 x RteSwComponentInstance, all with category=TOOL_CONFIGURED:
      SwcInstance_EcuM_Slave2: RteSoftwareComponentInstanceRef=EcuM_Slave2
        RteEventToTaskMapping_EcuM_TE_10ms_Slave2 (RteEventToTaskMapping):
          category = TOOL_CONFIGURED
          RteImmediateRestart = false
          RtePositionInTask = 0
          RteEventRef = EcuM_TE_10ms_Slave2
          RteMappedToTaskRef = OsTask_BSW_FG1_10ms_Sub2
          RteUsedOsAlarmRef = OsAlarm_BSW_10ms_Sub2
      SwcInstance_Os_Slave1: RteSoftwareComponentInstanceRef=Os_Slave1
        RteEventToTaskMapping_Os_TE_10ms_Slave1 (RteEventToTaskMapping):
          category = TOOL_CONFIGURED
          RteImmediateRestart = false
          RtePositionInTask = 1
          RteEventRef = Os_TE_10ms_Slave1
          RteMappedToTaskRef = OsTask_BSW_FG1_10ms_Sub1
          RteUsedOsAlarmRef = OsAlarm_BSW_10ms_Sub1
      SwcInstance_Os_Master: RteSoftwareComponentInstanceRef=Os_Master
        RteEventToTaskMapping_Os_TE_10ms_Master (RteEventToTaskMapping):
          category = TOOL_CONFIGURED
          RteImmediateRestart = false
          RtePositionInTask = 3
          RteEventRef = Os_TE_10ms_Master
          RteMappedToTaskRef = OsTask_ASW_FG1_10ms
          RteUsedOsAlarmRef = OsAlarm_ASW_10ms
      SwcInstance_Os_Slave2: RteSoftwareComponentInstanceRef=Os_Slave2
        RteEventToTaskMapping_Os_TE_10ms_Slave2 (RteEventToTaskMapping):
          category = TOOL_CONFIGURED
          RteImmediateRestart = false
          RtePositionInTask = 1
          RteEventRef = Os_TE_10ms_Slave2
          RteMappedToTaskRef = OsTask_BSW_FG1_10ms_Sub2
          RteUsedOsAlarmRef = OsAlarm_BSW_10ms_Sub2
      SwcInstance_Svc_NvM: RteSoftwareComponentInstanceRef=Svc_NvM
        63 x RteEventToTaskMapping, all with category=TOOL_CONFIGURED, RteImmediateRestart=false:
          RteEventToTaskMapping_OperationInvokedEvent_PS_NvMBlock_ConfigID_InvalidateNvBlock: RteEventRef=OperationInvokedEvent_PS_NvMBlock_ConfigID_InvalidateNvBlock
          RteEventToTaskMapping_OperationInvokedEvent_PS_NvMBlock_ConfigID_EraseNvBlock: RteEventRef=OperationInvokedEvent_PS_NvMBlock_ConfigID_EraseNvBlock
          RteEventToTaskMapping_OperationInvokedEvent_PS_NvMBlock_ConfigID_RestoreBlockDefaults: RteEventRef=OperationInvokedEvent_PS_NvMBlock_ConfigID_RestoreBlockDefaults
          RteEventToTaskMapping_OperationInvokedEvent_PS_NvMBlock_ConfigID_CancelJobs: RteEventRef=OperationInvokedEvent_PS_NvMBlock_ConfigID_CancelJobs
          RteEventToTaskMapping_OperationInvokedEvent_PS_NvMBlock_ConfigID_GetErrorStatus: RteEventRef=OperationInvokedEvent_PS_NvMBlock_ConfigID_GetErrorStatus
          RteEventToTaskMapping_OperationInvokedEvent_PS_NvMBlock_ConfigID_WriteBlock: RteEventRef=OperationInvokedEvent_PS_NvMBlock_ConfigID_WriteBlock
          RteEventToTaskMapping_OperationInvokedEvent_PS_NvMBlock_ConfigID_ReadBlock: RteEventRef=OperationInvokedEvent_PS_NvMBlock_ConfigID_ReadBlock
          RteEventToTaskMapping_OperationInvokedEvent_PS_NvMBlock_DemNonVolatileData_InvalidateNvBlock: RteEventRef=OperationInvokedEvent_PS_NvMBlock_DemNonVolatileData_InvalidateNvBlock
          RteEventToTaskMapping_OperationInvokedEvent_PS_NvMBlock_DemNonVolatileData_EraseNvBlock: RteEventRef=OperationInvokedEvent_PS_NvMBlock_DemNonVolatileData_EraseNvBlock
          RteEventToTaskMapping_OperationInvokedEvent_PS_NvMBlock_DemNonVolatileData_RestoreBlockDefaults: RteEventRef=OperationInvokedEvent_PS_NvMBlock_DemNonVolatileData_RestoreBlockDefaults
          RteEventToTaskMapping_OperationInvokedEvent_PS_NvMBlock_DemNonVolatileData_CancelJobs: RteEventRef=OperationInvokedEvent_PS_NvMBlock_DemNonVolatileData_CancelJobs
          RteEventToTaskMapping_OperationInvokedEvent_PS_NvMBlock_DemNonVolatileData_GetErrorStatus: RteEventRef=OperationInvokedEvent_PS_NvMBlock_DemNonVolatileData_GetErrorStatus
          RteEventToTaskMapping_OperationInvokedEvent_PS_NvMBlock_DemNonVolatileData_WriteBlock: RteEventRef=OperationInvokedEvent_PS_NvMBlock_DemNonVolatileData_WriteBlock
          RteEventToTaskMapping_OperationInvokedEvent_PS_NvMBlock_DemNonVolatileData_ReadBlock: RteEventRef=OperationInvokedEvent_PS_NvMBlock_DemNonVolatileData_ReadBlock
          RteEventToTaskMapping_OperationInvokedEvent_PS_NvMBlock_DemPrimaryEventMemoryEntry_0_InvalidateNvBlock: RteEventRef=OperationInvokedEvent_PS_NvMBlock_DemPrimaryEventMemoryEntry_0_InvalidateNvBlock
          RteEventToTaskMapping_OperationInvokedEvent_PS_NvMBlock_DemPrimaryEventMemoryEntry_0_EraseNvBlock: RteEventRef=OperationInvokedEvent_PS_NvMBlock_DemPrimaryEventMemoryEntry_0_EraseNvBlock
          RteEventToTaskMapping_OperationInvokedEvent_PS_NvMBlock_DemPrimaryEventMemoryEntry_0_RestoreBlockDefaults: RteEventRef=OperationInvokedEvent_PS_NvMBlock_DemPrimaryEventMemoryEntry_0_RestoreBlockDefaults
          RteEventToTaskMapping_OperationInvokedEvent_PS_NvMBlock_DemPrimaryEventMemoryEntry_0_CancelJobs: RteEventRef=OperationInvokedEvent_PS_NvMBlock_DemPrimaryEventMemoryEntry_0_CancelJobs
          RteEventToTaskMapping_OperationInvokedEvent_PS_NvMBlock_DemPrimaryEventMemoryEntry_0_GetErrorStatus: RteEventRef=OperationInvokedEvent_PS_NvMBlock_DemPrimaryEventMemoryEntry_0_GetErrorStatus
          RteEventToTaskMapping_OperationInvokedEvent_PS_NvMBlock_DemPrimaryEventMemoryEntry_0_WriteBlock: RteEventRef=OperationInvokedEvent_PS_NvMBlock_DemPrimaryEventMemoryEntry_0_WriteBlock
          RteEventToTaskMapping_OperationInvokedEvent_PS_NvMBlock_DemPrimaryEventMemoryEntry_0_ReadBlock: RteEventRef=OperationInvokedEvent_PS_NvMBlock_DemPrimaryEventMemoryEntry_0_ReadBlock
          RteEventToTaskMapping_OperationInvokedEvent_PS_NvMBlock_DemPrimaryEventMemoryEntry_1_InvalidateNvBlock: RteEventRef=OperationInvokedEvent_PS_NvMBlock_DemPrimaryEventMemoryEntry_1_InvalidateNvBlock
          RteEventToTaskMapping_OperationInvokedEvent_PS_NvMBlock_DemPrimaryEventMemoryEntry_1_EraseNvBlock: RteEventRef=OperationInvokedEvent_PS_NvMBlock_DemPrimaryEventMemoryEntry_1_EraseNvBlock
          RteEventToTaskMapping_OperationInvokedEvent_PS_NvMBlock_DemPrimaryEventMemoryEntry_1_RestoreBlockDefaults: RteEventRef=OperationInvokedEvent_PS_NvMBlock_DemPrimaryEventMemoryEntry_1_RestoreBlockDefaults
          RteEventToTaskMapping_OperationInvokedEvent_PS_NvMBlock_DemPrimaryEventMemoryEntry_1_CancelJobs: RteEventRef=OperationInvokedEvent_PS_NvMBlock_DemPrimaryEventMemoryEntry_1_CancelJobs
          RteEventToTaskMapping_OperationInvokedEvent_PS_NvMBlock_DemPrimaryEventMemoryEntry_1_GetErrorStatus: RteEventRef=OperationInvokedEvent_PS_NvMBlock_DemPrimaryEventMemoryEntry_1_GetErrorStatus
          RteEventToTaskMapping_OperationInvokedEvent_PS_NvMBlock_DemPrimaryEventMemoryEntry_1_WriteBlock: RteEventRef=OperationInvokedEvent_PS_NvMBlock_DemPrimaryEventMemoryEntry_1_WriteBlock
          RteEventToTaskMapping_OperationInvokedEvent_PS_NvMBlock_DemPrimaryEventMemoryEntry_1_ReadBlock: RteEventRef=OperationInvokedEvent_PS_NvMBlock_DemPrimaryEventMemoryEntry_1_ReadBlock
          RteEventToTaskMapping_OperationInvokedEvent_PS_NvMBlock_DemPrimaryEventMemoryEntry_2_InvalidateNvBlock: RteEventRef=OperationInvokedEvent_PS_NvMBlock_DemPrimaryEventMemoryEntry_2_InvalidateNvBlock
          RteEventToTaskMapping_OperationInvokedEvent_PS_NvMBlock_DemPrimaryEventMemoryEntry_2_EraseNvBlock: RteEventRef=OperationInvokedEvent_PS_NvMBlock_DemPrimaryEventMemoryEntry_2_EraseNvBlock
          RteEventToTaskMapping_OperationInvokedEvent_PS_NvMBlock_DemPrimaryEventMemoryEntry_2_RestoreBlockDefaults: RteEventRef=OperationInvokedEvent_PS_NvMBlock_DemPrimaryEventMemoryEntry_2_RestoreBlockDefaults
          RteEventToTaskMapping_OperationInvokedEvent_PS_NvMBlock_DemPrimaryEventMemoryEntry_2_CancelJobs: RteEventRef=OperationInvokedEvent_PS_NvMBlock_DemPrimaryEventMemoryEntry_2_CancelJobs
          RteEventToTaskMapping_OperationInvokedEvent_PS_NvMBlock_DemPrimaryEventMemoryEntry_2_GetErrorStatus: RteEventRef=OperationInvokedEvent_PS_NvMBlock_DemPrimaryEventMemoryEntry_2_GetErrorStatus
          RteEventToTaskMapping_OperationInvokedEvent_PS_NvMBlock_DemPrimaryEventMemoryEntry_2_WriteBlock: RteEventRef=OperationInvokedEvent_PS_NvMBlock_DemPrimaryEventMemoryEntry_2_WriteBlock
          RteEventToTaskMapping_OperationInvokedEvent_PS_NvMBlock_DemPrimaryEventMemoryEntry_2_ReadBlock: RteEventRef=OperationInvokedEvent_PS_NvMBlock_DemPrimaryEventMemoryEntry_2_ReadBlock
          RteEventToTaskMapping_OperationInvokedEvent_PS_NvMBlock_Test_Native_6_InvalidateNvBlock: RteEventRef=OperationInvokedEvent_PS_NvMBlock_Test_Native_6_InvalidateNvBlock
          RteEventToTaskMapping_OperationInvokedEvent_PS_NvMBlock_Test_Native_6_EraseNvBlock: RteEventRef=OperationInvokedEvent_PS_NvMBlock_Test_Native_6_EraseNvBlock
          RteEventToTaskMapping_OperationInvokedEvent_PS_NvMBlock_Test_Native_6_RestoreBlockDefaults: RteEventRef=OperationInvokedEvent_PS_NvMBlock_Test_Native_6_RestoreBlockDefaults
          RteEventToTaskMapping_OperationInvokedEvent_PS_NvMBlock_Test_Native_6_CancelJobs: RteEventRef=OperationInvokedEvent_PS_NvMBlock_Test_Native_6_CancelJobs
          RteEventToTaskMapping_OperationInvokedEvent_PS_NvMBlock_Test_Native_6_GetErrorStatus: RteEventRef=OperationInvokedEvent_PS_NvMBlock_Test_Native_6_GetErrorStatus
          RteEventToTaskMapping_OperationInvokedEvent_PS_NvMBlock_Test_Native_6_WriteBlock: RteEventRef=OperationInvokedEvent_PS_NvMBlock_Test_Native_6_WriteBlock
          RteEventToTaskMapping_OperationInvokedEvent_PS_NvMBlock_Test_Native_6_ReadBlock: RteEventRef=OperationInvokedEvent_PS_NvMBlock_Test_Native_6_ReadBlock
          RteEventToTaskMapping_OperationInvokedEvent_PS_NvMBlock_IntTst_TestBlock1_InvalidateNvBlock: RteEventRef=OperationInvokedEvent_PS_NvMBlock_IntTst_TestBlock1_InvalidateNvBlock
          RteEventToTaskMapping_OperationInvokedEvent_PS_NvMBlock_IntTst_TestBlock1_EraseNvBlock: RteEventRef=OperationInvokedEvent_PS_NvMBlock_IntTst_TestBlock1_EraseNvBlock
          RteEventToTaskMapping_OperationInvokedEvent_PS_NvMBlock_IntTst_TestBlock1_RestoreBlockDefaults: RteEventRef=OperationInvokedEvent_PS_NvMBlock_IntTst_TestBlock1_RestoreBlockDefaults
          RteEventToTaskMapping_OperationInvokedEvent_PS_NvMBlock_IntTst_TestBlock1_CancelJobs: RteEventRef=OperationInvokedEvent_PS_NvMBlock_IntTst_TestBlock1_CancelJobs
          RteEventToTaskMapping_OperationInvokedEvent_PS_NvMBlock_IntTst_TestBlock1_GetErrorStatus: RteEventRef=OperationInvokedEvent_PS_NvMBlock_IntTst_TestBlock1_GetErrorStatus
          RteEventToTaskMapping_OperationInvokedEvent_PS_NvMBlock_IntTst_TestBlock1_WriteBlock: RteEventRef=OperationInvokedEvent_PS_NvMBlock_IntTst_TestBlock1_WriteBlock
          RteEventToTaskMapping_OperationInvokedEvent_PS_NvMBlock_IntTst_TestBlock1_ReadBlock: RteEventRef=OperationInvokedEvent_PS_NvMBlock_IntTst_TestBlock1_ReadBlock
          RteEventToTaskMapping_OperationInvokedEvent_PS_NvMBlock_IntTst_TestBlock2_InvalidateNvBlock: RteEventRef=OperationInvokedEvent_PS_NvMBlock_IntTst_TestBlock2_InvalidateNvBlock
          RteEventToTaskMapping_OperationInvokedEvent_PS_NvMBlock_IntTst_TestBlock2_EraseNvBlock: RteEventRef=OperationInvokedEvent_PS_NvMBlock_IntTst_TestBlock2_EraseNvBlock
          RteEventToTaskMapping_OperationInvokedEvent_PS_NvMBlock_IntTst_TestBlock2_RestoreBlockDefaults: RteEventRef=OperationInvokedEvent_PS_NvMBlock_IntTst_TestBlock2_RestoreBlockDefaults
          RteEventToTaskMapping_OperationInvokedEvent_PS_NvMBlock_IntTst_TestBlock2_CancelJobs: RteEventRef=OperationInvokedEvent_PS_NvMBlock_IntTst_TestBlock2_CancelJobs
          RteEventToTaskMapping_OperationInvokedEvent_PS_NvMBlock_IntTst_TestBlock2_GetErrorStatus: RteEventRef=OperationInvokedEvent_PS_NvMBlock_IntTst_TestBlock2_GetErrorStatus
          RteEventToTaskMapping_OperationInvokedEvent_PS_NvMBlock_IntTst_TestBlock2_WriteBlock: RteEventRef=OperationInvokedEvent_PS_NvMBlock_IntTst_TestBlock2_WriteBlock
          RteEventToTaskMapping_OperationInvokedEvent_PS_NvMBlock_IntTst_TestBlock2_ReadBlock: RteEventRef=OperationInvokedEvent_PS_NvMBlock_IntTst_TestBlock2_ReadBlock
          RteEventToTaskMapping_OperationInvokedEvent_PS_NvMBlock_IntTst_TestBlock3_InvalidateNvBlock: RteEventRef=OperationInvokedEvent_PS_NvMBlock_IntTst_TestBlock3_InvalidateNvBlock
          RteEventToTaskMapping_OperationInvokedEvent_PS_NvMBlock_IntTst_TestBlock3_EraseNvBlock: RteEventRef=OperationInvokedEvent_PS_NvMBlock_IntTst_TestBlock3_EraseNvBlock
          RteEventToTaskMapping_OperationInvokedEvent_PS_NvMBlock_IntTst_TestBlock3_RestoreBlockDefaults: RteEventRef=OperationInvokedEvent_PS_NvMBlock_IntTst_TestBlock3_RestoreBlockDefaults
          RteEventToTaskMapping_OperationInvokedEvent_PS_NvMBlock_IntTst_TestBlock3_CancelJobs: RteEventRef=OperationInvokedEvent_PS_NvMBlock_IntTst_TestBlock3_CancelJobs
          RteEventToTaskMapping_OperationInvokedEvent_PS_NvMBlock_IntTst_TestBlock3_GetErrorStatus: RteEventRef=OperationInvokedEvent_PS_NvMBlock_IntTst_TestBlock3_GetErrorStatus
          RteEventToTaskMapping_OperationInvokedEvent_PS_NvMBlock_IntTst_TestBlock3_WriteBlock: RteEventRef=OperationInvokedEvent_PS_NvMBlock_IntTst_TestBlock3_WriteBlock
          RteEventToTaskMapping_OperationInvokedEvent_PS_NvMBlock_IntTst_TestBlock3_ReadBlock: RteEventRef=OperationInvokedEvent_PS_NvMBlock_IntTst_TestBlock3_ReadBlock
    RteSwComponentType_NvM (RteSwComponentType): RteComponentTypeRef=NvM
      RteComponentTypeCalibration: category=TOOL_CONFIGURED, RteCalibrationSupportEnabled=0
    SwcInstance_Svc_WdgM (RteSwComponentInstance): category=TOOL_CONFIGURED, RteSoftwareComponentInstanceRef=Svc_WdgM
      10 x RteEventToTaskMapping, all with category=TOOL_CONFIGURED, RteImmediateRestart=false:
        RteEventToTaskMapping_OperationInvokedEvent_alive_SE_Init_CheckpointReached: RteEventRef=OperationInvokedEvent_alive_SE_Init_CheckpointReached
        RteEventToTaskMapping_OperationInvokedEvent_alive_SE_Init_UpdateAliveCounter: RteEventRef=OperationInvokedEvent_alive_SE_Init_UpdateAliveCounter
        RteEventToTaskMapping_OperationInvokedEvent_alive_SE_WdgMTest_CheckpointReached: RteEventRef=OperationInvokedEvent_alive_SE_WdgMTest_CheckpointReached
        RteEventToTaskMapping_OperationInvokedEvent_alive_SE_WdgMTest_UpdateAliveCounter: RteEventRef=OperationInvokedEvent_alive_SE_WdgMTest_UpdateAliveCounter
        RteEventToTaskMapping_OperationInvokedEvent_SetMode: RtePositionInTask=0, RteEventRef=OperationInvokedEvent_SetMode, RteMappedToTaskRef=OsTask_BSW_FG2_WdgMAPI
        RteEventToTaskMapping_OperationInvokedEvent_GetMode: RteEventRef=OperationInvokedEvent_GetMode
        RteEventToTaskMapping_OperationInvokedEvent_GetLocalStatus: RteEventRef=OperationInvokedEvent_GetLocalStatus
        RteEventToTaskMapping_OperationInvokedEvent_GetGlobalStatus: RteEventRef=OperationInvokedEvent_GetGlobalStatus
        RteEventToTaskMapping_OperationInvokedEvent_PerformReset: RtePositionInTask=1, RteEventRef=OperationInvokedEvent_PerformReset, RteMappedToTaskRef=OsTask_BSW_FG2_WdgMAPI
        RteEventToTaskMapping_OperationInvokedEvent_GetFirstExpiredSEID: RteEventRef=OperationInvokedEvent_GetFirstExpiredSEID
    SwcInstance_SWC_AppTransformer (RteSwComponentInstance): RteSoftwareComponentInstanceRef=SWC_AppTransformer
      RteEventToTaskMapping0 (RteEventToTaskMapping):
        RteImmediateRestart = 0
        RtePositionInTask = 1
        RteEventRef = TE_App_Transformer
        RteMappedToTaskRef = OsTask_ASW_FG1_100ms
        RteUsedOsAlarmRef = OsAlarm_ASW_100ms
    RteSwComponentType_WdgM (RteSwComponentType): RteComponentTypeRef=WdgM
      RteComponentTypeCalibration: category=TOOL_CONFIGURED, RteCalibrationSupportEnabled=0
    CommonPublishedInformation: ModuleId=2, VendorId=76, ArReleaseVersion=4.0.3, SwVersion=4.0.2
    RteBswGeneral: RteUseComShadowSignalApi=0, RteSchMVersionInfoApi=0
    RteGeneration:
      RteCalibrationSupport = OVERLAY_RAM
      RteDevErrorDetect = 0
      RteDevErrorDetectUninit = 0
      RteGenerationMode = COMPATIBILITY_MODE
      RteIocInteractionReturnValue = RTE_IOC
      RteMeasurementSupport = 0
      RteOptimizationMode = RUNTIME
      RteValueRangeCheckEnabled = 0
      RteVfbTraceEnabled = 0
      RteTaskComMapping = OsTask_RteComTask
    RtePostBuildVariantConfiguration
    RteOsInteraction0 (RteOsInteraction): SynchronizedActivateOffset=0
      8 x RteUsedOsActivation, all with AlarmSetMethodIsRelative=1:
        RteUsedOsActivation_BSW_5ms_Mem: RteExpectedActivationPosition=0, RteExpectedActivationOffset=0.0025, RteActivationOsAlarmRef=OsAlarm_BSW_5ms_Mem
        RteUsedOsActivation_BSW_5ms_Com: RteExpectedActivationPosition=1, RteExpectedActivationOffset=0.0025, RteActivationOsAlarmRef=OsAlarm_BSW_5ms_Com
        RteUsedOsActivation_BSW_100ms: RteExpectedActivationPosition=2, RteExpectedActivationOffset=0.02, RteActivationOsAlarmRef=OsAlarm_BSW_100ms
        RteUsedOsActivation_ASW_100ms: RteExpectedActivationPosition=3, RteExpectedActivationOffset=0.01875, RteActivationOsAlarmRef=OsAlarm_ASW_100ms
        RteUsedOsActivation_ASW_10ms: RteExpectedActivationPosition=4, RteExpectedActivationOffset=0.00375, RteActivationOsAlarmRef=OsAlarm_ASW_10ms
        RteUsedOsActivation_BSW_10ms: RteExpectedActivationPosition=5, RteExpectedActivationOffset=0.005, RteActivationOsAlarmRef=OsAlarm_BSW_10ms
        RteUsedOsActivation_BSW_10ms_Sub1: RteExpectedActivationOffset=0.005, RteExpectedActivationPosition=6, RteActivationOsAlarmRef=OsAlarm_BSW_10ms_Sub1
        RteUsedOsActivation_BSW_10ms_Sub2: RteExpectedActivationOffset=0.005, RteExpectedActivationPosition=7, RteActivationOsAlarmRef=OsAlarm_BSW_10ms_Sub2
