AUTOSAR XML (schema 4-0-3)
package /AUTOSAR
  module config Rte: implementation-config-variant=VARIANT-PRE-COMPILE, containers=[..., ..., ...]
