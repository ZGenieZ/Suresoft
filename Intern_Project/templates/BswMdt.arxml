AUTOSAR XML (schema 4-0-3)
standard types defined: Std_ReturnType, uint8, uint16
package /Autosar_Rte
  bsw implementation BswImplementation_0: programming-language=C, sw-version=4.0.2, used-code-generator=RteCodeGenerator, vendor-id=76, ar-release-version=4.0.3, behavior=BswInternalBehavior_0
    resource consumption ResourceConsumption_0
      6 x memory section, all with prefix=SectionNamePrefix_0:
        RTE_START_SEC_CODE: alignment=CODE, symbol=START
        RTE_STOP_SEC_CODE: alignment=CODE, symbol=STOP
        RTE_START_SEC_VAR_8: alignment=8, symbol=START
        RTE_STOP_SEC_VAR_8: alignment=8, symbol=STOP
        RTE_START_SEC_VAR_NO_INIT_8: alignment=8, symbol=START
        RTE_STOP_SEC_VAR_NO_INIT_8: alignment=8, symbol=STOP
      section name prefix SectionNamePrefix_0: symbol=RTE
  19 x bsw module entry, all with is-reentrant=true, is-synchronous=true, sw-service-impl-policy=STANDARD:
    Rte_Start: service-id=0x70, role=Rte_Start, call-type=REGULAR, execution-context=UNSPECIFIED
      return type Std_ReturnType: direction=OUT, implementation-data-type=Std_ReturnType
    Rte_Stop: service-id=0x71, role=Rte_Stop, call-type=REGULAR, execution-context=UNSPECIFIED
      return type Std_ReturnType: direction=OUT, implementation-data-type=Std_ReturnType
    SchM_Init: service-id=0x00, role=SchM_Init, call-type=REGULAR, execution-context=UNSPECIFIED
    SchM_Deinit: service-id=0x01, role=SchM_Deinit, call-type=REGULAR, execution-context=UNSPECIFIED
    SchM_GetVersionInfo: service-id=0x02, role=SchM_GetVersionInfo, call-type=REGULAR, execution-context=UNSPECIFIED
      sw service arg LpVersionInfo: direction=IN, implementation-data-type=Std_VersionInfoType
    Rte_COMCbk_ComISignalGroup_MsgGr_CCANFD_ACU_01_100ms: service-id=0x95, role=Rte_COMCbk_ComISignalGroup_MsgGr_CCANFD_ACU_01_100ms, call-type=REGULAR, execution-context=UNSPECIFIED
    Rte_ComCbk_ComISignalGroup_MsgGr_CCANFD_ESC_01_10ms: service-id=0x95, role=Rte_ComCbk_ComISignalGroup_MsgGr_CCANFD_ESC_01_10ms, call-type=REGULAR, execution-context=UNSPECIFIED
    Rte_PartitionRestarting_EcucPartition_Main: service-id=0x73, role=Rte_PartitionRestarting_EcucPartition_Main, call-type=REGULAR, execution-context=UNSPECIFIED
    Rte_PartitionRestarting_EcucPartition_NonTrusted: service-id=0x73, role=Rte_PartitionRestarting_EcucPartition_NonTrusted, call-type=REGULAR, execution-context=UNSPECIFIED
    Rte_PartitionRestarting_EcucPartition_Sub1: service-id=0x73, role=Rte_PartitionRestarting_EcucPartition_Sub1, call-type=REGULAR, execution-context=UNSPECIFIED
    Rte_PartitionRestarting_EcucPartition_Sub2: service-id=0x73, role=Rte_PartitionRestarting_EcucPartition_Sub2, call-type=REGULAR, execution-context=UNSPECIFIED
    Rte_PartitionTerminated_EcucPartition_Main: service-id=0x72, role=Rte_PartitionTerminated_EcucPartition_Main, call-type=REGULAR, execution-context=UNSPECIFIED
    Rte_PartitionTerminated_EcucPartition_NonTrusted: service-id=0x72, role=Rte_PartitionTerminated_EcucPartition_NonTrusted, call-type=REGULAR, execution-context=UNSPECIFIED
    Rte_PartitionTerminated_EcucPartition_Sub1: service-id=0x72, role=Rte_PartitionTerminated_EcucPartition_Sub1, call-type=REGULAR, execution-context=UNSPECIFIED
    Rte_PartitionTerminated_EcucPartition_Sub2: service-id=0x72, role=Rte_PartitionTerminated_EcucPartition_Sub2, call-type=REGULAR, execution-context=UNSPECIFIED
    Rte_RestartPartition_EcucPartition_Main: service-id=0x74, role=Rte_RestartPartition_EcucPartition_Main, call-type=REGULAR, execution-context=UNSPECIFIED
      return type Std_ReturnType: direction=OUT, implementation-data-type=Std_ReturnType
    Rte_RestartPartition_EcucPartition_NonTrusted: service-id=0x74, role=Rte_RestartPartition_EcucPartition_NonTrusted, call-type=REGULAR, execution-context=UNSPECIFIED
      return type Std_ReturnType: direction=OUT, implementation-data-type=Std_ReturnType
    Rte_RestartPartition_EcucPartition_Sub1: service-id=0x74, role=Rte_RestartPartition_EcucPartition_Sub1, call-type=CALLBACK, execution-context=TASK
      return type Std_ReturnType: direction=OUT, implementation-data-type=Std_ReturnType
    Rte_RestartPartition_EcucPartition_Sub2: service-id=0x74, role=Rte_RestartPartition_EcucPartition_Sub2, call-type=CALLBACK, execution-context=TASK
      return type Std_ReturnType: direction=OUT, implementation-data-type=Std_ReturnType
  bsw module description BswModuleDescription_0
    provided-entrys:
      Rte_Start
      Rte_Stop
      SchM_Init
      SchM_Deinit
      SchM_GetVersionInfo
      Rte_PartitionRestarting_EcucPartition_Main
      Rte_PartitionRestarting_EcucPartition_NonTrusted
      Rte_PartitionRestarting_EcucPartition_Sub1
      Rte_PartitionRestarting_EcucPartition_Sub2
      Rte_PartitionTerminated_EcucPartition_Main
      Rte_PartitionTerminated_EcucPartition_NonTrusted
      Rte_PartitionTerminated_EcucPartition_Sub1
      Rte_PartitionTerminated_EcucPartition_Sub2
      Rte_RestartPartition_EcucPartition_Main
      Rte_RestartPartition_EcucPartition_NonTrusted
      Rte_RestartPartition_EcucPartition_Sub1
      Rte_RestartPartition_EcucPartition_Sub2
    bsw module dependency BswModuleDependency_0: target-module-id=2, required-entrys=[Rte_Start, Rte_Stop, SchM_Init, SchM_Deinit, SchM_GetVersionInfo]
    bsw module dependency BswModuleDependency_1: target-module-id=50
      expected-callbacks:
        Rte_COMCbk_ComISignalGroup_MsgGr_CCANFD_ACU_01_100ms
        Rte_ComCbk_ComISignalGroup_MsgGr_CCANFD_ESC_01_10ms
        Rte_PartitionRestarting_EcucPartition_Main
        Rte_PartitionRestarting_EcucPartition_NonTrusted
        Rte_PartitionRestarting_EcucPartition_Sub1
        Rte_PartitionRestarting_EcucPartition_Sub2
        Rte_PartitionTerminated_EcucPartition_Main
        Rte_PartitionTerminated_EcucPartition_NonTrusted
        Rte_PartitionTerminated_EcucPartition_Sub1
        Rte_PartitionTerminated_EcucPartition_Sub2
        Rte_RestartPartition_EcucPartition_Main
        Rte_RestartPartition_EcucPartition_NonTrusted
        Rte_RestartPartition_EcucPartition_Sub1
        Rte_RestartPartition_EcucPartition_Sub2
    bsw internal behavior BswInternalBehavior_0
      static-memorys:
        50 x data:
          Rte_GucInitState_NewMode_modeSwitchPort_InitStateBswM: type=uint8
          Rte_GucComMMode_zDEBUGCAN_NewMode_modeSwitchPort_ComMMode_zDEBUGCANBswM: type=uint8
          Rte_GucComMMode_CCANFD_CurrentMode_modeSwitchPort_ComMMode_CCANFDBswM: type=uint8
          Rte_GucCanSMBORState_CCANFD_OldMode_modeSwitchPort_CanSMBORState_CCANFDBswM: type=uint8
          Rte_GucEcuMode_OldMode_modeSwitchPort_EcuModeBswM: type=EcuM_StateType
          Rte_GucWakeupEvent_CurrentMode_modeSwitchPort_WakeupEventBswM: type=uint8
          Rte_GucCanSMBORState_zDEBUGCAN_CurrentMode_modeSwitchPort_CanSMBORState_zDEBUGCANBswM: type=uint8
          Rte_GucDcmDiagnosticSessionControl_CurrentMode_modeSwitchPort_DcmDiagnosticSessionControlBswM: type=uint8
          Rte_GucComMMode_zDEBUGCAN_CurrentMode_modeSwitchPort_ComMMode_zDEBUGCANBswM: type=uint8
          Rte_GucPduGroupRx_CCANFD_CurrentMode_modeSwitchPort_PduGroupRx_CCANFDBswM: type=uint8
          Rte_GucComMMode_LCANFD_NewMode_modeSwitchPort_ComMMode_LCANFDBswM: type=uint8
          Rte_GucCanSMBORState_LCANFD_CurrentMode_modeSwitchPort_CanSMBORState_LCANFDBswM: type=uint8
          Rte_GucDcmDiagnosticSessionControl_OldMode_modeSwitchPort_DcmDiagnosticSessionControlBswM: type=uint8
          Rte_GucPduGroupTx_CCANFD_CurrentMode_modeNotificationPort_PduGroupTx_CCANFDSWC_AppMode: type=uint8
          Rte_GuccurrentMode_CurrentMode_globalModeWdgM: type=uint8
          Rte_GuccurrentMode_CurrentMode_UM000_PComM: type=ComM_ModeType
          Rte_GucPduGroupTx_zDEBUGCAN_CurrentMode_modeSwitchPort_PduGroupTx_zDEBUGCANBswM: type=uint8
          Rte_GucComMMode_LCANFD_CurrentMode_modeSwitchPort_ComMMode_LCANFDBswM: type=uint8
          Rte_GucPduGroupRx_LCANFD_CurrentMode_modeSwitchPort_PduGroupRx_LCANFDBswM: type=uint8
          Rte_GucPduGroupRx_zDEBUGCAN_CurrentMode_modeNotificationPort_PduGroupRx_zDEBUGCANSWC_AppMode: type=uint8
          Rte_GuccurrentMode_OldMode_globalModeWdgM: type=uint8
          Rte_GucComMMode_CCANFD_OldMode_modeSwitchPort_ComMMode_CCANFDBswM: type=uint8
          Rte_GucPduGroupRx_CCANFD_CurrentMode_modeNotificationPort_PduGroupRx_CCANFDSWC_AppMode: type=uint8
          Rte_GucCanSMBORState_zDEBUGCAN_OldMode_modeSwitchPort_CanSMBORState_zDEBUGCANBswM: type=uint8
          Rte_GucCanSMBORState_CCANFD_CurrentMode_modeSwitchPort_CanSMBORState_CCANFDBswM: type=uint8
          Rte_GucPduGroupRx_zDEBUGCAN_CurrentMode_modeSwitchPort_PduGroupRx_zDEBUGCANBswM: type=uint8
          Rte_GucComMMode_LCANFD_OldMode_modeSwitchPort_ComMMode_LCANFDBswM: type=uint8
          Rte_GuccurrentMode_NewMode_globalModeWdgM: type=uint8
          Rte_GucComMMode_zDEBUGCAN_OldMode_modeSwitchPort_ComMMode_zDEBUGCANBswM: type=uint8
          Rte_GuccurrentMode_CurrentMode_mode_SE_InitWdgM: type=uint8
          Rte_GucCanSMBORState_LCANFD_OldMode_modeSwitchPort_CanSMBORState_LCANFDBswM: type=uint8
          Rte_GucPduGroupTx_CCANFD_CurrentMode_modeSwitchPort_PduGroupTx_CCANFDBswM: type=uint8
          Rte_GucDcmDiagnosticSessionControl_NewMode_modeSwitchPort_DcmDiagnosticSessionControlBswM: type=uint8
          Rte_GucPduGroupTx_LCANFD_CurrentMode_modeNotificationPort_PduGroupTx_LCANFDSWC_AppMode: type=uint8
          Rte_GucPduGroupTx_LCANFD_CurrentMode_modeSwitchPort_PduGroupTx_LCANFDBswM: type=uint8
          Rte_GucPduGroupRx_LCANFD_CurrentMode_modeNotificationPort_PduGroupRx_LCANFDSWC_AppMode: type=uint8
          Rte_GucEcuMode_CurrentMode_modeSwitchPort_EcuModeBswM: type=EcuM_StateType
          Rte_GucCanSMBORState_CCANFD_NewMode_modeSwitchPort_CanSMBORState_CCANFDBswM: type=uint8
          Rte_GuccurrentMode_CurrentMode_UM002_PComM: type=ComM_ModeType
          Rte_GucComMMode_CCANFD_NewMode_modeSwitchPort_ComMMode_CCANFDBswM: type=uint8
          Rte_GucCanSMBORState_LCANFD_NewMode_modeSwitchPort_CanSMBORState_LCANFDBswM: type=uint8
          Rte_GucWakeupEvent_NewMode_modeSwitchPort_WakeupEventBswM: type=uint8
          Rte_GucInitState_OldMode_modeSwitchPort_InitStateBswM: type=uint8
          Rte_GucPduGroupTx_zDEBUGCAN_CurrentMode_modeNotificationPort_PduGroupTx_zDEBUGCANSWC_AppMode: type=uint8
          Rte_GuccurrentMode_CurrentMode_mode_SE_WdgMTestWdgM: type=uint8
          Rte_GucInitState_CurrentMode_modeSwitchPort_InitStateBswM: type=uint8
          Rte_GucWakeupEvent_OldMode_modeSwitchPort_WakeupEventBswM: type=uint8
          Rte_GucEcuMode_NewMode_modeSwitchPort_EcuModeBswM: type=EcuM_StateType
          Rte_GuccurrentMode_CurrentMode_UM001_PComM: type=ComM_ModeType
          Rte_GucCanSMBORState_zDEBUGCAN_NewMode_modeSwitchPort_CanSMBORState_zDEBUGCANBswM: type=uint8
      17 x bsw called entity:
        BswCalledEntity_0: implemented-entry=Rte_Start
        BswCalledEntity_1: implemented-entry=Rte_Stop
        BswCalledEntity_3: implemented-entry=SchM_Init
        BswCalledEntity_4: implemented-entry=SchM_Deinit
        BswCalledEntity_5: implemented-entry=SchM_GetVersionInfo
        BswCalledEntity_8: implemented-entry=Rte_PartitionRestarting_EcucPartition_Main
        BswCalledEntity_9: implemented-entry=Rte_PartitionRestarting_EcucPartition_NonTrusted
        BswCalledEntity_10: implemented-entry=Rte_PartitionRestarting_EcucPartition_Sub1
        BswCalledEntity_11: implemented-entry=Rte_PartitionRestarting_EcucPartition_Sub2
        BswCalledEntity_12: implemented-entry=Rte_PartitionTerminated_EcucPartition_Main
        BswCalledEntity_13: implemented-entry=Rte_PartitionTerminated_EcucPartition_NonTrusted
        BswCalledEntity_14: implemented-entry=Rte_PartitionTerminated_EcucPartition_Sub1
        BswCalledEntity_15: implemented-entry=Rte_PartitionTerminated_EcucPartition_Sub2
        BswCalledEntity_16: implemented-entry=Rte_RestartPartition_EcucPartition_Main
        BswCalledEntity_17: implemented-entry=Rte_RestartPartition_EcucPartition_NonTrusted
        BswCalledEntity_18: implemented-entry=Rte_RestartPartition_EcucPartition_Sub1
        BswCalledEntity_19: implemented-entry=Rte_RestartPartition_EcucPartition_Sub2
  impl type Std_VersionInfoType: category=DATA_REFERENCE
    5 x element:
      vendorID: base-type=uint16
      moduleID: base-type=uint16
      sw_major_version: base-type=uint8
      sw_minor_version: base-type=uint8
      sw_patch_version: base-type=uint8
