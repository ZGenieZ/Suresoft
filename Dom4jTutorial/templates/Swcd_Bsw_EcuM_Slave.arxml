AUTOSAR XML (schema 4-0-3)
package /EcuM/ServiceSwComponentTypes
  service sw component type EcuM_Slave1
    behavior SwcIB_EcuM_Slave1: handle-termination-and-restart=NO-SUPPORT
      timing event EcuM_TE_10ms_Slave1: start-on-event=EcuM_MainFunction1, period=0.01
      runnable EcuM_MainFunction1
  swc implementation SwcImplementation_EcuM_Slave1: programming-language=C, behavior=SwcIB_EcuM_Slave1
  service sw component type EcuM_Slave2
    behavior SwcIB_EcuM_Slave2: handle-termination-and-restart=NO-SUPPORT
      timing event EcuM_TE_10ms_Slave2: start-on-event=EcuM_MainFunction2, period=0.01
      runnable EcuM_MainFunction2
  swc implementation SwcImplementation_EcuM_Slave2: programming-language=C, behavior=SwcIB_EcuM_Slave2
package /EcuM/CompositionSwComponentTypes
  composition sw component type CSwc_EcuM_Slave
    component EcuM_Slave1: type=EcuM_Slave1
    component EcuM_Slave2: type=EcuM_Slave2
